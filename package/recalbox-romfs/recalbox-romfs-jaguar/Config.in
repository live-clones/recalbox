## package/recalbox-romfs/recalbox-romfs-jaguar/Config.in
```kconfig
config BR2_PACKAGE_RECALBOX_ROMFS_JAGUAR
	bool "recalbox-romfs-jaguar"
	select BR2_PACKAGE_RECALBOX_ROMS
	depends on BR2_PACKAGE_LIBRETRO_VIRTUALJAGUAR
	help
	  share_init/roms and xml for jaguar
```

## package/recalbox-romfs/recalbox-romfs-lowresnx/Config.in
```kconfig
config BR2_PACKAGE_RECALBOX_ROMFS_LOWRESNX
	bool "recalbox-romfs-lowresnx"
	select BR2_PACKAGE_RECALBOX_ROMS
	depends on BR2_PACKAGE_LIBRETRO_LOWRES_NX
	help
	  share_init/roms and xml for lowresnx
```

## package/recalbox-romfs/recalbox-romfs-macintosh/Config.in
```kconfig
config BR2_PACKAGE_RECALBOX_ROMFS_MACINTOSH
	bool "recalbox-romfs-macintosh"
	select BR2_PACKAGE_RECALBOX_ROMS
	depends on BR2_PACKAGE_LIBRETRO_MINIVMAC
	help
	  share_init/roms and xml for macintosh
```

## package/recalbox-romfs/recalbox-romfs-mame/Config.in
```kconfig
config BR2_PACKAGE_RECALBOX_ROMFS_MAME
	bool "recalbox-romfs-mame"
	select BR2_PACKAGE_RECALBOX_ROMS
	depends on BR2_PACKAGE_LIBRETRO_MAME2003 \
	  || BR2_PACKAGE_LIBRETRO_MAME2000 \
	  || BR2_PACKAGE_ADVANCEMAME \
	  || BR2_PACKAGE_LIBRETRO_MAME2010 \
	  || BR2_PACKAGE_LIBRETRO_MAME2015 \
	  || BR2_PACKAGE_LIBRETRO_MAME \
	  || BR2_PACKAGE_LIBRETRO_MAME2003_PLUS
	help
	  share_init/roms and xml for mame
```

## package/recalbox-romfs/recalbox-romfs-mastersystem/Config.in
```kconfig
config BR2_PACKAGE_RECALBOX_ROMFS_MASTERSYSTEM
	bool "recalbox-romfs-mastersystem"
	select BR2_PACKAGE_RECALBOX_ROMS
	depends on BR2_PACKAGE_LIBRETRO_GENESISPLUSGX \
	  || BR2_PACKAGE_LIBRETRO_PICODRIVE \
	  || BR2_PACKAGE_LIBRETRO_GEARSYSTEM \
	  || BR2_PACKAGE_LIBRETRO_FBNEO
	help
	  share_init/roms and xml for mastersystem
```

## package/recalbox-romfs/recalbox-romfs-megadrive/Config.in
```kconfig
config BR2_PACKAGE_RECALBOX_ROMFS_MEGADRIVE
	bool "recalbox-romfs-megadrive"
	select BR2_PACKAGE_RECALBOX_ROMS
	depends on BR2_PACKAGE_LIBRETRO_GENESISPLUSGX \
	  || BR2_PACKAGE_LIBRETRO_PICODRIVE \
	  || BR2_PACKAGE_LIBRETRO_FBNEO
	help
	  share_init/roms and xml for megadrive
```

## package/recalbox-romfs/recalbox-romfs-minecraft/Config.in
```kconfig
config BR2_PACKAGE_RECALBOX_ROMFS_MINECRAFT
	bool "recalbox-romfs-minecraft"
	select BR2_PACKAGE_RECALBOX_ROMS
	depends on BR2_PACKAGE_LIBRETRO_CRAFT
	help
	  share_init/roms and xml for minecraft
```

## package/recalbox-romfs/recalbox-romfs-model3/Config.in
```kconfig
config BR2_PACKAGE_RECALBOX_ROMFS_MODEL3
	bool "recalbox-romfs-model3"
	select BR2_PACKAGE_RECALBOX_ROMS
	depends on BR2_PACKAGE_SUPERMODEL
	help
	  share_init/roms and xml for model3
```

## package/recalbox-romfs/recalbox-romfs-mrboom/Config.in
```kconfig
config BR2_PACKAGE_RECALBOX_ROMFS_MRBOOM
	bool "recalbox-romfs-mrboom"
	select BR2_PACKAGE_RECALBOX_ROMS
	depends on BR2_PACKAGE_LIBRETRO_MRBOOM
	help
	  share_init/roms and xml for mrboom
```

## package/recalbox-romfs/recalbox-romfs-msxturbor/Config.in
```kconfig
config BR2_PACKAGE_RECALBOX_ROMFS_MSXTURBOR
	bool "recalbox-romfs-msxturbor"
	select BR2_PACKAGE_RECALBOX_ROMS
	depends on BR2_PACKAGE_LIBRETRO_BLUEMSX
	help
	  share_init/roms and xml for msxturbor
```

## package/recalbox-romfs/recalbox-romfs-multivision/Config.in
```kconfig
config BR2_PACKAGE_RECALBOX_ROMFS_MULTIVISION
	bool "recalbox-romfs-multivision"
	select BR2_PACKAGE_RECALBOX_ROMS
	depends on BR2_PACKAGE_LIBRETRO_GEARSYSTEM
	help
	  share_init/roms and xml for multivision
```

## package/recalbox-romfs/recalbox-romfs-n64/Config.in
```kconfig
config BR2_PACKAGE_RECALBOX_ROMFS_N64
	bool "recalbox-romfs-n64"
	select BR2_PACKAGE_RECALBOX_ROMS
	depends on BR2_PACKAGE_MUPEN64PLUS_GLIDEN64 \
	  || BR2_PACKAGE_MUPEN64PLUS_GLES2N64 \
	  || BR2_PACKAGE_MUPEN64PLUS_GLES2RICE \
	  || BR2_PACKAGE_MUPEN64PLUS_VIDEO_GLIDE64MK2 \
	  || BR2_PACKAGE_LIBRETRO_MUPEN64PLUS \
	  || BR2_PACKAGE_LIBRETRO_PARALLEL_N64 \
	  || BR2_PACKAGE_LIBRETRO_MUPEN64PLUS_NX
	help
	  share_init/roms and xml for n64
```

## package/recalbox-romfs/recalbox-romfs-naomigd/Config.in
```kconfig
config BR2_PACKAGE_RECALBOX_ROMFS_NAOMIGD
	bool "recalbox-romfs-naomigd"
	select BR2_PACKAGE_RECALBOX_ROMS
	depends on BR2_PACKAGE_LIBRETRO_FLYCAST
	help
	  share_init/roms and xml for naomigd
```

## package/recalbox-romfs/recalbox-romfs-nds/Config.in
```kconfig
config BR2_PACKAGE_RECALBOX_ROMFS_NDS
	bool "recalbox-romfs-nds"
	select BR2_PACKAGE_RECALBOX_ROMS
	depends on BR2_PACKAGE_LIBRETRO_DESMUME \
	  || BR2_PACKAGE_LIBRETRO_MELONDS
	help
	  share_init/roms and xml for nds
```

## package/recalbox-romfs/recalbox-romfs-neogeo/Config.in
```kconfig
config BR2_PACKAGE_RECALBOX_ROMFS_NEOGEO
	bool "recalbox-romfs-neogeo"
	select BR2_PACKAGE_RECALBOX_ROMS
	depends on BR2_PACKAGE_LIBRETRO_MAME2003 \
	  || BR2_PACKAGE_LIBRETRO_MAME2003_PLUS \
	  || BR2_PACKAGE_LIBRETRO_MAME2000 \
	  || BR2_PACKAGE_LIBRETRO_FBNEO \
	  || BR2_PACKAGE_PIFBA \
	  || BR2_PACKAGE_LIBRETRO_MAME2010 \
	  || BR2_PACKAGE_LIBRETRO_MAME2015 \
	  || BR2_PACKAGE_LIBRETRO_MAME2016
	help
	  share_init/roms and xml for neogeo
```

## package/recalbox-romfs/recalbox-romfs-neogeocd/Config.in
```kconfig
config BR2_PACKAGE_RECALBOX_ROMFS_NEOGEOCD
	bool "recalbox-romfs-neogeocd"
	select BR2_PACKAGE_RECALBOX_ROMS
	depends on BR2_PACKAGE_LIBRETRO_FBNEO \
	  || BR2_PACKAGE_LIBRETRO_NEOCD
	help
	  share_init/roms and xml for neogeocd
```

## package/recalbox-romfs/recalbox-romfs-openbor/Config.in
```kconfig
config BR2_PACKAGE_RECALBOX_ROMFS_OPENBOR
	bool "recalbox-romfs-openbor"
	select BR2_PACKAGE_RECALBOX_ROMS
	depends on BR2_PACKAGE_OPENBOR
	help
	  share_init/roms and xml for openbor
```

## package/recalbox-romfs/recalbox-romfs-openlara/Config.in
```kconfig
config BR2_PACKAGE_RECALBOX_ROMFS_OPENLARA
	bool "recalbox-romfs-openlara"
	select BR2_PACKAGE_RECALBOX_ROMS
	depends on BR2_PACKAGE_LIBRETRO_OPENLARA
	help
	  share_init/roms and xml for openlara
```

## package/recalbox-romfs/recalbox-romfs-oricatmos/Config.in
```kconfig
config BR2_PACKAGE_RECALBOX_ROMFS_ORICATMOS
	bool "recalbox-romfs-oricatmos"
	select BR2_PACKAGE_RECALBOX_ROMS
	depends on BR2_PACKAGE_ORICUTRON
	help
	  share_init/roms and xml for oricatmos
```

## package/recalbox-romfs/recalbox-romfs-outrun/Config.in
```kconfig
config BR2_PACKAGE_RECALBOX_ROMFS_OUTRUN
	bool "recalbox-romfs-outrun"
	select BR2_PACKAGE_RECALBOX_ROMS
	depends on BR2_PACKAGE_LIBRETRO_CANNONBALL
	help
	  share_init/roms and xml for outrun
```

## package/recalbox-romfs/recalbox-romfs-pc98/Config.in
```kconfig
config BR2_PACKAGE_RECALBOX_ROMFS_PC98
	bool "recalbox-romfs-pc98"
	select BR2_PACKAGE_RECALBOX_ROMS
	depends on BR2_PACKAGE_LIBRETRO_NP2KAI
	help
	  share_init/roms and xml for pc98
```

## package/recalbox-romfs/recalbox-romfs-pcengine/Config.in
```kconfig
config BR2_PACKAGE_RECALBOX_ROMFS_PCENGINE
	bool "recalbox-romfs-pcengine"
	select BR2_PACKAGE_RECALBOX_ROMS
	depends on BR2_PACKAGE_LIBRETRO_BEETLE_SUPERGRAFX \
	  || BR2_PACKAGE_LIBRETRO_BEETLE_PCE_FAST \
	  || BR2_PACKAGE_LIBRETRO_FBNEO
	help
	  share_init/roms and xml for pcengine
```

## package/recalbox-romfs/recalbox-romfs-pcfx/Config.in
```kconfig
config BR2_PACKAGE_RECALBOX_ROMFS_PCFX
	bool "recalbox-romfs-pcfx"
	select BR2_PACKAGE_RECALBOX_ROMS
	depends on BR2_PACKAGE_LIBRETRO_BEETLE_PCFX
	help
	  share_init/roms and xml for pcfx
```

## package/recalbox-romfs/recalbox-romfs-pcv2/Config.in
```kconfig
config BR2_PACKAGE_RECALBOX_ROMFS_PCV2
	bool "recalbox-romfs-pcv2"
	select BR2_PACKAGE_RECALBOX_ROMS
	depends on BR2_PACKAGE_LIBRETRO_BEETLE_WSWAN
	help
	  share_init/roms and xml for pcv2
```

## package/recalbox-romfs/recalbox-romfs-pico8/Config.in
```kconfig
config BR2_PACKAGE_RECALBOX_ROMFS_PICO8
	bool "recalbox-romfs-pico8"
	select BR2_PACKAGE_RECALBOX_ROMS
	depends on BR2_PACKAGE_LIBRETRO_RETRO8
	help
	  share_init/roms and xml for pico8
```
