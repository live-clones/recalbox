## package/recalbox-romfs/recalbox-romfs-ports/Config.in
```kconfig
config BR2_PACKAGE_RECALBOX_ROMFS_PORTS
	bool "recalbox-romfs-ports"
	select BR2_PACKAGE_RECALBOX_ROMS
	depends on BR2_PACKAGE_LIBRETRO_MRBOOM
	help
	  share_init/roms and xml for ports
```

## package/recalbox-romfs/recalbox-romfs-psx/Config.in
```kconfig
config BR2_PACKAGE_RECALBOX_ROMFS_PSX
	bool "recalbox-romfs-psx"
	select BR2_PACKAGE_RECALBOX_ROMS
	depends on BR2_PACKAGE_LIBRETRO_PCSX \
	  || BR2_PACKAGE_LIBRETRO_BEETLE_PSX \
	  || BR2_PACKAGE_LIBRETRO_BEETLE_PSX_HW
	help
	  share_init/roms and xml for psx
```

## package/recalbox-romfs/recalbox-romfs-quake/Config.in
```kconfig
config BR2_PACKAGE_RECALBOX_ROMFS_QUAKE
	bool "recalbox-romfs-quake"
	select BR2_PACKAGE_RECALBOX_ROMS
	depends on BR2_PACKAGE_LIBRETRO_TYRQUAKE
	help
	  share_init/roms and xml for quake
```

## package/recalbox-romfs/recalbox-romfs-quake1/Config.in
```kconfig
config BR2_PACKAGE_RECALBOX_ROMFS_QUAKE1
	bool "recalbox-romfs-quake1"
	select BR2_PACKAGE_RECALBOX_ROMS
	depends on BR2_PACKAGE_LIBRETRO_TYRQUAKE
	help
	  share_init/roms and xml for quake1
```

## package/recalbox-romfs/recalbox-romfs-quake2/Config.in
```kconfig
config BR2_PACKAGE_RECALBOX_ROMFS_QUAKE2
	bool "recalbox-romfs-quake2"
	select BR2_PACKAGE_RECALBOX_ROMS
	depends on BR2_PACKAGE_LIBRETRO_VITAQUAKE2
	help
	  share_init/roms and xml for quake2
```

## package/recalbox-romfs/recalbox-romfs-quake3/Config.in
```kconfig
config BR2_PACKAGE_RECALBOX_ROMFS_QUAKE3
	bool "recalbox-romfs-quake3"
	select BR2_PACKAGE_RECALBOX_ROMS
	depends on BR2_PACKAGE_LIBRETRO_VITAQUAKE3
	help
	  share_init/roms and xml for quake3
```

## package/recalbox-romfs/recalbox-romfs-rickdangerous/Config.in
```kconfig
config BR2_PACKAGE_RECALBOX_ROMFS_RICKDANGEROUS
	bool "recalbox-romfs-rickdangerous"
	select BR2_PACKAGE_RECALBOX_ROMS
	depends on BR2_PACKAGE_LIBRETRO_XRICK
	help
	  share_init/roms and xml for rickdangerous
```

## package/recalbox-romfs/recalbox-romfs-samcoupe/Config.in
```kconfig
config BR2_PACKAGE_RECALBOX_ROMFS_SAMCOUPE
	bool "recalbox-romfs-samcoupe"
	select BR2_PACKAGE_RECALBOX_ROMS
	depends on BR2_PACKAGE_SIMCOUPE
	help
	  share_init/roms and xml for samcoupe
```

## package/recalbox-romfs/recalbox-romfs-satellaview/Config.in
```kconfig
config BR2_PACKAGE_RECALBOX_ROMFS_SATELLAVIEW
	bool "recalbox-romfs-satellaview"
	select BR2_PACKAGE_RECALBOX_ROMS
	depends on BR2_PACKAGE_LIBRETRO_SNES9X
	help
	  share_init/roms and xml for satellaview
```

## package/recalbox-romfs/recalbox-romfs-scummvm/Config.in
```kconfig
config BR2_PACKAGE_RECALBOX_ROMFS_SCUMMVM
	bool "recalbox-romfs-scummvm"
	select BR2_PACKAGE_RECALBOX_ROMS
	depends on BR2_PACKAGE_SCUMMVM \
	  || BR2_PACKAGE_RESIDUALVM \
	  || BR2_PACKAGE_LIBRETRO_SCUMMVM
	help
	  share_init/roms and xml for scummvm
```

## package/recalbox-romfs/recalbox-romfs-scv/Config.in
```kconfig
config BR2_PACKAGE_RECALBOX_ROMFS_SCV
	bool "recalbox-romfs-scv"
	select BR2_PACKAGE_RECALBOX_ROMS
	depends on BR2_PACKAGE_LIBRETRO_EMUSCV
	help
	  share_init/roms and xml for scv
```

## package/recalbox-romfs/recalbox-romfs-snes/Config.in
```kconfig
config BR2_PACKAGE_RECALBOX_ROMFS_SNES
	bool "recalbox-romfs-snes"
	select BR2_PACKAGE_RECALBOX_ROMS
	depends on BR2_PACKAGE_LIBRETRO_SNES9X2002 \
	  || BR2_PACKAGE_LIBRETRO_SNES9X2005 \
	  || BR2_PACKAGE_LIBRETRO_SNES9X2010 \
	  || BR2_PACKAGE_LIBRETRO_SNES9X \
	  || BR2_PACKAGE_PISNES
	help
	  share_init/roms and xml for snes
```

## package/recalbox-romfs/recalbox-romfs-solarus/Config.in
```kconfig
config BR2_PACKAGE_RECALBOX_ROMFS_SOLARUS
	bool "recalbox-romfs-solarus"
	select BR2_PACKAGE_RECALBOX_ROMS
	depends on BR2_PACKAGE_RECALBOX_SOLARUS
	help
	  share_init/roms and xml for solarus
```

## package/recalbox-romfs/recalbox-romfs-spectravideo/Config.in
```kconfig
config BR2_PACKAGE_RECALBOX_ROMFS_SPECTRAVIDEO
	bool "recalbox-romfs-spectravideo"
	select BR2_PACKAGE_RECALBOX_ROMS
	depends on BR2_PACKAGE_LIBRETRO_BLUEMSX
	help
	  share_init/roms and xml for spectravideo
```

## package/recalbox-romfs/recalbox-romfs-startrekvoyager/Config.in
```kconfig
config BR2_PACKAGE_RECALBOX_ROMFS_STARTREKVOYAGER
	bool "recalbox-romfs-startrekvoyager"
	select BR2_PACKAGE_RECALBOX_ROMS
	depends on BR2_PACKAGE_LIBRETRO_VITAVOYAGER
	help
	  share_init/roms and xml for startrekvoyager
```

## package/recalbox-romfs/recalbox-romfs-sufami/Config.in
```kconfig
config BR2_PACKAGE_RECALBOX_ROMFS_SUFAMI
	bool "recalbox-romfs-sufami"
	select BR2_PACKAGE_RECALBOX_ROMS
	depends on BR2_PACKAGE_LIBRETRO_SNES9X
	help
	  share_init/roms and xml for sufami
```

## package/recalbox-romfs/recalbox-romfs-supervision/Config.in
```kconfig
config BR2_PACKAGE_RECALBOX_ROMFS_SUPERVISION
	bool "recalbox-romfs-supervision"
	select BR2_PACKAGE_RECALBOX_ROMS
	depends on BR2_PACKAGE_LIBRETRO_POTATOR
	help
	  share_init/roms and xml for supervision
```

## package/recalbox-romfs/recalbox-romfs-thepowdertoy/Config.in
```kconfig
config BR2_PACKAGE_RECALBOX_ROMFS_THEPOWDERTOY
    bool "recalbox-romfs-thepowdertoy"
    select BR2_PACKAGE_RECALBOX_ROMS
    depends on BR2_PACKAGE_LIBRETRO_THEPOWDERTOY
    help
      share_init/roms and xml for thepowdertoy
```

## package/recalbox-romfs/recalbox-romfs-thomson/Config.in
```kconfig
config BR2_PACKAGE_RECALBOX_ROMFS_THOMSON
	bool "recalbox-romfs-thomson"
	select BR2_PACKAGE_RECALBOX_ROMS
	depends on BR2_PACKAGE_LIBRETRO_THEODORE
	help
	  share_init/roms and xml for Thomson TO8
```

## package/recalbox-romfs/recalbox-romfs-tic80/Config.in
```kconfig
config BR2_PACKAGE_RECALBOX_ROMFS_TIC80
	bool "recalbox-romfs-tic80"
	select BR2_PACKAGE_RECALBOX_ROMS
	depends on BR2_PACKAGE_LIBRETRO_TIC80
	help
	  share_init/roms and xml for tic80
```

## package/recalbox-romfs/recalbox-romfs-vic20/Config.in
```kconfig
config BR2_PACKAGE_RECALBOX_ROMFS_VIC20
	bool "recalbox-romfs-vic20"
	select BR2_PACKAGE_RECALBOX_ROMS
	depends on BR2_PACKAGE_LIBRETRO_VICE
	help
	  share_init/roms and xml for vic20
```

## package/recalbox-romfs/recalbox-romfs-videopacplus/Config.in
```kconfig
config BR2_PACKAGE_RECALBOX_ROMFS_VIDEOPACPLUS
	bool "recalbox-romfs-videopacplus"
	select BR2_PACKAGE_RECALBOX_ROMS
	depends on BR2_PACKAGE_LIBRETRO_O2EM
	help
	  share_init/roms and xml for videopacplus
```

## package/recalbox-romfs/recalbox-romfs-wolfenstein3d/Config.in
```kconfig
config BR2_PACKAGE_RECALBOX_ROMFS_WOLFENSTEIN3D
	bool "recalbox-romfs-wolfenstein3d"
	select BR2_PACKAGE_RECALBOX_ROMS
	depends on BR2_PACKAGE_LIBRETRO_ECWOLF
	help
	  share_init/roms and xml for wolfenstein3d
```

## package/recalbox-romfs/recalbox-romfs-wsv/Config.in
```kconfig
config BR2_PACKAGE_RECALBOX_ROMFS_WSV
	bool "recalbox-romfs-wsv"
	select BR2_PACKAGE_RECALBOX_ROMS
	depends on BR2_PACKAGE_LIBRETRO_POTATOR
	help
	  share_init/roms and xml for wsv
```

## package/recalbox-romfs/recalbox-romfs-x1/Config.in
```kconfig
config BR2_PACKAGE_RECALBOX_ROMFS_X1
	bool "recalbox-romfs-x1"
	select BR2_PACKAGE_RECALBOX_ROMS
	depends on BR2_PACKAGE_LIBRETRO_XMIL
	help
	  share_init/roms and xml for x1
```
