## package/recalbox-romfs/recalbox-romfs-amiga600/Config.in
```kconfig
config BR2_PACKAGE_RECALBOX_ROMFS_AMIGA600
	bool "recalbox-romfs-amiga600"
	select BR2_PACKAGE_RECALBOX_ROMS
	depends on BR2_PACKAGE_AMIBERRY \
	  || BR2_PACKAGE_LIBRETRO_UAE
	help
	  share_init/roms and xml for amiga600
```

## package/recalbox-romfs/recalbox-romfs-amigacd32/Config.in
```kconfig
config BR2_PACKAGE_RECALBOX_ROMFS_AMIGACD32
	bool "recalbox-romfs-amigacd32"
	select BR2_PACKAGE_RECALBOX_ROMS
	depends on BR2_PACKAGE_AMIBERRY
	help
	  share_init/roms and xml for amigacd32
```

## package/recalbox-romfs/recalbox-romfs-amigacdtv/Config.in
```kconfig
config BR2_PACKAGE_RECALBOX_ROMFS_AMIGACDTV
	bool "recalbox-romfs-amigacdtv"
	select BR2_PACKAGE_RECALBOX_ROMS
	depends on BR2_PACKAGE_LIBRETRO_UAE \
	  || BR2_PACKAGE_AMIBERRY
	help
	  share_init/roms and xml for amigacdtv
```

## package/recalbox-romfs/recalbox-romfs-apple2gs/Config.in
```kconfig
config BR2_PACKAGE_RECALBOX_ROMFS_APPLE2GS
	bool "recalbox-romfs-apple2gs"
	select BR2_PACKAGE_RECALBOX_ROMS
	depends on BR2_PACKAGE_GSPLUS
	help
	  share_init/roms and xml for apple2gs
```

## package/recalbox-romfs/recalbox-romfs-atari5200/Config.in
```kconfig
config BR2_PACKAGE_RECALBOX_ROMFS_ATARI5200
	bool "recalbox-romfs-atari5200"
	select BR2_PACKAGE_RECALBOX_ROMS
	depends on BR2_PACKAGE_LIBRETRO_ATARI800
	help
	  share_init/roms and xml for atari5200
```

## package/recalbox-romfs/recalbox-romfs-atari800/Config.in
```kconfig
config BR2_PACKAGE_RECALBOX_ROMFS_ATARI800
	bool "recalbox-romfs-atari800"
	select BR2_PACKAGE_RECALBOX_ROMS
	depends on BR2_PACKAGE_LIBRETRO_ATARI800
	help
	  share_init/roms and xml for atari800
```

## package/recalbox-romfs/recalbox-romfs-bk/Config.in
```kconfig
config BR2_PACKAGE_RECALBOX_ROMFS_BK
	bool "recalbox-romfs-bk"
	select BR2_PACKAGE_RECALBOX_ROMS
	depends on BR2_PACKAGE_LIBRETRO_BK_EMULATOR
	help
	  share_init/roms and xml for bk
```

## package/recalbox-romfs/recalbox-romfs-c64/Config.in
```kconfig
config BR2_PACKAGE_RECALBOX_ROMFS_C64
	bool "recalbox-romfs-c64"
	select BR2_PACKAGE_RECALBOX_ROMS
	depends on BR2_PACKAGE_LIBRETRO_VICE
	help
	  share_init/roms and xml for c64
```

## package/recalbox-romfs/recalbox-romfs-cdi/Config.in
```kconfig
config BR2_PACKAGE_RECALBOX_ROMFS_CDI
	bool "recalbox-romfs-cdi"
	select BR2_PACKAGE_RECALBOX_ROMS
	depends on BR2_PACKAGE_LIBRETRO_MESS
	help
	  share_init/roms and xml for cdi
```

## package/recalbox-romfs/recalbox-romfs-channelf/Config.in
```kconfig
config BR2_PACKAGE_RECALBOX_ROMFS_CHANNELF
	bool "recalbox-romfs-channelf"
	select BR2_PACKAGE_RECALBOX_ROMS
	depends on BR2_PACKAGE_LIBRETRO_FREECHAF
	help
	  share_init/roms and xml for channelf
```

## package/recalbox-romfs/recalbox-romfs-daphne/Config.in
```kconfig
config BR2_PACKAGE_RECALBOX_ROMFS_DAPHNE
	bool "recalbox-romfs-daphne"
	select BR2_PACKAGE_RECALBOX_ROMS
	depends on BR2_PACKAGE_HYPSEUS
	help
	  share_init/roms and xml for daphne
```

## package/recalbox-romfs/recalbox-romfs-dinothawr/Config.in
```kconfig
config BR2_PACKAGE_RECALBOX_ROMFS_DINOTHAWR
	bool "recalbox-romfs-dinothawr"
	select BR2_PACKAGE_RECALBOX_ROMS
	depends on BR2_PACKAGE_LIBRETRO_DINOTHAWR
	help
	  share_init/roms and xml for dinothawr
```

## package/recalbox-romfs/recalbox-romfs-doom/Config.in
```kconfig
config BR2_PACKAGE_RECALBOX_ROMFS_DOOM
	bool "recalbox-romfs-doom"
	select BR2_PACKAGE_RECALBOX_ROMS
	depends on BR2_PACKAGE_LIBRETRO_PRBOOM
	help
	  share_init/roms and xml for doom
```

## package/recalbox-romfs/recalbox-romfs-doom1&2/Config.in
```kconfig
config BR2_PACKAGE_RECALBOX_ROMFS_DOOM1&2
	bool "recalbox-romfs-doom1&2"
	select BR2_PACKAGE_RECALBOX_ROMS
	depends on BR2_PACKAGE_LIBRETRO_PRBOOM
	help
	  share_init/roms and xml for doom1&2
```

## package/recalbox-romfs/recalbox-romfs-doom3/Config.in
```kconfig
config BR2_PACKAGE_RECALBOX_ROMFS_DOOM3
	bool "recalbox-romfs-doom3"
	select BR2_PACKAGE_RECALBOX_ROMS
	depends on BR2_PACKAGE_LIBRETRO_BOOM3
	help
	  share_init/roms and xml for doom3
```

## package/recalbox-romfs/recalbox-romfs-dragon/Config.in
```kconfig
config BR2_PACKAGE_RECALBOX_ROMFS_DRAGON
	bool "recalbox-romfs-dragon"
	select BR2_PACKAGE_RECALBOX_ROMS
	depends on BR2_PACKAGE_XROAR
	help
	  share_init/roms and configs for dragon
```

## package/recalbox-romfs/recalbox-romfs-dreamcast/Config.in
```kconfig
config BR2_PACKAGE_RECALBOX_ROMFS_DREAMCAST
	bool "recalbox-romfs-dreamcast"
	select BR2_PACKAGE_RECALBOX_ROMS
	depends on BR2_PACKAGE_LIBRETRO_FLYCAST \
	  || BR2_PACKAGE_REICAST \
	  || BR2_PACKAGE_REICAST_OLD
	help
	  share_init/roms and xml for dreamcast
```

## package/recalbox-romfs/recalbox-romfs-dungeoncrawlstonesoup/Config.in
```kconfig
config BR2_PACKAGE_RECALBOX_ROMFS_DUNGEONCRAWLSTONESOUP
	bool "recalbox-romfs-dungeoncrawlstonesoup"
	select BR2_PACKAGE_RECALBOX_ROMS
	depends on BR2_PACKAGE_LIBRETRO_CRAWL
	help
	  share_init/roms and xml for dungeoncrawlstonesoup
```

## package/recalbox-romfs/recalbox-romfs-easyrpg/Config.in
```kconfig
config BR2_PACKAGE_RECALBOX_ROMFS_EASYRPG
	bool "recalbox-romfs-easyrpg"
	select BR2_PACKAGE_RECALBOX_ROMS
	depends on BR2_PACKAGE_LIBRETRO_EASYRPG
	help
	  share_init/roms and xml for easyrpg
```

## package/recalbox-romfs/recalbox-romfs-fbneo/Config.in
```kconfig
config BR2_PACKAGE_RECALBOX_ROMFS_FBNEO
	bool "recalbox-romfs-fbneo"
	select BR2_PACKAGE_RECALBOX_ROMS
	depends on BR2_PACKAGE_LIBRETRO_FBNEO
	help
	  share_init/roms and xml for fbneo
```

## package/recalbox-romfs/recalbox-romfs-flashback/Config.in
```kconfig
config BR2_PACKAGE_RECALBOX_ROMFS_FLASHBACK
	bool "recalbox-romfs-flashback"
	select BR2_PACKAGE_RECALBOX_ROMS
	depends on BR2_PACKAGE_LIBRETRO_REMINISCENCE
	help
	  share_init/roms and xml for flashback
```

## package/recalbox-romfs/recalbox-romfs-gamegear/Config.in
```kconfig
config BR2_PACKAGE_RECALBOX_ROMFS_GAMEGEAR
	bool "recalbox-romfs-gamegear"
	select BR2_PACKAGE_RECALBOX_ROMS
	depends on BR2_PACKAGE_LIBRETRO_GENESISPLUSGX \
	  || BR2_PACKAGE_LIBRETRO_GEARSYSTEM \
	  || BR2_PACKAGE_LIBRETRO_FBNEO
	help
	  share_init/roms and xml for gamegear
```

## package/recalbox-romfs/recalbox-romfs-gb/Config.in
```kconfig
config BR2_PACKAGE_RECALBOX_ROMFS_GB
	bool "recalbox-romfs-gb"
	select BR2_PACKAGE_RECALBOX_ROMS
	depends on BR2_PACKAGE_LIBRETRO_GAMBATTE \
	  || BR2_PACKAGE_LIBRETRO_TGBDUAL \
	  || BR2_PACKAGE_LIBRETRO_MGBA \
	  || BR2_PACKAGE_LIBRETRO_SAMEBOY
	help
	  share_init/roms and xml for gb
```

## package/recalbox-romfs/recalbox-romfs-gx4000/Config.in
```kconfig
config BR2_PACKAGE_RECALBOX_ROMFS_GX4000
	bool "recalbox-romfs-gx4000"
	select BR2_PACKAGE_RECALBOX_ROMS
	depends on BR2_PACKAGE_LIBRETRO_CAP32
	help
	  share_init/roms and xml for gx4000
```

## package/recalbox-romfs/recalbox-romfs-intellivision/Config.in
```kconfig
config BR2_PACKAGE_RECALBOX_ROMFS_INTELLIVISION
	bool "recalbox-romfs-intellivision"
	select BR2_PACKAGE_RECALBOX_ROMS
	depends on BR2_PACKAGE_LIBRETRO_FREEINTV
	help
	  share_init/roms and xml for intellivision
```
