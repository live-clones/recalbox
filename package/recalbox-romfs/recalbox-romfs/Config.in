## package/residualvm/Config.in
```kconfig
config BR2_PACKAGE_RESIDUALVM
        bool "Residualvm"
	depends on BR2_INSTALL_LIBSTDCPP
	depends on BR2_PACKAGE_SDL2
	select BR2_PACKAGE_LIBMPEG2
	select BR2_PACKAGE_LIBOGG

        select BR2_PACKAGE_LIBVORBIS
        select BR2_PACKAGE_FLAC
        select BR2_PACKAGE_LIBMAD
        select BR2_PACKAGE_LIBPNG
        select BR2_PACKAGE_LIBTHEORA
        select BR2_PACKAGE_FAAD2
        select BR2_PACKAGE_FLUIDSYNTH
        select BR2_PACKAGE_FREETYPE

	select BR2_PACKAGE_ZLIB  

	select BR2_PACKAGE_RECALBOX_ROMFS_SCUMMVM

        help
		ResidualVM is a cross-platform 3D game interpreter which allows you to play LucasArts' Lua-based 3D adventures point and click 
		http://www.residualvm.org/

comment "ResidualVM needs a toolchain w/ C++,  SDL"
	depends on !BR2_INSTALL_LIBSTDCPP || !BR2_PACKAGE_SDL2
```

## package/retroarch-assets/Config.in
```kconfig
config BR2_PACKAGE_RETROARCH_ASSETS
	bool "retroarch-assets"
	depends on BR2_PACKAGE_RETROARCH

	help
	  RetroArch assets.
	  http://www.libretro.com
```

## package/rkwifibt/Config.in
```kconfig
config BR2_PACKAGE_RKWIFIBT
	bool "Rockchip rtk_hciattach"
	help
	  Tools for starting bluetooth on Rockchip device

	  https://github.com/Caesar-github/rkwifibt/tree/master/realtek/rtk_hciattach
```

## package/rockchip-kintaro-case/Config.in
```kconfig
config BR2_PACKAGE_ROCKCHIP_KINTARO_CASE
	bool "rockchip-kintaro-case"
	depends on BR2_PACKAGE_RECALBOX_TARGETGROUP_ROCKCHIP
	select BR2_PACKAGE_R64GPIO
	help
	  A Custom Python Script to Enable LED and Buttons on Kintaro Cases for Recalbox on the Rock64

comment "Enable Kintaro Case Buttons and LED for the Rock64/Rockpro64"
```

## package/rockchip-mali-bifrost-vulkan/Config.in
```kconfig
config BR2_PACKAGE_ROCKCHIP_MALI_BIFROST_VULKAN
	bool "Enable Bifrost Vulkan support"
	depends on BR2_PACKAGE_ROCKCHIP_MALI_BIFROST_GBM
	help
	  Add Vulkan support

if BR2_PACKAGE_ROCKCHIP_MALI_BIFROST_VULKAN

config BR2_PACKAGE_PROVIDES_LIBEGL
	default "rockchip-mali-bifrost-vulkan"

config BR2_PACKAGE_PROVIDES_LIBGLES
	default "rockchip-mali-bifrost-vulkan"

endif

comment "Mali Rockchip Bifrost Vulkan"
	depends on !BR2_arm && !BR2_aarch64
```

## package/rockchip-mali/Config.in
```kconfig
menuconfig BR2_PACKAGE_ROCKCHIP_MALI
	bool "Mali Rockchip"
	depends on BR2_arm || BR2_aarch64
	select BR2_PACKAGE_HAS_LIBEGL
	select BR2_PACKAGE_HAS_LIBGLES
	select BR2_PACKAGE_LIBDRM
	help
	  The Mali GPU library used in Rockchip Platform.
	  Supported GPU: bifrost, midgard, utgard.

if BR2_PACKAGE_ROCKCHIP_MALI

config BR2_PACKAGE_PROVIDES_LIBEGL
	default "rockchip-mali"

config BR2_PACKAGE_PROVIDES_LIBGLES
	default "rockchip-mali"

choice
	prompt "Platform/GPU"
config BR2_PACKAGE_ROCKCHIP_MALI_BIFROST
	bool "bifrost g31"
config BR2_PACKAGE_ROCKCHIP_MALI_MIDGARD
	bool "midgard t86x"
config BR2_PACKAGE_ROCKCHIP_MALI_UTGARD
	bool "utgard 450"
endchoice

if BR2_PACKAGE_ROCKCHIP_MALI_BIFROST
choice
	prompt "bifrost backend"
config BR2_PACKAGE_ROCKCHIP_MALI_BIFROST_GBM
	bool "gbm"
config BR2_PACKAGE_ROCKCHIP_MALI_BIFROST_WAYLAND
	bool "wayland"
config BR2_PACKAGE_ROCKCHIP_MALI_BIFROST_X11
	bool "x11"
endchoice
endif

if BR2_PACKAGE_ROCKCHIP_MALI_MIDGARD
choice
	prompt "midgard backend"
config BR2_PACKAGE_ROCKCHIP_MALI_MIDGARD_GBM
	bool "gbm"
config BR2_PACKAGE_ROCKCHIP_MALI_MIDGARD_WAYLAND
	bool "Wayland"
config BR2_PACKAGE_ROCKCHIP_MALI_MIDGARD_X11
	bool "X11"
endchoice
endif

if BR2_PACKAGE_ROCKCHIP_MALI_UTGARD
choice
	prompt "utgard backend"
config BR2_PACKAGE_ROCKCHIP_MALI_UTGARD_GBM
	bool "gbm"
config BR2_PACKAGE_ROCKCHIP_MALI_UTGARD_WAYLAND
	bool "Wayland"
config BR2_PACKAGE_ROCKCHIP_MALI_UTGARD_X11
	bool "X11"
endchoice
endif

config BR2_PACKAGE_ROCKCHIP_MALI_BIFROST_VULKAN
	bool "Enable Bifrost Vulkan Support"
	depends on BR2_PACKAGE_ROCKCHIP_MALI_BIFROST_GBM
	help
	  Add Vulkan support

endif

comment "Mali Rockchip"
	depends on !BR2_arm && !BR2_aarch64
```

## package/rockchip-mpp/Config.in
```kconfig
config BR2_PACKAGE_ROCKCHIP_MPP
	bool "rockchip-mpp"
	help
	  Media Process Platform (MPP) module

	  https://github.com/rockchip-linux/mpp
```

## package/rockchip-rkbin/Config.in
```kconfig
config BR2_PACKAGE_ROCKCHIP_RKBIN
	bool "Rockchip blobs"
	help
	  Firmware and Tool Binarys

	  https://github.com/rockchip-linux/rkbin
```

## package/rockchip-rkbin/Config.in.host
```kconfig
config BR2_PACKAGE_HOST_ROCKCHIP_RKBIN
	bool "Rockchip rkbin blobs"
	help
	  Firmware and Tool Binarys from Rockchip

	  https://github.com/rockchip-linux/rkbin
```

## package/rpi-dpidac/Config.in
```kconfig
config BR2_PACKAGE_RPI_DPIDAC
	bool "RPI DPI DAC Bridge support"
	depends on BR2_LINUX_KERNEL
	select DRM_KMS_HELPER
	help
	  Support for Raspberry Pi DPI to Analogue bridges like the
	  VGA666, Pi2SCART, Pi2JAMMA, RGB-Pi, RPI2SCART.

comment "rpi-dpidac needs a kernel and headers"
	depends on !BR2_LINUX_KERNEL
```
