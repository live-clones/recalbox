## package/recalbox-romfs/recalbox-romfs/Config.in
```kconfig
config BR2_PACKAGE_RECALBOX_ROMFS
	bool "recalbox-romfs"
	default y
	depends on 	  BR2_PACKAGE_RECALBOX_ROMFS_AMIGACD32 \
	  || BR2_PACKAGE_RECALBOX_ROMFS_THEPOWDERTOY \
	  || BR2_PACKAGE_RECALBOX_ROMFS_UZEBOX

	help
	  This super package will create the share_init/roms structure
	  as well as the es_systems.cfg depending on emulators
```

## package/recalbox-romfs2/Config.in
```kconfig
config BR2_PACKAGE_RECALBOX_ROMFS2
	bool "recalbox romfs 2"
	select BR2_PACKAGE_HOST_PYTHON3
	help
	  A new system descriptor generator using python3.

	  https://github.com/recalbox/recalbox-os
```

## package/recalbox-syslinux-efi/Config.in
```kconfig
config BR2_PACKAGE_RECALBOX_SYSLINUX_EFI
	bool "recalbox-syslinux-efi"
	help
	  Precompiled syslinux EFI binaries from Archlinux
	  https://www.archlinux.org/packages/core/x86_64/syslinux/
```

## package/recalbox-system/Config.in
```kconfig
config BR2_PACKAGE_RECALBOX_SYSTEM
	bool "Recalbox System"
	select BR2_PACKAGE_LBA_FINDER
	select BR2_PACKAGE_AVAHI_DAEMON
	select BR2_PACKAGE_USB_MODESWITCH_DATA
	select BR2_PACKAGE_AVAHI
	select BR2_PACKAGE_RECALBOX_BLUETOOTH
	select BR2_PACKAGE_RECALBOX_WIFI
	select BR2_PACKAGE_BRCM_BT_FIRMWARE
	select BR2_PACKAGE_SAMBA4
	help
	  Install the recalbox system files

choice
	prompt "Recalbox target"
	default BR2_PACKAGE_RECALBOX_TARGET_RPI4
	help
	  Select Recalbox target hardware

config BR2_PACKAGE_RECALBOX_TARGET_RPI0
	bool "rpi0"
	select BR2_PACKAGE_RPI_FIRMWARE

config BR2_PACKAGE_RECALBOX_TARGET_RPI1
	bool "rpi1"
	select BR2_PACKAGE_RPI_FIRMWARE
	select BR2_PACKAGE_RPI_USERLAND

config BR2_PACKAGE_RECALBOX_TARGET_RPIZERO2LEGACY
	bool "rpizero2legacy"
	select BR2_PACKAGE_RPI_FIRMWARE
	select BR2_PACKAGE_RPI_USERLAND

config BR2_PACKAGE_RECALBOX_TARGET_RPI3
	bool "rpi3"
	select BR2_PACKAGE_RPI_FIRMWARE
	select BR2_PACKAGE_MESA3D
	select BR2_PACKAGE_MESA3D_GALLIUM_DRIVER_KMSRO
	select BR2_PACKAGE_MESA3D_GALLIUM_DRIVER_V3D
	select BR2_PACKAGE_MESA3D_GALLIUM_DRIVER_VC4
	select BR2_PACKAGE_MESA3D_OPENGL_ES
	select BR2_PACKAGE_SDL2_KMSDRM
	select BR2_PACKAGE_RECALBOX_CRT
	select BR2_PACKAGE_RPI_DTOVERLAY

config BR2_PACKAGE_RECALBOX_TARGET_RPIZERO2
	bool "rpizero2"
	select BR2_PACKAGE_RPI_FIRMWARE
	select BR2_PACKAGE_MESA3D
	select BR2_PACKAGE_MESA3D_GALLIUM_DRIVER_KMSRO
	select BR2_PACKAGE_MESA3D_GALLIUM_DRIVER_V3D
	select BR2_PACKAGE_MESA3D_GALLIUM_DRIVER_VC4
	select BR2_PACKAGE_MESA3D_OPENGL_ES
	select BR2_PACKAGE_SDL2_KMSDRM
	select BR2_PACKAGE_RECALBOX_CRT
	select BR2_PACKAGE_RPI_DTOVERLAY

config BR2_PACKAGE_RECALBOX_TARGET_RPI4_64
	bool "rpi4_64"
	select BR2_PACKAGE_RPI_FIRMWARE
	select BR2_PACKAGE_RPI_FIRMWARE_VARIANT_PI4
	select BR2_PACKAGE_MESA3D
	select BR2_PACKAGE_MESA3D_GALLIUM_DRIVER_KMSRO
	select BR2_PACKAGE_MESA3D_GALLIUM_DRIVER_V3D
	select BR2_PACKAGE_MESA3D_GALLIUM_DRIVER_VC4
	select BR2_PACKAGE_MESA3D_OPENGL_ES
	select BR2_PACKAGE_SDL2_KMSDRM
	select BR2_PACKAGE_RECALBOX_CRT
	select BR2_PACKAGE_EEPROMUTILS

config BR2_PACKAGE_RECALBOX_TARGET_RPI4
	bool "rpi4"
	select BR2_PACKAGE_RPI_FIRMWARE
	select BR2_PACKAGE_RPI_FIRMWARE_VARIANT_PI4
	select BR2_PACKAGE_MESA3D
	select BR2_PACKAGE_MESA3D_GALLIUM_DRIVER_KMSRO
	select BR2_PACKAGE_MESA3D_GALLIUM_DRIVER_V3D
	select BR2_PACKAGE_MESA3D_GALLIUM_DRIVER_VC4
	select BR2_PACKAGE_MESA3D_OPENGL_ES
	select BR2_PACKAGE_SDL2_KMSDRM
	select BR2_PACKAGE_RECALBOX_CRT
	select BR2_PACKAGE_EEPROMUTILS

config BR2_PACKAGE_RECALBOX_TARGET_ODROIDXU4
	bool "odroidxu4"
	select BR2_PACKAGE_HOST_UBOOT_TOOLS

config BR2_PACKAGE_RECALBOX_TARGET_ODROIDGO2
	bool "odroidgo2"
	select BR2_PACKAGE_PM_UTILS
	select BR2_PACKAGE_ROCKCHIP_MPP
	select BR2_PACKAGE_HOST_UBOOT_TOOLS
	select BR2_PACKAGE_RECALBOX_ROCKCHIP_MALI

config BR2_PACKAGE_RECALBOX_TARGET_RG353X
	bool "Anbernic RG353x family"
	select BR2_PACKAGE_RECALBOX_ROCKCHIP_MALI
	select BR2_PACKAGE_UBOOT_RG353X
	select BR2_PACKAGE_GPTFDISK
	select BR2_PACKAGE_GPTFDISK_SGDISK

config BR2_PACKAGE_RECALBOX_TARGET_X86
	bool "x86"

config BR2_PACKAGE_RECALBOX_TARGET_X86_64
	bool "x86_64"

endchoice

# configure features
config BR2_PACKAGE_RECALBOX_HAS_LIBGLES
	bool
	default y if \
	  BR2_PACKAGE_RECALBOX_TARGET_RPI1 ||\
	  BR2_PACKAGE_RECALBOX_TARGET_RPIZERO2 ||\
	  BR2_PACKAGE_RECALBOX_TARGET_RPIZERO2LEGACY ||\
	  BR2_PACKAGE_RECALBOX_TARGET_RPI3 ||\
	  BR2_PACKAGE_RECALBOX_TARGET_RPI4 ||\
	  BR2_PACKAGE_RECALBOX_TARGET_RPI4_64 ||\
	  BR2_PACKAGE_RECALBOX_TARGET_ODROIDXU4 ||\
	  BR2_PACKAGE_RECALBOX_TARGET_ODROIDGO2 ||\
	  BR2_PACKAGE_RECALBOX_TARGET_RG353X

config BR2_PACKAGE_RECALBOX_HAS_LIBGLES3
	bool
	default y if \
	  BR2_PACKAGE_RECALBOX_TARGET_RPIZERO2 ||\
	  BR2_PACKAGE_RECALBOX_TARGET_RPI3 ||\
	  BR2_PACKAGE_RECALBOX_TARGET_RPI4 ||\
	  BR2_PACKAGE_RECALBOX_TARGET_RPI4_64 ||\
	  BR2_PACKAGE_RECALBOX_TARGET_ODROIDXU4 ||\
	  BR2_PACKAGE_RECALBOX_TARGET_ODROIDGO2 ||\
	  BR2_PACKAGE_RECALBOX_TARGET_RG353X

config BR2_PACKAGE_RECALBOX_HAS_KMS
	bool
	default y if \
	  BR2_PACKAGE_RECALBOX_TARGET_RPIZERO2 ||\
	  BR2_PACKAGE_RECALBOX_TARGET_RPI3 ||\
	  BR2_PACKAGE_RECALBOX_TARGET_RPI4 ||\
	  BR2_PACKAGE_RECALBOX_TARGET_RPI4_64 ||\
	  BR2_PACKAGE_RECALBOX_TARGET_ODROIDXU4 ||\
	  BR2_PACKAGE_RECALBOX_TARGET_ODROIDGO2 ||\
	  BR2_PACKAGE_RECALBOX_TARGET_RG353X

config BR2_PACKAGE_RECALBOX_EGL_NO_X11
	bool
	default y if \
	  BR2_PACKAGE_RECALBOX_TARGET_RPI1 ||\
	  BR2_PACKAGE_RECALBOX_TARGET_RPIZERO2 ||\
	  BR2_PACKAGE_RECALBOX_TARGET_RPIZERO2LEGACY ||\
	  BR2_PACKAGE_RECALBOX_TARGET_RPI3 ||\
	  BR2_PACKAGE_RECALBOX_TARGET_RPI4 ||\
	  BR2_PACKAGE_RECALBOX_TARGET_RPI4_64 ||\
	  BR2_PACKAGE_RECALBOX_TARGET_ODROIDXU4 ||\
	  BR2_PACKAGE_RECALBOX_TARGET_ODROIDGO2 ||\
	  BR2_PACKAGE_RECALBOX_TARGET_RG353X

# shader slang (used by retroarch)
config BR2_PACKAGE_RECALBOX_HAS_SLANG
	bool
	default y if \
	  BR2_PACKAGE_RECALBOX_TARGET_RPI4_64 ||\
	  BR2_PACKAGE_RECALBOX_TARGET_ODROIDGO2
```

## package/recalbox-tft-assets/Config.in
```kconfig
config BR2_PACKAGE_RECALBOX_TFT_ASSETS
	bool "Recalbox TFT assets"
	help
	  Install the recalbox tft assets
```

## package/recalbox-themes/Config.in
```kconfig
config BR2_PACKAGE_RECALBOX_THEMES
	bool "recalbox ES themes"
	help
	  Emulationstation themes for recalbox.

	  https://gitlab.com/recalbox/recalbox-themes
```

## package/recalbox-videomode/Config.in
```kconfig
config BR2_PACKAGE_RECALBOX_VIDEOMODE
	bool "recalbox videomode"
	depends on BR2_INSTALL_LIBSTDCPP
	select BR2_PACKAGE_SDL2
	help
	  A simple resolution list utility

	  https://github.com/recalbox/recalbox

comment "videomode needs a toolchain w/ C++ and SDL2"
	depends on !BR2_INSTALL_LIBSTDCPP || !BR2_PACKAGE_SDL2
```

## package/recalbox-volumed/Config.in
```kconfig
config BR2_PACKAGE_RECALBOX_VOLUMED
	bool "recalbox-volumed"
	depends on BR2_PACKAGE_PULSEAUDIO
	help
	  Volume control from the wheel

comment "xpi_gamecon_rpi needs PulseAudio"
	depends on !BR2_PACKAGE_PULSEAUDIO
```

## package/recalbox-wifi/Config.in
```kconfig
config BR2_PACKAGE_RECALBOX_WIFI
	bool "recalbox wifi"
	select BR2_PACKAGE_WPA_SUPPLICANT
	select BR2_PACKAGE_WPA_SUPPLICANT_CLI
	select BR2_PACKAGE_WPA_SUPPLICANT_DBUS
	help
	  The wifi utilities for recalbox
```

## package/recalbox-wpaf/Config.in
```kconfig
config BR2_PACKAGE_RECALBOX_WPAF
	bool "recalbox-wpaf"
	select BR2_PACKAGE_BCM2835
	help
	  Recalbox Fan controller
```

## package/recalbox-x86_64_efi/Config.in
```kconfig
config BR2_PACKAGE_RECALBOX_X86_64_EFI
	bool "recalbox-x86_64_efi"
	help
	  EFI 64 grub blob
```

## package/recalbox/Config.in
```kconfig
menu "Recalbox"
	source "package/recalbox/recalbox-system/Config.in"
	source "package/recalbox/recalbox-themes/Config.in"
	source "package/recalbox/recalbox-configgen/Config.in"
	source "package/recalbox/recalbox-romfs/Config.in"
	source "package/recalbox/moonlight-embedded/Config.in"
	source "package/recalbox/recalbox-manager/Config.in"
	source "package/recalbox/recalbox-manager2/Config.in"
	source "package/recalbox/recalbox-api/Config.in"
	source "package/recalbox/recalbox-initramfs/Config.in"
	source "package/recalbox/recalbox-x86_64_efi/Config.in"
	source "package/recalbox/rgb-pi/Config.in"
	source "package/recalbox/tft-waveshare/Config.in"
	source "package/recalbox/pwm-audio-pi-zero/Config.in"
	source "package/recalbox/freeimage/Config.in"
	source "package/recalbox/mali-450/Config.in"
	source "package/recalbox/mali-t62x/Config.in"
	source "package/recalbox/mali-opengles-sdk/Config.in"
	source "package/recalbox/sdl2_mixer/Config.in"
	source "package/recalbox/fluidsynth/Config.in"	
	source "package/recalbox/sfml/Config.in"
	source "package/recalbox/evwait/Config.in"
	source "package/recalbox/python-autobreadcrumbs/Config.in"
	source "package/recalbox/python-rpigpio/Config.in"
	source "package/recalbox/python-libusb1/Config.in"	
	source "package/recalbox/libenet/Config.in"
menu "Emulationstation"
        source "package/recalbox/recalbox-emulationstation2/Config.in"
        source "package/recalbox/emulation-station/Config.in"
        source "package/recalbox/python-es-scraper/Config.in"
endmenu
menu "Controllers"
	source "package/recalbox/qtsixa/Config.in"
	source "package/recalbox/qtsixa-shanwan/Config.in"
	source "package/recalbox/mk_arcade_joystick_rpi/Config.in"
	source "package/recalbox/db9_gpio_rpi/Config.in"
	source "package/recalbox/gamecon_gpio_rpi/Config.in"
	source "package/recalbox/xboxdrv/Config.in"
	source "package/recalbox/xarcade2jstick/Config.in"
	source "package/recalbox/recalbox-retrogame/Config.in"
	source "package/recalbox/virtualgamepads/Config.in"
	source "package/recalbox/steamcontroller/Config.in"
endmenu
menu "Emulators"
	source "package/recalbox/ppsspp/Config.in"
	source "package/recalbox/linapple-pie/Config.in"
	source "package/recalbox/mupen64plus-core/Config.in"
	source "package/recalbox/mupen64plus-uiconsole/Config.in"
	source "package/recalbox/mupen64plus-gles2/Config.in"
	source "package/recalbox/mupen64plus-gles2rice/Config.in"
	source "package/recalbox/mupen64plus-video-glide64mk2/Config.in"
	source "package/recalbox/mupen64plus-omx/Config.in"
	source "package/recalbox/mupen64plus-input-sdl/Config.in"
	source "package/recalbox/mupen64plus-audio-sdl/Config.in"
	source "package/recalbox/mupen64plus-rsphle/Config.in"
	source "package/recalbox/mupen64plus-rice/Config.in"
	source "package/recalbox/mupen64plus-gliden64/Config.in"
	source "package/recalbox/advancemame/Config.in"
        source "package/recalbox/gpsp/Config.in"
        source "package/recalbox/pifba/Config.in"
        source "package/recalbox/retroarch/Config.in"
        source "package/recalbox/scummvm/Config.in"
        source "package/recalbox/scummvm-vanfanel/Config.in"
        source "package/recalbox/dosbox/Config.in"
        source "package/recalbox/vice/Config.in"
        source "package/recalbox/reicast/Config.in"
        source "package/recalbox/dolphin-emu/Config.in"

if BR2_PACKAGE_RETROARCH
menu "Libretro Cores"
       source "package/recalbox/libretro-armsnes/Config.in"
       source "package/recalbox/libretro-pocketsnes/Config.in"
       source "package/recalbox/libretro-catsfc/Config.in"
       source "package/recalbox/libretro-beetle-vb/Config.in"
       source "package/recalbox/libretro-snes9x-next/Config.in"
       source "package/recalbox/libretro-picodrive/Config.in"
       source "package/recalbox/libretro-genesisplusgx/Config.in"
       source "package/recalbox/libretro-gambatte/Config.in"
       source "package/recalbox/libretro-stella/Config.in"
       source "package/recalbox/libretro-pcsx/Config.in"
       source "package/recalbox/libretro-fceumm/Config.in"
       source "package/recalbox/libretro-fceunext/Config.in"
       source "package/recalbox/libretro-nestopia/Config.in"
       source "package/recalbox/libretro-imame/Config.in"
       source "package/recalbox/libretro-scummvm/Config.in"
       source "package/recalbox/libretro-beetle-pce/Config.in"
       source "package/recalbox/libretro-beetle-pcfx/Config.in"
       source "package/recalbox/libretro-meteor/Config.in"
       source "package/recalbox/libretro-virtualjaguar/Config.in"
       source "package/recalbox/libretro-fmsx/Config.in"
       source "package/recalbox/libretro-bluemsx/Config.in"
       source "package/recalbox/libretro-gpsp/Config.in"
       source "package/recalbox/libretro-4do/Config.in"
       source "package/recalbox/libretro-fba/Config.in"
       source "package/recalbox/libretro-gw/Config.in"
       source "package/recalbox/libretro-prboom/Config.in"
       source "package/recalbox/libretro-beetle-ngp/Config.in"
       source "package/recalbox/libretro-vecx/Config.in"
       source "package/recalbox/libretro-beetle-lynx/Config.in"
       source "package/recalbox/libretro-lutro/Config.in"
       source "package/recalbox/libretro-beetle-wswan/Config.in"
       source "package/recalbox/libretro-uae/Config.in"
       source "package/recalbox/libretro-mupen64/Config.in"
       source "package/recalbox/libretro-beetle-supergrafx/Config.in"
       source "package/recalbox/libretro-nxengine/Config.in"
       source "package/recalbox/libretro-prosystem/Config.in"
       source "package/recalbox/libretro-tgbdual/Config.in"
       source "package/recalbox/libretro-mgba/Config.in"
       source "package/recalbox/libretro-mame2003/Config.in"
       source "package/recalbox/libretro-fuse/Config.in"
       source "package/recalbox/libretro-cap32/Config.in"
       source "package/recalbox/libretro-81/Config.in"
       source "package/recalbox/libretro-imageviewer/Config.in"
       source "package/recalbox/libretro-o2em/Config.in"
       source "package/recalbox/libretro-hatari/Config.in"
       source "package/recalbox/libretro-quicknes/Config.in"
       source "package/recalbox/libretro-glupen64/Config.in"
       source "package/recalbox/libretro-snes9x/Config.in"
endmenu
endif
menu "Doom packages"
	source "package/recalbox/prboom/Config.in"
	source "package/recalbox/doom-wad/Config.in"
endmenu
endmenu
menu "Kodi addons"
	source "package/recalbox/kodi-plugin-video-youtube/Config.in"
	source "package/recalbox/kodi-script.module.t0mm0.common/Config.in"
menu "Languages"
	source "package/recalbox/kodi-resource-language-fr_fr/Config.in"
	source "package/recalbox/kodi-resource-language-de_de/Config.in"
	source "package/recalbox/kodi-resource-language-es_es/Config.in"
	source "package/recalbox/kodi-resource-language-eu_es/Config.in"
	source "package/recalbox/kodi-resource-language-it_it/Config.in"
	source "package/recalbox/kodi-resource-language-pt_br/Config.in"
	source "package/recalbox/kodi-resource-language-sv_se/Config.in"
	source "package/recalbox/kodi-resource-language-tr_tr/Config.in"
	source "package/recalbox/kodi-resource-language-zh_cn/Config.in"
endmenu
endmenu
menu "Utils"
        source "package/recalbox/raspi2png/Config.in"
        source "package/recalbox/megatools/Config.in"
        source "package/recalbox/jstest2/Config.in"
        source "package/recalbox/libcapsimage/Config.in"
endmenu
menu "Small TFT Screen"
        source "package/recalbox/rpi-fbcp/Config.in"
endmenu
endmenu
```

## package/recalbox/evwait/Config.in
```kconfig
config BR2_PACKAGE_EVWAIT
	bool "evwait"
	help
	  evwait wait for a specific evdev kernel event

	  https://github.com/nadenislamarre/evwait
```

## package/reicast-new/Config.in
```kconfig
config BR2_PACKAGE_REICAST_NEW
	bool "reicast-new"
	depends on BR2_PACKAGE_SDL2
	depends on BR2_PACKAGE_LIBPNG
	select BR2_PACKAGE_RECALBOX_ROMFS_DREAMCAST
	help
	  A  Dreamcast emulator (new version)
```

## package/reicast-old/Config.in
```kconfig
config BR2_PACKAGE_REICAST_OLD
	bool "reicast-old"
	depends on BR2_PACKAGE_SDL2
	depends on BR2_PACKAGE_LIBPNG
	help
	  A  Dreamcast emulator (old version)
```
