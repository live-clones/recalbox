## package/libretro-dhewm3/Config.in
```kconfig
config BR2_PACKAGE_LIBRETRO_DHEWM3
	bool "libretro-dhewm3"
	depends on BR2_PACKAGE_RETROARCH
	depends on BR2_INSTALL_LIBSTDCPP
	select BR2_PACKAGE_RECALBOX_ROMFS_DOOM
	help
	  A libretro Doom 3 core.

	  http://www.libretro.com

comment "LIBRETRO_DHEWM3 needs a toolchain w/ C++"
	depends on !BR2_INSTALL_LIBSTDCPP
```

## package/libretro-dinothawr/Config.in
```kconfig
config BR2_PACKAGE_LIBRETRO_DINOTHAWR
	bool "libretro-dinothawr"
	depends on BR2_PACKAGE_RETROARCH
	depends on BR2_INSTALL_LIBSTDCPP
	depends on BR2_PACKAGE_RECALBOX_ROMFS2
	help
	  A libretro block pushing puzzle game.

	  http://www.libretro.com

comment "LIBRETRO_DINOTHAWR needs a toolchain w/ C++"
	depends on !BR2_INSTALL_LIBSTDCPP
```

## package/libretro-dirksimple/Config.in
```kconfig
config BR2_PACKAGE_LIBRETRO_DIRKSIMPLE
	bool "libretro-dirksimple"
	depends on BR2_PACKAGE_RETROARCH
	depends on BR2_INSTALL_LIBSTDCPP
	select BR2_PACKAGE_LIBMPEG2
	select BR2_PACKAGE_LIBOGG
	select BR2_PACKAGE_LIBVORBIS
	select BR2_PACKAGE_SDL2
	select BR2_PACKAGE_ZLIB
	help
	  A libretro Daphné emulator core.

	  http://www.libretro.com

comment "LIBRETRO_DIRKSIMPLE needs a toolchain w/ C++"
	depends on !BR2_INSTALL_LIBSTDCPP
```

## package/libretro-dosbox-core/Config.in
```kconfig
config BR2_PACKAGE_LIBRETRO_DOSBOX_CORE
	bool "libretro-dosbox-core"
	depends on BR2_PACKAGE_RETROARCH
	depends on BR2_INSTALL_LIBSTDCPP
	select BR2_PACKAGE_RECALBOX_ROMFS_DOS
	help
	  A libretro dosbox-core emulator.

	  http://www.libretro.com

comment "LIBRETRO_DOSBOX_CORE needs a toolchain w/ C++"
	depends on !BR2_INSTALL_LIBSTDCPP
```

## package/libretro-duckstation/Config.in
```kconfig
config BR2_PACKAGE_LIBRETRO_DUCKSTATION
	bool "libretro-duckstation"
	depends on BR2_PACKAGE_RETROARCH
	depends on BR2_INSTALL_LIBSTDCPP
	select BR2_PACKAGE_RECALBOX_ROMFS_PSX
	help
	  A libretro psx emulation core.

	  https://github.com/stenzek/duckstation

comment "LIBRETRO_DUCKSTATION needs a toolchain w/ C++"
	depends on !BR2_INSTALL_LIBSTDCPP
```

## package/libretro-easyrpg/Config.in
```kconfig
config BR2_PACKAGE_LIBRETRO_EASYRPG
	bool "libretro-easyrpg"
	depends on BR2_PACKAGE_RETROARCH
	depends on BR2_INSTALL_LIBSTDCPP
	select BR2_PACKAGE_LIBLCF
	select BR2_PACKAGE_PIXMAN
	select BR2_PACKAGE_LIBPNG
	select BR2_PACKAGE_ZLIB
	select BR2_PACKAGE_FMT
	select BR2_PACKAGE_FREETYPE
	select BR2_PACKAGE_MPG123
	select BR2_PACKAGE_WILDMIDI
	select BR2_PACKAGE_LIBVORBIS
	select BR2_PACKAGE_LIBOGG
	select BR2_PACKAGE_OPUSFILE
	select BR2_PACKAGE_FLUIDSYNTH_LIBSNDFILE
	select BR2_PACKAGE_LIBXMP_LITE
	select BR2_PACKAGE_SPEEXDSP
	help
	  A libretro EasyRPG game engine.

	  https://github.com/EasyRPG/Player

comment "LIBRETRO_EASYRPG needs a toolchain w/ C++"
	depends on !BR2_INSTALL_LIBSTDCPP
```

## package/libretro-fbalpha/Config.in
```kconfig
config BR2_PACKAGE_LIBRETRO_FBALPHA
        bool "libretro-fbalpha"
	depends on BR2_PACKAGE_RETROARCH
	depends on BR2_INSTALL_LIBSTDCPP
	select BR2_PACKAGE_RECALBOX_ROMFS_FBA_LIBRETRO
	select BR2_PACKAGE_RECALBOX_ROMFS_NEOGEO
	select BR2_PACKAGE_RECALBOX_ROMFS_NEOGEOCD
        help
          A libretro fbalpha emulator core for ARM.

	  http://www.libretro.com

comment "LIBRETRO_FBALPHA needs a toolchain w/ C++"
	depends on !BR2_INSTALL_LIBSTDCPP
```

## package/libretro-fbneo/Config.in
```kconfig
config BR2_PACKAGE_LIBRETRO_FBNEO
	bool "libretro-fbneo"
	depends on BR2_PACKAGE_RETROARCH
	depends on BR2_INSTALL_LIBSTDCPP
	select BR2_PACKAGE_RECALBOX_ROMFS_FBNEO
	select BR2_PACKAGE_RECALBOX_ROMFS_NEOGEO
	select BR2_PACKAGE_RECALBOX_ROMFS_NEOGEOCD
	help
	  A libretro fbneo emulator core for ARM.

	  http://www.libretro.com

comment "LIBRETRO_FBNEO needs a toolchain w/ C++"
	depends on !BR2_INSTALL_LIBSTDCPP
```

## package/libretro-flycast/Config.in
```kconfig
config BR2_PACKAGE_LIBRETRO_FLYCAST
	bool "libretro-flycast"
	depends on BR2_PACKAGE_RETROARCH
	depends on BR2_INSTALL_LIBSTDCPP
	depends on BR2_GCC_ENABLE_OPENMP
	select BR2_PACKAGE_RECALBOX_ROMFS_ATOMISWAVE
	select BR2_PACKAGE_RECALBOX_ROMFS_DREAMCAST
	select BR2_PACKAGE_RECALBOX_ROMFS_NAOMI
	help
	  A libretro atomiswave, dreamcast and naomi core.

	  http://www.libretro.com

comment "LIBRETRO_FLYCAST needs a toolchain w/ C++"
	depends on !BR2_INSTALL_LIBSTDCPP
```

## package/libretro-freechaf/Config.in
```kconfig
config BR2_PACKAGE_LIBRETRO_FREECHAF
	bool "libretro-freechaf"
	depends on BR2_PACKAGE_RETROARCH
	depends on BR2_INSTALL_LIBSTDCPP
	help
	  A libretro Fairchild Channel F emulator core.

	  http://www.libretro.com

comment "LIBRETRO_FREECHAF needs a toolchain w/ C++"
	depends on !BR2_INSTALL_LIBSTDCPP
```

## package/libretro-gearcoleco/Config.in
```kconfig
config BR2_PACKAGE_LIBRETRO_GEARCOLECO
	bool "libretro-gearcoleco"
	depends on BR2_PACKAGE_RETROARCH
	depends on BR2_INSTALL_LIBSTDCPP
	help
	  An accurate ColecoVision emulator.

	  http://www.libretro.com

comment "LIBRETRO_VECX needs a toolchain w/ C++"
	depends on !BR2_INSTALL_LIBSTDCPP
```

## package/libretro-gearsystem/Config.in
```kconfig
config BR2_PACKAGE_LIBRETRO_GEARSYSTEM
	bool "libretro-gearsystem"
	depends on BR2_PACKAGE_RETROARCH
	depends on BR2_INSTALL_LIBSTDCPP
	help
	  A libretro SEGA 8 bits emulator core for ARM.

	  http://www.libretro.com

comment "LIBRETRO_GEARSYSTEM needs a toolchain w/ C++"
	depends on !BR2_INSTALL_LIBSTDCPP
```

## package/libretro-genesisplusgxwide/Config.in
```kconfig
config BR2_PACKAGE_LIBRETRO_GENESISPLUSGXWIDE
	bool "libretro-genesisplusgxwide"
	depends on BR2_PACKAGE_RETROARCH
	depends on BR2_INSTALL_LIBSTDCPP
	help
	  A libretro SEGA 8 / 16 bits emulator core for ARM,
	  with wide screen support

	  https://github.com/libretro/Genesis-Plus-GX-Wide

comment "LIBRETRO_GENESISPLUSGXWIDE needs a toolchain w/ C++"
	depends on !BR2_INSTALL_LIBSTDCPP
```

## package/libretro-gong/Config.in
```kconfig
config BR2_PACKAGE_LIBRETRO_GONG
	bool "libretro-gong"
	depends on BR2_PACKAGE_RETROARCH
	depends on BR2_INSTALL_LIBSTDCPP
	help
	  A libretro gong is a port of pong

	  https://github.com/libretro/gong

comment "LIBRETRO_GONG needs a toolchain w/ C++"
	depends on !BR2_INSTALL_LIBSTDCPP
```

## package/libretro-handy/Config.in
```kconfig
config BR2_PACKAGE_LIBRETRO_HANDY
	bool "libretro-handy"
	depends on BR2_PACKAGE_RETROARCH
	depends on BR2_INSTALL_LIBSTDCPP
	select BR2_PACKAGE_RECALBOX_ROMFS_LYNX
	help
	  A libretro Lynx emulator core for ARM.

	  http://www.libretro.com

comment "LIBRETRO_HANDY needs a toolchain w/ C++"
	depends on !BR2_INSTALL_LIBSTDCPP
```

## package/libretro-lowres-nx/Config.in
```kconfig
config BR2_PACKAGE_LIBRETRO_LOWRES_NX
	bool "libretro-lowres-nx"
	depends on BR2_PACKAGE_RETROARCH
	depends on BR2_INSTALL_LIBSTDCPP
	select BR2_PACKAGE_RECALBOX_ROMFS_LOWRESNX
	help
	  A libretro Virtual Game Console LowRes-NX emulator core.

	  https://github.com/timoinutilis/lowres-nx

comment "LIBRETRO_LOWRES_NX needs a toolchain w/ C++"
	depends on !BR2_INSTALL_LIBSTDCPP
```

## package/libretro-mame/Config.in
```kconfig
config BR2_PACKAGE_LIBRETRO_MAME
	bool "libretro-mame"
	depends on BR2_PACKAGE_RETROARCH
	depends on BR2_INSTALL_LIBSTDCPP
	select BR2_PACKAGE_ZLIB
	help
	  A libretro mame core for x86_64 - Based on MAME 0.216.

	  http://www.libretro.com

comment "LIBRETRO_MAME needs a toolchain w/ C++"
	depends on !BR2_INSTALL_LIBSTDCPP
```

## package/libretro-mame2000/Config.in
```kconfig
config BR2_PACKAGE_LIBRETRO_MAME2000
        bool "libretro-mame2000"
	depends on BR2_PACKAGE_RETROARCH
	depends on BR2_INSTALL_LIBSTDCPP
	select BR2_PACKAGE_RECALBOX_ROMFS_MAME
	select BR2_PACKAGE_RECALBOX_ROMFS_NEOGEO
        help
          A libretro imame4all core for ARM.

	  http://www.libretro.com

comment "LIBRETRO_MAME2000 needs a toolchain w/ C++"
	depends on !BR2_INSTALL_LIBSTDCPP
```

## package/libretro-mame2015/Config.in
```kconfig
config BR2_PACKAGE_LIBRETRO_MAME2015
	bool "libretro-mame2015"
	depends on BR2_PACKAGE_RETROARCH
	depends on BR2_INSTALL_LIBSTDCPP
	select BR2_PACKAGE_ZLIB
	help
	  A libretro mame2015 core for ARM - Based on MAME 0.139.

	  http://www.libretro.com

comment "LIBRETRO_MAME2015 needs a toolchain w/ C++"
	depends on !BR2_INSTALL_LIBSTDCPP
```

## package/libretro-mame2016/Config.in
```kconfig
config BR2_PACKAGE_LIBRETRO_MAME2016
	bool "libretro-mame2016"
	depends on BR2_PACKAGE_RETROARCH
	depends on BR2_INSTALL_LIBSTDCPP
	select BR2_PACKAGE_ZLIB
	help
	  A libretro mame2016 core for ARM - Based on MAME 0.174.

	  http://www.libretro.com

comment "LIBRETRO_MAME2016 needs a toolchain w/ C++"
	depends on !BR2_INSTALL_LIBSTDCPP
```

## package/libretro-melonds/Config.in
```kconfig
config BR2_PACKAGE_LIBRETRO_MELONDS
	bool "libretro-melonds"
	depends on BR2_PACKAGE_RETROARCH
	depends on BR2_INSTALL_LIBSTDCPP
	help
	  A libretro nintendo DS emulator core.

	  http://www.libretro.com

comment "LIBRETRO_MELONDS needs a toolchain w/ C++"
	depends on !BR2_INSTALL_LIBSTDCPP
```

## package/libretro-meowPC98/Config.in
```kconfig
config BR2_PACKAGE_LIBRETRO_MEOWPC98
	bool "libretro-meowPC98"
	depends on BR2_PACKAGE_RETROARCH
	depends on BR2_INSTALL_LIBSTDCPP
	select BR2_PACKAGE_RECALBOX_ROMFS_MEOWPC98
	help
	  A libretro NEC PC-98 emulator core.

	  http://www.libretro.com

comment "LIBRETRO_MEOWPC98 needs a toolchain w/ C++"
	depends on !BR2_INSTALL_LIBSTDCPP
```

## package/libretro-mesen-s/Config.in
```kconfig
config BR2_PACKAGE_LIBRETRO_MESEN_S
	bool "libretro-mesen-s"
	depends on BR2_PACKAGE_RETROARCH
	depends on BR2_INSTALL_LIBSTDCPP
	help
	  A cross-platform SNES emulator.

	  https://github.com/SourMesen/Mesen-S

comment "LIBRETRO_MESEN_S needs a toolchain w/ C++"
	depends on !BR2_INSTALL_LIBSTDCPP
```

## package/libretro-mesen/Config.in
```kconfig
config BR2_PACKAGE_LIBRETRO_MESEN
	bool "libretro-mesen"
	depends on BR2_PACKAGE_RETROARCH
	depends on BR2_INSTALL_LIBSTDCPP
	help
	  A cross-platform NES/Famicom emulator.

	  https://github.com/SourMesen/Mesen

comment "LIBRETRO_MESEN needs a toolchain w/ C++"
	depends on !BR2_INSTALL_LIBSTDCPP
```

## package/libretro-mess/Config.in
```kconfig
config BR2_PACKAGE_LIBRETRO_MESS
	bool "libretro-mess"
	depends on BR2_PACKAGE_RETROARCH
	depends on BR2_INSTALL_LIBSTDCPP
	select BR2_PACKAGE_ZLIB
	select BR2_PACKAGE_RECALBOX_ROMFS_MESS
	help
	  A libretro mess core for x86_64 - Based on MESS 0.216.

	  http://www.libretro.com

comment "LIBRETRO_MESS needs a toolchain w/ C++"
	depends on !BR2_INSTALL_LIBSTDCPP
```
