## package/libretro-uae4all/Config.in
```kconfig
config BR2_PACKAGE_LIBRETRO_UAE4ALL
	bool "libretro-uae4all"
	depends on BR2_PACKAGE_RETROARCH
	select BR2_PACKAGE_RECALBOX_ROMFS_AMIGA600
	help
	  A fast libretro AMIGA emulator core.

	  https://github.com/Chips-fr/uae4all-rpi
```

## package/libretro-uae4arm/Config.in
```kconfig
config BR2_PACKAGE_LIBRETRO_UAE4ARM
	bool "libretro-uae4arm"
	depends on BR2_PACKAGE_RETROARCH
	select BR2_PACKAGE_RECALBOX_ROMFS_AMIGA600
	select BR2_PACKAGE_RECALBOX_ROMFS_AMIGA1200
	select BR2_PACKAGE_RECALBOX_ROMFS_AMIGACD32
	select BR2_PACKAGE_RECALBOX_ROMFS_AMIGACDTV
	help
	  A libretro AMIGA emulator core for ARM.

	  http://www.libretro.com
```

## package/libretro-vice/Config.in
```kconfig
config BR2_PACKAGE_LIBRETRO_VICE
	bool "libretro-vice"
	depends on BR2_PACKAGE_RETROARCH
	depends on BR2_INSTALL_LIBSTDCPP
	select BR2_PACKAGE_RECALBOX_ROMFS_C64
	help
	  A libretro VICE emulator core.

	  http://www.libretro.com

comment "LIBRETRO_VICE needs a toolchain w/ C++"
	depends on !BR2_INSTALL_LIBSTDCPP
```

## package/libretro-vice_x64/Config.in
```kconfig
config BR2_PACKAGE_LIBRETRO_VICE_X64
	bool "libretro-vice_x64"
	depends on BR2_PACKAGE_RETROARCH
	depends on BR2_INSTALL_LIBSTDCPP
	select BR2_PACKAGE_RECALBOX_ROMFS_C64
	help
	  A libretro VICE emulator core.

	  http://www.libretro.com

comment "LIBRETRO_VICE_X64 needs a toolchain w/ C++"
	depends on !BR2_INSTALL_LIBSTDCPP
```

## package/libretro-vitaquake2/Config.in
```kconfig
config BR2_PACKAGE_LIBRETRO_VITAQUAKE2
	bool "libretro-vitaquake2"
	depends on BR2_PACKAGE_RETROARCH
	depends on BR2_INSTALL_LIBSTDCPP
	select BR2_PACKAGE_RECALBOX_ROMFS_QUAKE
	help
	  A libretro Quake 2 core.

	  http://www.libretro.com

comment "LIBRETRO_VITAQUAKE2 needs a toolchain w/ C++"
	depends on !BR2_INSTALL_LIBSTDCPP
```

## package/libretro-xmil/Config.in
```kconfig
config BR2_PACKAGE_LIBRETRO_XMIL
	bool "libretro-xmil"
	depends on BR2_PACKAGE_RETROARCH
	depends on BR2_INSTALL_LIBSTDCPP
	help
	  A libretro SHARP X1 emulator core.

	  http://www.libretro.com

comment "LIBRETRO_XMIL needs a toolchain w/ C++"
	depends on !BR2_INSTALL_LIBSTDCPP
```

## package/libretro-xrick/Config.in
```kconfig
config BR2_PACKAGE_LIBRETRO_XRICK
	bool "libretro-xrick"
	depends on BR2_PACKAGE_RETROARCH
	depends on BR2_INSTALL_LIBSTDCPP
	depends on BR2_PACKAGE_RECALBOX_ROMFS2
	help
	  A libretro clone of Rick Dangerous.

	  http://www.libretro.com

comment "LIBRETRO_XRICK needs a toolchain w/ C++"
	depends on !BR2_INSTALL_LIBSTDCPP
```

## package/librga/Config.in
```kconfig
config BR2_PACKAGE_LIBRGA
	bool "librga"
	select BR2_PACKAGE_LIBDRM
	help
	  librga - Userspace interface to Rockchip RGA 2D accelerator

	  https://github.com/rockchip-linux/linux-rga
```

## package/libxmp-lite/Config.in
```kconfig
config BR2_PACKAGE_LIBXMP_LITE
	bool "libxmp-lite"
	help
	  Libxmp is a library that renders
	  module files to PCM data.
	  https://github.com/cmatsuoka/libxmp
```

## package/linapple-recalbox/Config.in
```kconfig
config BR2_PACKAGE_LINAPPLE_RECALBOX
	bool "LinApple-Recalbox"
	select BR2_PACKAGE_SDL
	select BR2_PACKAGE_SDL_IMAGE
	select BR2_PACKAGE_SDL_IMAGE_PNG
	select BR2_PACKAGE_SDL_IMAGE_XPM
	select BR2_PACKAGE_LIBCURL
	select BR2_PACKAGE_ZLIB
	select BR2_PACKAGE_LIBZIP
	help
	  Linapple on Raspberry Pi
	  Great thanks to Mark Ormond for fine tuning LinApple and
	  publishing his work on GitHub

	  https://github.com/dabonetn/linapple-pie

comment "LinApple-pie needs a toolchain w/ C++, and following librarie : sdl, sdl_image (bmp, xpm), curl, zlib and libzip"
	depends on !BR2_PACKAGE_SDL || !BR2_PACKAGE_SDL_IMAGE || !BR2_PACKAGE_SDL_IMAGE_PNG || !BR2_PACKAGE_SDL_IMAGE_XPM || !BR2_PACKAGE_CURL || !BR2_PACKAGE_ZLIB || !BR2_PACKAGE_LIBZIP
```

## package/mali-t62x/Config.in
```kconfig
config BR2_PACKAGE_MALI_T62X
	bool "MALI_T62X"
	depends on BR2_arm
	select BR2_PACKAGE_MALI_OPENGLES_SDK
	select BR2_PACKAGE_HAS_LIBEGL
	select BR2_PACKAGE_HAS_LIBGLES
	select BR2_PACKAGE_LIBDRM_EXYNOS
	select BR2_PACKAGE_LIBDRM
	help
	  Install the binary user-space components for the
	  ARM Mali Midgard T62X GPU. This package requires a
	  kernel with the ARM Mali Midgard GPU Kernel Drivers enabled.

	  http://malideveloper.arm.com/resources/drivers/arm-mali-midgard-gpu-user-space-drivers

if BR2_PACKAGE_MALI_T62X

config BR2_PACKAGE_PROVIDES_LIBEGL
	default "mali-t62x"

config BR2_PACKAGE_PROVIDES_LIBGLES
	default "mali-t62x"

choice
	prompt "Driver flavor"
config BR2_PACKAGE_MALI_T62X_FBDEV
	bool "fbdev"
config BR2_PACKAGE_MALI_T62X_GBM
	bool "GBM"
	select BR2_PACKAGE_WAYLAND
config BR2_PACKAGE_MALI_T62X_BIGMALI
	bool "BigMali"
endchoice
endif

comment "mali-t62x"
	depends on !BR2_arm || !BR2_PACKAGE_MALI_OPENGLES_SDK
```

## package/moonlight-qt/Config.in
```kconfig
config BR2_PACKAGE_MOONLIGHT_QT
	bool "moonlight-qt"
	depends on (BR2_PACKAGE_HAS_LIBGLES || BR2_PACKAGE_HAS_LIBEGL || BR2_PACKAGE_HAS_LIBGL)
	depends on BR2_PACKAGE_HAS_UDEV
	select BR2_PACKAGE_OPUS
	select BR2_PACKAGE_OPUS_FIXED_POINT
	select BR2_PACKAGE_EXPAT
	select BR2_PACKAGE_LIBEVDEV
	select BR2_PACKAGE_AVAHI
	select BR2_PACKAGE_ALSA_LIB
	select BR2_PACKAGE_PULSEAUDIO
	select BR2_PACKAGE_LIBCURL
	select BR2_PACKAGE_LIBCEC
	select BR2_PACKAGE_FFMPEG
	select BR2_PACKAGE_SDL2
	select BR2_PACKAGE_SDL2_TTF
	select BR2_PACKAGE_SDL2_KMSDRM
	select BR2_PACKAGE_LIBENET
	select BR2_PACKAGE_RECALBOX_ROMFS_MOONLIGHT
	select BR2_PACKAGE_QT5
	select BR2_PACKAGE_QT5BASE_GUI
	select BR2_PACKAGE_QT5BASE_WIDGETSd
	select BR2_PACKAGE_QT5BASE_EGLFSd
	select BR2_PACKAGE_QT5BASE_FONTCONFIGd
	select BR2_PACKAGE_QT5BASE_LINUXFBd
	select BR2_PACKAGE_QT5BASE_OPENGL_LIBd
	select BR2_PACKAGE_QT5BASE_GIFd
	select BR2_PACKAGE_QT5BASE_JPEGd
	select BR2_PACKAGE_QT5BASE_PNGd
	select BR2_PACKAGE_QT5SVG
	select BR2_PACKAGE_QT5QUICKCONTROLS2
	select BR2_PACKAGE_OPENSSL
	select BR2_PACKAGE_XLIB_LIBX11 if BR2_PACKAGE_XORG7
	help
	  GameStream client for PCs (Windows, Mac, Linux,
	  and Steam Link)
	  https://github.com/moonlight-stream/moonlight-qt

if BR2_PACKAGE_MOONLIGHT_QT

config BR2_PACKAGE_QT5BASE_DEFAULT_QPA
	string
	default "eglfs" if ! BR2_PACKAGE_XORG7
	default "xcb" if BR2_PACKAGE_XORG7

endif
```

## package/mupen64plus-core/Config.in
```kconfig
config BR2_PACKAGE_MUPEN64PLUS_CORE
	bool "mupen 64 plus core"
	depends on BR2_INSTALL_LIBSTDCPP
	depends on BR2_PACKAGE_SDL2
	depends on BR2_PACKAGE_ALSA_LIB
	depends on BR2_PACKAGE_LIBPNG
	depends on BR2_PACKAGE_FREETYPE
	help
	  Mupen64Plus Core
	  https://github.com/mupen64plus/
comment "MUPEN64PLUS CORE  needs a toolchain w/ C++, ALSA, SDL2 and Freetype"
	depends on !BR2_INSTALL_LIBSTDCPP || !BR2_PACKAGE_SDL2 || !BR2_PACKAGE_ALSA_LIB || !BR2_PACKAGE_FREETYPE
```

## package/mupen64plus-video-gles2n64/Config.in
```kconfig
config BR2_PACKAGE_MUPEN64PLUS_VIDEO_GLES2N64
	bool "mupen64plus-video-gles2n64"
	depends on BR2_INSTALL_LIBSTDCPP
	depends on BR2_PACKAGE_SDL2
	depends on BR2_PACKAGE_RPI_USERLAND
	depends on BR2_PACKAGE_ALSA_LIB
	help
	  mupen64plus-video-gles2n64 plugin
	  https://github.com/mupen64plus/

comment "MUPEN64PLUS GLES2N64 needs a toolchain w/ C++, ALSA and SDL2"
	depends on !BR2_INSTALL_LIBSTDCPP || !BR2_PACKAGE_SDL2 || !BR2_PACKAGE_ALSA_LIB
```

## package/mupen64plus-video-gles2rice/Config.in
```kconfig
config BR2_PACKAGE_MUPEN64PLUS_VIDEO_GLES2RICE
	bool "mupen64plus-video-gles2rice"
	depends on BR2_INSTALL_LIBSTDCPP
	depends on BR2_PACKAGE_SDL2
	depends on BR2_PACKAGE_RPI_USERLAND
	depends on BR2_PACKAGE_ALSA_LIB
	help
	  mupen64plus-video-gles2rice plugin
	  https://github.com/mupen64plus/

comment "MUPEN64PLUS_GLES2RICE needs a toolchain w/ C++, ALSA and SDL2"
	depends on !BR2_INSTALL_LIBSTDCPP || !BR2_PACKAGE_SDL2 || !BR2_PACKAGE_ALSA_LIB
```

## package/mupen64plus-video-rice/Config.in
```kconfig
config BR2_PACKAGE_MUPEN64PLUS_VIDEO_RICE
	bool "mupen64plus-video-rice"
	depends on BR2_INSTALL_LIBSTDCPP
	depends on BR2_PACKAGE_SDL2
	depends on BR2_PACKAGE_ALSA_LIB
	help
	  mupen64plus-video-rice plugin
	  https://github.com/mupen64plus/mupen64plus-video-rice

comment "MUPEN64PLUS_VIDEO_RICE needs a toolchain w/ C++, ALSA and SDL2"
	depends on !BR2_INSTALL_LIBSTDCPP || !BR2_PACKAGE_SDL2 || !BR2_PACKAGE_ALSA_LIB
```

## package/nvidia-driver-390-recalbox/Config.in
```kconfig
comment "nvidia-driver-390 needs a glibc toolchain"
	depends on BR2_i386 || BR2_x86_64
	depends on !BR2_TOOLCHAIN_USES_GLIBC

config BR2_PACKAGE_NVIDIA_DRIVER_390_RECALBOX
	bool "nvidia-driver-390-recalbox"
	depends on BR2_i386 || BR2_x86_64
	depends on BR2_TOOLCHAIN_USES_GLIBC
	help
	  The binary-only driver blob for NVidia cards.
	  This is the userland part only.

	  http://www.nvidia.com/

if BR2_PACKAGE_NVIDIA_DRIVER_390_RECALBOX

comment "nvidia-driver-390 X.org drivers needs a modular Xorg server"
	depends on !BR2_PACKAGE_XSERVER_XORG_SERVER_MODULAR

config BR2_PACKAGE_NVIDIA_DRIVER_390_RECALBOX_XORG
	bool "X.org drivers"
	default y
	depends on BR2_PACKAGE_XSERVER_XORG_SERVER_MODULAR
	# recalbox - enable both mesa and nvidia
	select BR2_PACKAGE_MESA3D_HEADERS if !BR2_PACKAGE_MESA3D
	select BR2_PACKAGE_XLIB_LIBX11
	select BR2_PACKAGE_XLIB_LIBXEXT
	select BR2_PACKAGE_HAS_LIBGL if !BR2_PACKAGE_MESA3D
	select BR2_PACKAGE_HAS_LIBEGL if !BR2_PACKAGE_MESA3D
	select BR2_PACKAGE_HAS_LIBEGL_WAYLAND if !BR2_PACKAGE_MESA3D
	select BR2_PACKAGE_HAS_LIBGLES if !BR2_PACKAGE_MESA3D

if BR2_PACKAGE_NVIDIA_DRIVER_390_RECALBOX_XORG

# recalbox - enable both mesa and nvidia
if !BR2_PACKAGE_MESA3D
config BR2_PACKAGE_PROVIDES_LIBGL
	default "nvidia-driver-390"

config BR2_PACKAGE_PROVIDES_LIBEGL
	default "nvidia-driver-390"

config BR2_PACKAGE_PROVIDES_LIBGLES
	default "nvidia-driver-390"
endif

config BR2_PACKAGE_NVIDIA_DRIVER_390_RECALBOX_PRIVATE_LIBS
	bool "Install private libraries"
	help
	  Two libraries require special agreement with NVidia to
	  develop code linking to those libraries: libnvidia-ifr.so
	  and libnvidia-fbc.so (to grab and encode an OpenGL buffer or
	  an X framebuffer.)

	  Say 'y' here if you plan on running a program that uses
	  those private libraries.

endif # BR2_PACKAGE_NVIDIA_DRIVER_390_RECALBOX_XORG

config BR2_PACKAGE_NVIDIA_DRIVER_390_RECALBOX_CUDA
	bool "CUDA support"

if BR2_PACKAGE_NVIDIA_DRIVER_390_RECALBOX_CUDA

config BR2_PACKAGE_NVIDIA_DRIVER_390_RECALBOX_OPENCL
	bool "OpenCL support"

config BR2_PACKAGE_NVIDIA_DRIVER_390_RECALBOX_CUDA_PROGS
	bool "CUDA MPS server and control"
	help
	  Say 'y' here if you need to run more than one program
	  doing CUDA at the same time. The MPS server will be
	  launched automatically when needed.

endif # BR2_PACKAGE_NVIDIA_DRIVER_390_RECALBOX_CUDA

comment "nvidia kernel module needs a kernel to be built"
	depends on !BR2_LINUX_KERNEL

config BR2_PACKAGE_NVIDIA_DRIVER_390_RECALBOX_MODULE
	bool "nvidia kernel module"
	depends on BR2_LINUX_KERNEL
	select BR2_LINUX_NEEDS_MODULES # not using kernel-module infra
	help
	  Build the nvidia.ko kernel module.

	  If CUDA support (above) is set, and the target is x86_64, then
	  this will also build the nvidia-uvm.ko kernel module, which
	  provides Unified Memory access to the GPU and CPU memories for
	  CUDA programs.

endif # BR2_PACKAGE_NVIDIA_DRIVER_390_RECALBOX
```

## package/openbor/Config.in
```kconfig
config BR2_PACKAGE_OPENBOR
	bool "openbor"
	select BR2_PACKAGE_SDL2
	select BR2_PACKAGE_SDL2_GFX
	select BR2_PACKAGE_LIBVPX
	help
	  OpenBOR is the ultimate 2D side scrolling engine
	  for beat em' ups, shooters, and more!
	  http://www.chronocrash.com

comment "OPENBOR needs a toolchain w/ OpenGl, SDL2"
	depends on BR2_PACKAGE_SDL2
```

## package/oricutron/Config.in
```kconfig
config BR2_PACKAGE_ORICUTRON
	bool "oricutron"
	select BR2_PACKAGE_SDL2
	help
	  Portable Oric-1/Atmos/Telestrat and Pravetz 8D emulator.

	  http://www.petergordon.org.uk/oricutron/.

comment "Oricutron needs a toolchain w/ OpenGl, SDL2"
	depends on BR2_PACKAGE_SDL2
```

## package/pamix/Config.in
```kconfig
config BR2_PACKAGE_PAMIX
	bool "PAmix"
	depends on BR2_PACKAGE_PULSEAUDIO
	select BR2_PACKAGE_NCURSES
	help
	  ncurses/curses pulseaudio mixer in c++ similar to pavucontrol

	  https://github.com/patroclos/PAmix
```

## package/pcsx2/Config.in
```kconfig
config BR2_PACKAGE_PCSX2
	bool "pcsx2"
	depends on BR2_x86_64
	depends on BR2_PACKAGE_XORG7
	select BR2_PACKAGE_RECALBOX_ROMFS_PS2
	select BR2_PACKAGE_ALSA_LIB
	select BR2_PACKAGE_DEJAVU
	select BR2_PACKAGE_FREETYPE
	select BR2_PACKAGE_LIBAIO
	select BR2_PACKAGE_LIBPCAP
	select BR2_PACKAGE_LIBPNG
	select BR2_PACKAGE_LIBSOUNDTOUCH
	select BR2_PACKAGE_PORTAUDIO
	select BR2_PACKAGE_SDL2
	select BR2_PACKAGE_WXWIDGETS
	select BR2_PACKAGE_YAML_CPP
	select BR2_PACKAGE_ZLIB
	select BR2_PACKAGE_LIBSAMPLERATE
	help
	  A Sony PS2 emulator for X86_64.

	  https://github.com/PCSX2/

comment "Pcsx2 a toolchain w/ C++, and following librarie : alsa-lib, dejavu, freetype, gdk_libaio, libpcap, libpng, libsoundtouch, portaudio, sdl2, wxwidgets, yaml-cpp, zlib, libsamplerate"
	depends on !BR2_PACKAGE_ALSA_LIB || !BR2_PACKAGE_DEJAVU || !BR2_PACKAGE_FREETYPE || !BR2_PACKAGE_LIBAIO || \
	!BR2_PACKAGE_LIBPCAP || !BR2_PACKAGE_LIBPNG || !BR2_PACKAGE_LIBSOUNDTOUCH || !BR2_PACKAGE_PORTAUDIO || \
	!BR2_PACKAGE_SDL2 || !BR2_PACKAGE_WXWIDGETS || !BR2_PACKAGE_YAML_CPP || !BR2_PACKAGE_ZLIB || \
	!BR2_PACKAGE_LIBSAMPLERATE
```

## package/pcsx_rearmed/Config.in
```kconfig
config BR2_PACKAGE_PCSX_REARMED
	bool "pcsx_rearmed"
	depends on BR2_INSTALL_LIBSTDCPP
	help
	  A psx emulator core for ARM.

	  http://github.com/notaz/pcsx_rearmed

comment "PCSX_REARMED needs a toolchain w/ C++"
	depends on !BR2_INSTALL_LIBSTDCPP
```

## package/pifba/Config.in
```kconfig
config BR2_PACKAGE_PIFBA
	bool "Pifba"
	depends on BR2_INSTALL_LIBSTDCPP
	select BR2_PACKAGE_SDL2
	select BR2_PACKAGE_RPI_USERLAND
	select BR2_PACKAGE_ALSA_LIB
	help
	  FBA arm optimized

	  https://github.com/digitalLumberjack/pifba

comment "Pifba needs a toolchain w/ C++, ALSA and SDL"
	depends on !BR2_INSTALL_LIBSTDCPP || !BR2_PACKAGE_SDL || !BR2_PACKAGE_ALSA_LIB
```

## package/pisnes/Config.in
```kconfig
config BR2_PACKAGE_PISNES
	bool "pisnes"
	depends on BR2_INSTALL_LIBSTDCPP
	help
	  A SNES emulator core for ARM.

	  https://gitlab.com/Bkg2k/pisnes

comment "PCSX_REARMED needs a toolchain w/ C++"
	depends on !BR2_INSTALL_LIBSTDCPP
```

## package/pm-utils/Config.in
```kconfig
config BR2_PACKAGE_PM_UTILS
	bool "pm-utils"
	help
	  pm-utils is a small collection of scripts that handle suspend
	  and resume on behalf of HAL.

	  https://pm-utils.freedesktop.org/wiki/
```
