## package/xroar/Config.in
```kconfig
config BR2_PACKAGE_XROAR
	bool "xroar"
	select BR2_PACKAGE_SDL2
	help
	  TRS-80 Coco & Dragon 32/64 emulator

	  https://www.6809.org.uk/wroar

comment "Gsplus needs a toolchain w/ OpenGl, SDL2"
	depends on BR2_PACKAGE_SDL2
```
