## package/rpi-dtoverlay/Config.in
```kconfig
config BR2_PACKAGE_RPI_DTOVERLAY
	bool "rpi-dtoverlay"
	depends on BR2_arm
	depends on BR2_INSTALL_LIBSTDCPP
	depends on BR2_TOOLCHAIN_HAS_THREADS
	depends on !BR2_STATIC_LIBS
	help
	  dtoverlay binary from Raspberry Pi Userland.

	  https://github.com/raspberrypi/userland/

comment "rpi-dtoverlay needs a toolchain w/ C++, threads, dynamic library"
	depends on BR2_arm
	depends on !BR2_INSTALL_LIBSTDCPP || !BR2_TOOLCHAIN_HAS_THREADS || \
		BR2_STATIC_LIBS
```

## package/rpi-fbcp/Config.in
```kconfig
config BR2_PACKAGE_RPI_FBCP
	bool "rpi-fbcp"
	depends on BR2_PACKAGE_TFT_WAVESHARE
	select BR2_PACKAGE_RPI_FIRMWARE
	help
	  Raspberry Pi utility.
	  Used for mirror primary framebuffer to secondary framebuffer.
	  Fork from https://github.com/tasanakorn/rpi-fbcp

	  https://github.com/ian57/rpi-fbcp
```

## package/rpi-userland-tools/Config.in
```kconfig
config BR2_PACKAGE_RPI_USERLAND_TOOLS
	bool "rpi-userland tools"
	depends on BR2_arm
	depends on BR2_INSTALL_LIBSTDCPP
	depends on BR2_TOOLCHAIN_HAS_THREADS
	depends on !BR2_STATIC_LIBS
	depends on !BR2_PACKAGE_RPI_USERLAND
	help
	  Raspberry Pi Userland contains the necessary library to use
	  the VideoCore driver.

	  Includes source for the ARM side code to interface to: EGL,
	  mmal, GLESv2, vcos, openmaxil, vchiq_arm, bcm_host, WFC,
	  OpenVG.

	  This package will only install userland tools, for RPI4.

	  https://github.com/raspberrypi/userland/

comment "rpi-userland needs a toolchain w/ C++, threads, dynamic library"
	depends on BR2_arm
	depends on !BR2_INSTALL_LIBSTDCPP || !BR2_TOOLCHAIN_HAS_THREADS || \
		BR2_STATIC_LIBS
```

## package/rtl8812au/Config.in
```kconfig
comment "rtl8812au needs a Linux kernel to be built"
	depends on !BR2_LINUX_KERNEL

config BR2_PACKAGE_RTL8812AU
	bool "rtl8812au/rtl8821au"
	depends on BR2_LINUX_KERNEL
	help
	  rtl8812au/rtl8821au wifi driver

	  https://github.com/aircrack-ng/rtl8812au
```

## package/rtl88x2bu/Config.in
```kconfig
comment "rtl88x2bu needs a Linux kernel to be built"
	depends on !BR2_LINUX_KERNEL

config BR2_PACKAGE_RTL88X2BU
	bool "rtl88x2bu"
	depends on BR2_LINUX_KERNEL
	help
	  rtl88x2bu wifi driver

	  https://github.com/cilynx/rtl88x2bu
```

## package/sdl12-compat/Config.in
```kconfig
config BR2_PACKAGE_SDL12_COMPAT
	bool "sdl12-compat"
	depends on BR2_PACKAGE_SDL2 && !BR2_PACKAGE_SDL
	help
	  SDL1.2 compatibility library

	  https://github.com/libsdl-org/sdl12-compat

comment "sdl12-compat needs a toolchain w/ OpenGl, SDL2"
	depends on BR2_PACKAGE_SDL2
```

## package/simcoupe/Config.in
```kconfig
config BR2_PACKAGE_SIMCOUPE
	bool "simcoupe"
	select BR2_PACKAGE_SDL2
	select BR2_PACKAGE_FMT
	help
	  Portable MGT SAM Coupe emulator

	  http://www.simcoupe.org

comment "Oricutron needs a toolchain w/ OpenGl, SDL2"
	depends on BR2_PACKAGE_SDL2
```

## package/supermodel/Config.in
```kconfig
config BR2_PACKAGE_SUPERMODEL
	bool "supermodel"
	depends on BR2_INSTALL_LIBSTDCPP
	select BR2_PACKAGE_SDL2
	select BR2_PACKAGE_SDL2_NET
	select BR2_PACKAGE_LIBGLU
	select BR2_PACKAGE_ZLIB
	select BR2_PACKAGE_LIBPNG
	select BR2_PACKAGE_LIBOGG
	select BR2_PACKAGE_LIBVORIS
	help
	  Supermodel is a Sega Model 3 that uses the SDL-library

	  https://sourceforge.net/p/model3emu/
```

## package/switchres/Config.in
```kconfig
config BR2_PACKAGE_SWITCHRES
	bool "switchres"
	select BR2_PACKAGE_HOST_DOS2UNIX
	help
	  Switchres is a modeline generation engine for emulation.
	  https://github.com/antonioginer/switchres
```

## package/ti99sim/Config.in
```kconfig
config BR2_PACKAGE_TI99SIM
	bool "ti99sim"
	select BR2_PACKAGE_SDL2
	help
	  TI-99 Emulator

	  https://www.mrousseau.org/programs/ti99sim/

comment "Ti99Sim needs a toolchain w/ OpenGl, SDL2"
	depends on BR2_PACKAGE_SDL2
```

## package/uboot-c2/Config.in
```kconfig
config BR2_PACKAGE_UBOOT_C2
	bool "Pre-built U-Boot for Odroid C2"
	help
	  Pre-built uboot binaries for C2 for GCC >= 5.x

	  https://github.com/mdrjr/c2_uboot_binaries
```

## package/uboot-odroidgo2/Config.in
```kconfig
config BR2_PACKAGE_UBOOT_ODROIDGO2
	bool "U-Boot for Odroid GO2"
	help
	  u-boot for odroid

	  https://github.com/hardkernel/u-boot/tree/odroidgoA-v2017.09
```

## package/uboot-rg353x/Config.in
```kconfig
config BR2_PACKAGE_UBOOT_RG353X
	bool "U-Boot for Anbernic RG353x"
	select BR2_PACKAGE_HOST_DTC
	select BR2_PACKAGE_ROCKCHIP_RKBIN
	help
	  u-boot for Anbernic RG35P/V/M

	  https://github.com/pkegg/RG353P_uboot
```

## package/uboot-xu4/Config.in
```kconfig
config BR2_PACKAGE_UBOOT_XU4
	bool "Pre-built U-Boot for Odroid XU4"
	help
	  Pre-built uboot binaries for XU4 for GCC >= 5.x

	  https://github.com/hardkernel/u-boot/tree/odroidxu4-v2017.05
```

## package/vulkan-headers/Config.in
```kconfig
config BR2_PACKAGE_VULKAN_HEADERS
	bool "Vulkan headers"
	help
	  Vulkan Header files and API registry
	  https://github.com/KhronosGroup/Vulkan-Headers
```

## package/vulkan-loader/Config.in
```kconfig
config BR2_PACKAGE_VULKAN_LOADER
	bool "Vulkan loader"
	select BR2_PACKAGE_VULKAN_HEADERS
	help
	  Vulkan loader
	  https://github.com/KhronosGroup/Vulkan-Loader
```

## package/wii-u-gc-adapter/Config.in
```kconfig
config BR2_PACKAGE_WII_U_GC_ADAPTER
	bool "wii-u-gc-adapter"
	depends on BR2_INSTALL_LIBSTDCPP
	select BR2_PACKAGE_LIBUSB
	select BR2_PACKAGE_LIBEVDEV
	help
	  Tool for using the Wii U GameCube Adapter on Linux
```

## package/wildmidi/Config.in
```kconfig
config BR2_PACKAGE_WILDMIDI
	bool "wildmidi"
	help
	  WildMIDI is a simple software midi
	  player which has a core softsynth
	  library that canbe used with other
	  applications.
	  https://github.com/Mindwerks/wildmidi
```

## package/wm8960-audiohat/Config.in
```kconfig
config BR2_PACKAGE_WM8960_AUDIOHAT
	bool "wm8960 soundcard Kernel Module and overlay"
	depends on BR2_LINUX_KERNEL
	help
	  Kernel module to support waveshare wm8960 soundcard on gpio

comment "wm8960 soundcard support needs a kernel and headers"
	depends on !BR2_LINUX_KERNEL
```

## package/wsd/Config.in
```kconfig
config BR2_PACKAGE_WSD
	bool "Web Service Device"
	help
	  Web Service Device for automatic discovery in Window network
	  https://en.wikipedia.org/wiki/Web_Services_for_Devices
```

## package/wxwidgets/Config.in
```kconfig
config BR2_PACKAGE_WXWIDGETS
	bool "wxwidgets"
	select BR2_PACKAGE_LIBPNG
	select BR2_PACKAGE_JPEG
	select BR2_PACKAGE_ZLIB
	select BR2_PACKAGE_GDK_PIXBUF
	select BR2_PACKAGE_LIBGTK3
	select BR2_PACKAGE_LIBGTK3_X11
	help
	  Wxwidgets A crossplatform gui library

	  https://github.com/wxWidgets/wxWidgets

comment "wxWidget a toolchain w/ C++, and following librarie : libpng, jpeg, zlib, gdk_pixbuf"
	depends on !BR2_PACKAGE_LIBPNG || !BR2_PACKAGE_JPEG || !BR2_PACKAGE_ZLIB || !BR2_PACKAGE_GDK_PIXBUF
```

## package/xa65/Config.in
```kconfig
config BR2_PACKAGE_XA65
	bool "xa65"
	help
	  xa65 - 6502 assembler
	  https://github/fachat/xa65
```

## package/xow/Config.in
```kconfig
config BR2_PACKAGE_XOW
	bool "xow"
	depends on BR2_LINUX_KERNEL
	depends on BR2_INSTALL_LIBSTDCPP
	help
	  Xbox One wireless dongles support
```

## package/xpadneo/Config.in
```kconfig
config BR2_PACKAGE_XPADNEO
	bool "Xbox One controller support"
	depends on BR2_PACKAGE_HAS_UDEV
	select BR2_PACKAGE_LIBEVDEV
	help
	  Xbox One controller support
	  https://atar-axis.github.io/xpadneo/
```

## package/xpi_gamecon_rpi/Config.in
```kconfig
config BR2_PACKAGE_XPI_GAMECON_RPI
	bool "xpi_gamecon Kernel Module for Piboy DMG"
	depends on BR2_LINUX_KERNEL
	help
	  Kernel module to support hardware from piboy DMG

comment "xpi_gamecon_rpi needs a kernel and headers"
	depends on !BR2_LINUX_KERNEL
```
