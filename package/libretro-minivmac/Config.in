## package/libretro-minivmac/Config.in
```kconfig
config BR2_PACKAGE_LIBRETRO_MINIVMAC
	bool "libretro-minivmac"
	depends on BR2_PACKAGE_RETROARCH
	depends on BR2_INSTALL_LIBSTDCPP
	help
	  A libretro MACINTOSH emulator core.

	  http://www.libretro.com

comment "LIBRETRO_MINIVMAC needs a toolchain w/ C++"
	depends on !BR2_INSTALL_LIBSTDCPP
```

## package/libretro-mojozork/Config.in
```kconfig
config BR2_PACKAGE_LIBRETRO_MOJOZORK
	bool "libretro-mojozrok"
	depends on BR2_PACKAGE_RETROARCH
	depends on BR2_INSTALL_LIBSTDCPP
	help
	  A Z-Machine libretro core.

	  https://www.libretro.com

comment "Mojozork a toolchain w/ C++"
	depends on !BR2_INSTALL_LIBSTDCPP
```

## package/libretro-mupen64-nx/Config.in
```kconfig
config BR2_PACKAGE_LIBRETRO_MUPEN64_NX
	bool "libretro-mupen64-nx"
	depends on BR2_PACKAGE_RETROARCH
	depends on BR2_INSTALL_LIBSTDCPP
	help
	  A libretro N64 emulator core for ARM.

	  http://www.libretro.com

comment "LIBRETRO_MUPEN64_NX needs a toolchain w/ C++"
	depends on !BR2_INSTALL_LIBSTDCPP
```

## package/libretro-mupen64plus-next/Config.in
```kconfig
config BR2_PACKAGE_LIBRETRO_MUPEN64PLUS_NEXT
        bool "libretro-mupen64plus-next"
	depends on BR2_PACKAGE_RETROARCH
	depends on BR2_INSTALL_LIBSTDCPP
        help
          A libretro N64 emulator core for ARM.

	  http://www.libretro.com

comment "LIBRETRO_MUPEN64PLUS_NEXT needs a toolchain w/ C++"
	depends on !BR2_INSTALL_LIBSTDCPP
```

## package/libretro-mupen64plus/Config.in
```kconfig
config BR2_PACKAGE_LIBRETRO_MUPEN64PLUS
	bool "libretro-mupen64plus"
	depends on BR2_PACKAGE_RETROARCH
	depends on BR2_INSTALL_LIBSTDCPP
	help
	  A libretro N64 emulator core for ARM.

	  http://www.libretro.com

comment "LIBRETRO_MUPEN64PLUS needs a toolchain w/ C++"
	depends on !BR2_INSTALL_LIBSTDCPP
```

## package/libretro-openlara/Config.in
```kconfig
config BR2_PACKAGE_LIBRETRO_OPENLARA
	bool "libretro-openlara"
	depends on BR2_PACKAGE_RETROARCH
	depends on BR2_INSTALL_LIBSTDCPP
	select BR2_PACKAGE_RECALBOX_ROMFS_PORTS
	help
	  A libretro Tomb raider emulator core.

	  http://www.libretro.com

comment "LIBRETRO_OPENLARA needs a toolchain w/ C++"
	depends on !BR2_INSTALL_LIBSTDCPP
```

## package/libretro-opera/Config.in
```kconfig
config BR2_PACKAGE_LIBRETRO_OPERA
	bool "libretro-opera"
	depends on BR2_PACKAGE_RETROARCH
	depends on BR2_INSTALL_LIBSTDCPP
	select BR2_PACKAGE_RECALBOX_ROMFS_3DO
	help
	  A libretro 3DO emulator core for ARM.

	  http://www.libretro.com

comment "LIBRETRO_OPERA needs a toolchain w/ C++"
	depends on !BR2_INSTALL_LIBSTDCPP
```

## package/libretro-parallel-n64/Config.in
```kconfig
config BR2_PACKAGE_LIBRETRO_PARALLEL_N64
	bool "libretro-parallel-n64"
	depends on BR2_PACKAGE_RETROARCH
	depends on BR2_INSTALL_LIBSTDCPP
	select BR2_PACKAGE_RECALBOX_ROMFS_64DD
	help
	  A libretro N64 and 64DD emulator core for ARM.

	  http://www.libretro.com

comment "LIBRETRO_PARALLEL_N64 needs a toolchain w/ C++"
	depends on !BR2_INSTALL_LIBSTDCPP
```

## package/libretro-parallel64/Config.in
```kconfig
config BR2_PACKAGE_LIBRETRO_PARALLEL64
	bool "libretro-parallel64"
	depends on BR2_PACKAGE_RETROARCH
	depends on BR2_INSTALL_LIBSTDCPP
	help
	  A libretro N64 emulator core for ARM.

	  http://www.libretro.com

comment "LIBRETRO_PARALLEL64 needs a toolchain w/ C++"
	depends on !BR2_INSTALL_LIBSTDCPP
```

## package/libretro-pcsx2/Config.in
```kconfig
config BR2_PACKAGE_LIBRETRO_PCSX2
	bool "libretro-pcsx2"
	depends on BR2_x86_64
	depends on BR2_PACKAGE_RETROARCH
	depends on BR2_INSTALL_LIBSTDCPP
	help
	  A Sony PS2 libretro core for X86_64.

	  https://www.libretro.com

comment "Pcsx2 a toolchain w/ C++"
	depends on !BR2_INSTALL_LIBSTDCPP
```

## package/libretro-picodrive/Config.in
```kconfig
config BR2_PACKAGE_LIBRETRO_PICODRIVE
	bool "libretro-picodrive"
	depends on BR2_PACKAGE_RETROARCH
	depends on BR2_INSTALL_LIBSTDCPP
	depends on BR2_PACKAGE_LIBPNG
	depends on BR2_PACKAGE_SDL
	select BR2_PACKAGE_RECALBOX_ROMFS_MASTERSYSTEM
	select BR2_PACKAGE_RECALBOX_ROMFS_MEGADRIVE
	select BR2_PACKAGE_RECALBOX_ROMFS_SEGA32X
	select BR2_PACKAGE_RECALBOX_ROMFS_SEGACD
	help
	  A libretro Megadrive SMS emulator core for ARM.

	  http://www.libretro.com

comment "LIBRETRO_PICODRIVE needs a toolchain w/ C++"
	depends on !BR2_INSTALL_LIBSTDCPP && !BR2_PACKAGE_LIBPNG
```

## package/libretro-potator/Config.in
```kconfig
config BR2_PACKAGE_LIBRETRO_POTATOR
	bool "libretro-potator"
	depends on BR2_PACKAGE_RETROARCH
	depends on BR2_INSTALL_LIBSTDCPP
	help
	  A libretro Watara Supervision emulator core.

	  http://www.libretro.com

comment "LIBRETRO_POTATOR needs a toolchain w/ C++"
	depends on !BR2_INSTALL_LIBSTDCPP
```

## package/libretro-ppsspp/Config.in
```kconfig
config BR2_PACKAGE_LIBRETRO_PPSSPP
	bool "libretro-ppsspp"
	depends on BR2_PACKAGE_RETROARCH
	depends on BR2_INSTALL_LIBSTDCPP
	select BR2_PACKAGE_RECALBOX_ROMFS_PSP
	help
	  A libretro PSP emulator core.

	  http://www.libretro.com

comment "LIBRETRO_PPSSPP needs a toolchain w/ C++"
	depends on !BR2_INSTALL_LIBSTDCPP
```

## package/libretro-px68k/Config.in
```kconfig
config BR2_PACKAGE_LIBRETRO_PX68K
	bool "libretro-px68k"
	depends on BR2_PACKAGE_RETROARCH
	depends on BR2_INSTALL_LIBSTDCPP
	select BR2_PACKAGE_RECALBOX_ROMFS_X68000
	help
	  A libretro SHARP X68000 emulator core.

	  http://www.libretro.com

comment "LIBRETRO_BEETLE_PSX needs a toolchain w/ C++"
	depends on !BR2_INSTALL_LIBSTDCPP
```

## package/libretro-race/Config.in
```kconfig
config BR2_PACKAGE_LIBRETRO_RACE
	bool "libretro-race"
	depends on BR2_PACKAGE_RETROARCH
	depends on BR2_INSTALL_LIBSTDCPP
	select BR2_PACKAGE_RECALBOX_ROMFS_NGP
	select BR2_PACKAGE_RECALBOX_ROMFS_NGPC
	help
	  A libretro NGP emulator core for ARM.

	  http://www.libretro.com

comment "LIBRETRO_RACE needs a toolchain w/ C++"
	depends on !BR2_INSTALL_LIBSTDCPP
```

## package/libretro-retro8/Config.in
```kconfig
config BR2_PACKAGE_LIBRETRO_RETRO8
	bool "libretro-retro8"
	depends on BR2_PACKAGE_RETROARCH
	depends on BR2_INSTALL_LIBSTDCPP
	help
	  A libretro PICO-8 emulator core.

	  https://github.com/libretro/retro8

comment "LIBRETRO_RETRO8 needs a toolchain w/ C++"
	depends on !BR2_INSTALL_LIBSTDCPP
```

## package/libretro-retrodream/Config.in
```kconfig
config BR2_PACKAGE_LIBRETRO_RETRODREAM
	bool "libretro-retrodream"
	depends on BR2_PACKAGE_RETROARCH
	depends on BR2_INSTALL_LIBSTDCPP
	help
	  A libretro dreamcast emulator core.

	  http://www.libretro.com
comment "LIBRETRO_RETRODREAM needs a toolchain w/ C++"
	depends on !BR2_INSTALL_LIBSTDCPP
```

## package/libretro-same_cdi/Config.in
```kconfig
config BR2_PACKAGE_LIBRETRO_SAME_CDI
        bool "libretro-same_cdi"
        depends on BR2_PACKAGE_RETROARCH
        depends on BR2_INSTALL_LIBSTDCPP
        help
          A libretro Philipps CD-i emulator.

          http://www.libretro.com

comment "LIBRETRO_SAME_CDI needs a toolchain w/ C++"
        depends on !BR2_INSTALL_LIBSTDCPP
```

## package/libretro-sameboy/Config.in
```kconfig
config BR2_PACKAGE_LIBRETRO_SAMEBOY
	bool "libretro-sameboy"
	depends on BR2_PACKAGE_RETROARCH
	depends on BR2_INSTALL_LIBSTDCPP
	help
	  A libretro GB/C emulator core for ARM.

	  http://www.libretro.com

comment "LIBRETRO_SAMEBOY needs a toolchain w/ C++"
	depends on !BR2_INSTALL_LIBSTDCPP
```

## package/libretro-sameduck/Config.in
```kconfig
config BR2_PACKAGE_LIBRETRO_SAMEDUCK
	bool "libretro-sameduck"
	depends on BR2_PACKAGE_RETROARCH
	depends on BR2_INSTALL_LIBSTDCPP
	help
	  A libretro megaduck/cougar boy  emulator.

	  https://github.com/LIJI32/SameBoy/tree/SameDuck

comment "LIBRETRO_SAMEDUCK needs a toolchain w/ C++"
	depends on !BR2_INSTALL_LIBSTDCPP
```

## package/libretro-scummvm/Config.in
```kconfig
config BR2_PACKAGE_LIBRETRO_SCUMMVM
	bool "libretro-scummvm"
	depends on BR2_PACKAGE_RETROARCH
	depends on BR2_INSTALL_LIBSTDCPP
	select BR2_PACKAGE_RECALBOX_ROMFS_SCUMMVM
	help
	  A libretro SCUMMVM emulator core for ARM.

	  http://www.libretro.com

comment "LIBRETRO_SCUMMVM needs a toolchain w/ C++"
	depends on !BR2_INSTALL_LIBSTDCPP
```

## package/libretro-swanstation/Config.in
```kconfig
config BR2_PACKAGE_LIBRETRO_SWANSTATION
	bool "libretro-swanstation"
	depends on BR2_PACKAGE_RETROARCH
	depends on BR2_INSTALL_LIBSTDCPP
	help
	  A libretro psx emulation core.

	  https://github.com/libretro/swanstation

comment "LIBRETRO_SWANSTATION needs a toolchain w/ C++"
	depends on !BR2_INSTALL_LIBSTDCPP
```

## package/libretro-thepowdertoy/Config.in
```kconfig
config BR2_PACKAGE_LIBRETRO_THEPOWDERTOY
	bool "libretro-thepowdertoy"
	depends on BR2_PACKAGE_RETROARCH
	depends on BR2_INSTALL_LIBSTDCPP
	help
	  The Powder Toy is a free physics sandbox game.

	  http://www.libretro.com

comment "LIBRETRO_THEPOWDERTOY needs a toolchain w/ C++"
	depends on !BR2_INSTALL_LIBSTDCPP
```

## package/libretro-tic80/Config.in
```kconfig
config BR2_PACKAGE_LIBRETRO_TIC80
	bool "libretro-tic80"
	depends on BR2_PACKAGE_RETROARCH
	depends on BR2_INSTALL_LIBSTDCPP
	help
	  A libretro TIC-80 emulator core.

	  https://github.com/nesbox/TIC-80

comment "LIBRETRO_TIC80 needs a toolchain w/ C++"
	depends on !BR2_INSTALL_LIBSTDCPP
```

## package/libretro-uae/Config.in
```kconfig
config BR2_PACKAGE_LIBRETRO_UAE
	bool "libretro-uae"
	depends on BR2_PACKAGE_RETROARCH
	depends on BR2_INSTALL_LIBSTDCPP
	select BR2_PACKAGE_RECALBOX_ROMFS_AMIGA600
	select BR2_PACKAGE_RECALBOX_ROMFS_AMIGA1200
	select BR2_PACKAGE_RECALBOX_ROMFS_AMIGACD32
	select BR2_PACKAGE_RECALBOX_ROMFS_AMIGACDTV
	help
	  A libretro AMIGA emulator core for ARM.

	  http://www.libretro.com

comment "LIBRETRO_UAE needs a toolchain w/ C++"
	depends on !BR2_INSTALL_LIBSTDCPP
```
