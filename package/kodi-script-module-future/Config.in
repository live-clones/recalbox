## package/kodi-script-module-future/Config.in
```kconfig
config BR2_PACKAGE_KODI_SCRIPT_MODULE_FUTURE
	bool "kodi-script-module-future"
	default n
	depends on BR2_PACKAGE_KODI
	help
	  Kodi Future script module

	  https://mirrors.kodi.tv/addons/matrix/script.module.future/
```

## package/kodi-script-module-idna/Config.in
```kconfig
config BR2_PACKAGE_KODI_SCRIPT_MODULE_IDNA
	bool "kodi-script-module-idna"
	default n
	depends on BR2_PACKAGE_KODI
	help
	  Kodi Idna script module

	  https://mirrors.kodi.tv/addons/matrix/script.module.idna/
```

## package/kodi-script-module-inputstreamhelper/Config.in
```kconfig
config BR2_PACKAGE_KODI_SCRIPT_MODULE_INPUTSTREAMHELPER
	bool "kodi-script-module-inputstreamhelper"
	default n
	depends on BR2_PACKAGE_KODI
	select BR2_PACKAGE_LIBNSS
	help
	  Kodi inputstreamhelper script module

	  https://mirrors.kodi.tv/addons/matrix/script.module.inputstreamhelper/
```

## package/kodi-script-module-myconnpy/Config.in
```kconfig
config BR2_PACKAGE_KODI_SCRIPT_MODULE_MYCONNPY
	bool "kodi-script-module-myconnpy"
	default n
	depends on BR2_PACKAGE_KODI
	help
	  Kodi Myconnpy script module

	  https://kodi.tv
```

## package/kodi-script-module-python-twitch/Config.in
```kconfig
config BR2_PACKAGE_KODI_SCRIPT_MODULE_PYTHON_TWITCH
	bool "kodi-script-python-twitch"
	default n
	depends on BR2_PACKAGE_KODI
	select BR2_PACKAGE_PYTHON_SIX
	select BR2_PACKAGE_PYTHON_REQUESTS
	help
	  Kodi Python Twitch script module

	  https://kodi.wiki/view/Add-on:Python-twitch_for_Kodi
```

## package/kodi-script-module-requests/Config.in
```kconfig
config BR2_PACKAGE_KODI_SCRIPT_MODULE_REQUESTS
	bool "kodi-script-requests"
	default n
	depends on BR2_PACKAGE_KODI
	select BR2_PACKAGE_KODI_SCRIPT_MODULE_CERTIFI
	select BR2_PACKAGE_KODI_SCRIPT_MODULE_CHARDET
	select BR2_PACKAGE_KODI_SCRIPT_MODULE_IDNA
	select BR2_PACKAGE_KODI_SCRIPT_MODULE_URLLIB3
	help
	  Kodi Requests script module

	  https://gitlab.com/recalbox/recalbox-configgen/-/pipelines
```

## package/kodi-script-module-six/Config.in
```kconfig
config BR2_PACKAGE_KODI_SCRIPT_MODULE_SIX
	bool "kodi-script-six"
	default n
	depends on BR2_PACKAGE_KODI
	help
	  Kodi Six script module

	  https://kodi.wiki/view/Add-on:Six
```

## package/kodi-script-module-urllib3/Config.in
```kconfig
config BR2_PACKAGE_KODI_SCRIPT_MODULE_URLLIB3
	bool "kodi-script-module-urllib3"
	default n
	depends on BR2_PACKAGE_KODI
	help
	  Kodi Urllib3 script module

	  https://mirrors.kodi.tv/addons/matrix/script.module.urllib3/
```

## package/kodi-script.module.t0mm0.common/Config.in
```kconfig
config BR2_PACKAGE_KODI_SCRIPT_MODULE_T0MM0_COMMON
	bool "kodi-script.module.t0mm0.common"
	default y
	depends on BR2_PACKAGE_KODI
	help
	  Kodi Collection of commonly used addon routines

	  https://mirrors.kodi.tv/addons/leia/script.module.t0mm0.common/
```

## package/kodi-skin-confluence-480/Config.in
```kconfig
config BR2_PACKAGE_KODI_SKIN_CONFLUENCE_480
	bool "kodi-skin-confluence-480"
	default y
	depends on BR2_PACKAGE_KODI
	help
	  Kodi Skin Confluence 480

	  https://github.com/YggdrasiI/skin.confluence.480/
```

## package/lba-finder/Config.in
```kconfig
config BR2_PACKAGE_LBA_FINDER
	bool "lba-finder"
	help
	  lba-finder is a simple to get the first sector
	  of the first partition of a disk or image
```

## package/libgo2/Config.in
```kconfig
config BR2_PACKAGE_LIBGO2
	bool "libgo2"
	select BR2_PACKAGE_ALSA_LIB
	select BR2_PACKAGE_LIBEVDEV
	select BR2_PACKAGE_LIBDRM
	select BR2_PACKAGE_LIBPNG
	select BR2_PACKAGE_LIBRGA
	select BR2_PACKAGE_OPENAL
	help
	  libgo2 - Support library for the ODROID-GO Advance

	  https://github.com/OtherCrashOverride/libgo2
```

## package/liblcf/Config.in
```kconfig
config BR2_PACKAGE_LIBLCF
	bool "liblcf"
	select BR2_PACKAGE_EXPAT
	select BR2_PACKAGE_ICU
	help
	  Library to handle RPG Maker 2000 and 2003 game data.

	  https://github.com/EasyRPG/liblcf
```

## package/librelec-libmali/Config.in
```kconfig
config BR2_PACKAGE_LIBRELEC_LIBMALI
	bool "libmali"
	depends on BR2_arm || BR2_aarch64
	select BR2_PACKAGE_MALI_OPENGLES_SDK
	select BR2_PACKAGE_HAS_LIBEGL
	select BR2_PACKAGE_HAS_LIBGLES
	select BR2_PACKAGE_HAS_LIBGBM
	select BR2_PACKAGE_LIBDRM
	help
	  Install the binary user-space components for various
	  ARM Mali devices. This package requires a
	  kernel with the ARM Mali Midgard/Utgard/Panfrost GPU
	  Kernel Drivers enabled.

	  http://malideveloper.arm.com/resources/drivers/arm-mali-midgard-gpu-user-space-drivers

if BR2_PACKAGE_LIBRELEC_LIBMALI

config BR2_PACKAGE_PROVIDES_LIBEGL
	default "librelec-libmali"

config BR2_PACKAGE_PROVIDES_LIBGLES
	default "librelec-libmali"

config BR2_PACKAGE_PROVIDES_LIBGBM
	default "librelec-libmali"

choice
	prompt "GPU"
config BR2_PACKAGE_LIBRELEC_LIBMALI_T62X
	bool "mali t62x"
	depends on BR2_arm
	select BR2_PACKAGE_LIBGBM_HAS_FEATURE_DMA_BUF
	select BR2_PACKAGE_LIBDRM_EXYNOS
	select BR2_PACKAGE_WAYLAND
config BR2_PACKAGE_LIBRELEC_LIBMALI_G52
	bool "mali g52"
	select BR2_PACKAGE_LIBGBM_HAS_FEATURE_DMA_BUF
endchoice

config BR2_PACKAGE_LIBRELEC_LIBMALI_ARCH
	string
	default "arm-linux-gnueabihf" if BR2_arm
	default "aarch64-linux-gnu" if BR2_aarch64

config BR2_PACKAGE_LIBRELEC_LIBMALI_VARIANT
	string
	default "t620" if BR2_PACKAGE_LIBRELEC_LIBMALI_T62X
	default "g52" if BR2_PACKAGE_LIBRELEC_LIBMALI_G52

endif

comment "librelec-libmali"
	depends on !BR2_arm || !BR2_aarch64 || !BR2_PACKAGE_MALI_OPENGLES_SDK
```

## package/libretro-atari800/Config.in
```kconfig
config BR2_PACKAGE_LIBRETRO_ATARI800
        bool "libretro-atari800"
        depends on BR2_PACKAGE_RETROARCH
        depends on BR2_INSTALL_LIBSTDCPP
        select BR2_PACKAGE_RECALBOX_ROMFS_ATARI800
        select BR2_PACKAGE_RECALBOX_ROMFS_ATARI5200
        help
          A libretro ATARI800 E ATARI5200 emulator core.

          http://www.libretro.com

comment "LIBRETRO_ATARI800 needs a toolchain w/ C++"
        depends on !BR2_INSTALL_LIBSTDCPP
```

## package/libretro-beetle-psx-hw/Config.in
```kconfig
config BR2_PACKAGE_LIBRETRO_BEETLE_PSX_HW
	bool "libretro-beetle-psx-hw"
	depends on BR2_PACKAGE_RETROARCH
	depends on BR2_INSTALL_LIBSTDCPP
	help
	  An Enhanced libretro PSX emulator core for X86.

	  http://www.libretro.com

comment "LIBRETRO_BEETLE_PSX_HW needs a toolchain w/ C++"
	depends on !BR2_INSTALL_LIBSTDCPP
```

## package/libretro-beetle-psx/Config.in
```kconfig
config BR2_PACKAGE_LIBRETRO_BEETLE_PSX
	bool "libretro-beetle-psx"
	depends on BR2_PACKAGE_RETROARCH
	depends on BR2_INSTALL_LIBSTDCPP
	select BR2_PACKAGE_RECALBOX_ROMFS_PSX
	help
	  A libretro PSX emulator core.

	  http://www.libretro.com

comment "LIBRETRO_BEETLE_PSX needs a toolchain w/ C++"
	depends on !BR2_INSTALL_LIBSTDCPP
```

## package/libretro-beetle-wswan/Config.in
```kconfig
config BR2_PACKAGE_LIBRETRO_BEETLE_WSWAN
	bool "libretro-beetle-wswan"
	depends on BR2_PACKAGE_RETROARCH
	depends on BR2_INSTALL_LIBSTDCPP
	select BR2_PACKAGE_RECALBOX_ROMFS_WSWAN
	select BR2_PACKAGE_RECALBOX_ROMFS_WSWANC
	select BR2_PACKAGE_RECALBOX_ROMFS_PCV2
	help
	  A libretro Wonderswan/Pocket Challenge v2
	  emulator core for ARM.

	  http://www.libretro.com

comment "LIBRETRO_LIBRETRO_BEETLE_WSWAN needs a toolchain w/ C++"
	depends on !BR2_INSTALL_LIBSTDCPP
```

## package/libretro-bk-emulator/Config.in
```kconfig
config BR2_PACKAGE_LIBRETRO_BK_EMULATOR
	bool "libretro-bk-emulator"
	depends on BR2_PACKAGE_RETROARCH
	depends on BR2_INSTALL_LIBSTDCPP
	select BR2_PACKAGE_RECALBOX_ROMFS_BK
	help
	  A libretro BK computer serie emulator core.

	  http://www.libretro.com

comment "LIBRETRO_BK_EMULATOR needs a toolchain w/ C++"
	depends on !BR2_INSTALL_LIBSTDCPP
```

## package/libretro-bsnes/Config.in
```kconfig
config BR2_PACKAGE_LIBRETRO_BSNES
	bool "libretro-bsnes"
	depends on BR2_PACKAGE_RETROARCH
	depends on BR2_INSTALL_LIBSTDCPP
	depends on BR2_PACKAGE_RECALBOX_ROMFS2
	help
	  bsnes
	  Super Nintendo (SNES) emulator focused on performance, features, and ease of use.

	  http://www.libretro.com

comment "LIBRETRO_BSNES needs a toolchain w/ C++"
	depends on !BR2_INSTALL_LIBSTDCPP
```

## package/libretro-cdi2015/Config.in
```kconfig
config BR2_PACKAGE_LIBRETRO_CDI2015
	bool "libretro-cdi2015"
	depends on BR2_PACKAGE_RETROARCH
	depends on BR2_INSTALL_LIBSTDCPP
	select BR2_PACKAGE_ZLIB
	help
	  A libretro cdi2015.

	  http://www.libretro.com

comment "LIBRETRO_CDI2015 needs a toolchain w/ C++"
	depends on !BR2_INSTALL_LIBSTDCPP
```

## package/libretro-citra/Config.in
```kconfig
config BR2_PACKAGE_LIBRETRO_CITRA
        bool "libretro-citra"
	depends on BR2_PACKAGE_RETROARCH
	depends on BR2_INSTALL_LIBSTDCPP
	select BR2_PACKAGE_RECALBOX_ROMFS_3DS
        help
          A libretro Nintendo 3DS emulator core.

	  http://www.libretro.com

comment "LIBRETRO_FREEINTV needs a toolchain w/ C++"
	depends on !BR2_INSTALL_LIBSTDCPP
```

## package/libretro-crawl/Config.in
```kconfig
config BR2_PACKAGE_LIBRETRO_CRAWL
	bool "libretro-crawl"
	depends on BR2_PACKAGE_RETROARCH
	depends on BR2_INSTALL_LIBSTDCPP
	depends on BR2_PACKAGE_RECALBOX_ROMFS2
	help
	  A libretro roguelike adventure game.

	  http://www.libretro.com

comment "LIBRETRO_CRAWL needs a toolchain w/ C++"
	depends on !BR2_INSTALL_LIBSTDCPP
```

## package/libretro-crocods/Config.in
```kconfig
config BR2_PACKAGE_LIBRETRO_CROCODS
	bool "libretro-crocods"
	depends on BR2_PACKAGE_RETROARCH
	help
	  Another libretro AMSTRAD CPC emulator core.

	  https://github.com/libretro/libretro-crocods
```

## package/libretro-dcss/Config.in
```kconfig
config BR2_PACKAGE_LIBRETRO_DCSS
	bool "libretro-dcss"
	depends on BR2_PACKAGE_RETROARCH
	depends on BR2_INSTALL_LIBSTDCPP
	select BR2_PACKAGE_RECALBOX_ROMFS_DCSS
	help
	  A libretro rogue game.

	  http://www.libretro.com

comment "LIBRETRO_DCSS needs a toolchain w/ C++"
	depends on !BR2_INSTALL_LIBSTDCPP
```
