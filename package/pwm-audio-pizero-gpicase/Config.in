## package/pwm-audio-pizero-gpicase/Config.in
```kconfig
config BR2_PACKAGE_PWM_AUDIO_PIZERO_GPICASE
	bool "pwm-audio-pizero-gpicase"
	depends on BR2_PACKAGE_RPI_FIRMWARE
	help
	  pwm-audio-pizero-gpicase overlay to get audio thanks to PWMs
	  through GPIO Pins 18 and 19 on an Pi Zero equivalent
	  to dtoverlay=pwm-2chan,pin=18,func=2,pin2=19,func2=2
```

## package/python-openjvs/Config.in
```kconfig
config BR2_PACKAGE_PYTHON_OPENJVS
	bool "python-openjvs"
	depends on BR2_PACKAGE_PYTHON3_PY_PYC
	select BR2_PACKAGE_PYTHON_SERIAL # runtime
	select BR2_PACKAGE_PYTHON_UINPUT # runtime
	select BR2_PACKAGE_PYTHON_DAEMON # runtime
	help
	  Library used to support JVS arcade protocol.
```

## package/python-uinput/Config.in
```kconfig
config BR2_PACKAGE_PYTHON_UINPUT
	bool "python-uinput"
	depends on BR2_PACKAGE_PYTHON3_PY_PYC
	help
	  Library to used to emulate OTG joypad/keyboard/mice.
```

## package/raspi2png/Config.in
```kconfig
config BR2_PACKAGE_RASPI2PNG
	bool "raspi2png"
	depends on BR2_PACKAGE_LIBPNG
	depends on BR2_PACKAGE_RECALBOX_TARGET_RPI1 || BR2_PACKAGE_RECALBOX_TARGET_RPI2 || \
		BR2_PACKAGE_RECALBOX_TARGET_RPI3
	help
	  A tool for taking screenshots
	  https://github.com/AndrewFromMelbourne/raspi2png

comment "RASPI2PNG needs libpng"
	depends on !BR2_PACKAGE_LIBPNG
```

## package/rb5000/Config.in
```kconfig
config BR2_PACKAGE_RB5000
	bool "rb5000"
	select BR2_PACKAGE_SDL2
	select BR2_PACKAGE_SDL2_TTF
	help
	  Phillips VG 5000 Emulator

	  http://gitlab.com/bkg2k/rb5000

comment "Gsplus needs a toolchain w/ OpenGl, SDL2"
	depends on BR2_PACKAGE_SDL2
```

## package/recalbox-bluetooth/Config.in
```kconfig
config BR2_PACKAGE_RECALBOX_BLUETOOTH
	bool "recalbox bluetooth"
	select BR2_PACKAGE_PYTHON3
	select BR2_PACKAGE_PYTHON_GOBJECT
	select BR2_PACKAGE_DBUS_PYTHON
	select BR2_PACKAGE_BLUEZ5_UTILS
	select BR2_PACKAGE_SBC
	help
	  The bluetooth utilities for recalbox
```

## package/recalbox-bootia32/Config.in
```kconfig
config BR2_PACKAGE_RECALBOX_BOOTIA32
    bool "recalbox-bootia32"
    depends on BR2_x86_64 && BR2_TARGET_GRUB2
    help
      EFI 32 bit precompiled

comment "BOOTIA32 only for x86 64bits woth grub2"
```

## package/recalbox-check-resolution/Config.in
```kconfig
config BR2_PACKAGE_RECALBOX_CHECKRESOLUTION
	bool "recalbox check-resolution"
	depends on BR2_INSTALL_LIBSTDCPP
	select BR2_PACKAGE_SDL2
	help
	  A simple resolution check utility

	  https://github.com/recalbox/recalbox

comment "videomode needs a toolchain w/ C++ and SDL2"
	depends on !BR2_INSTALL_LIBSTDCPP || !BR2_PACKAGE_SDL2
```

## package/recalbox-configgen/Config.in
```kconfig
config BR2_PACKAGE_RECALBOX_CONFIGGEN
	bool "recalbox configgen"
	select BR2_PACKAGE_PYTHON3
	select BR2_PACKAGE_PYTHON_PYUDEV
	select BR2_PACKAGE_PYTHON_PYGAME
	select BR2_PACKAGE_PYTHON_PYGAME_IMAGE
	select BR2_PACKAGE_PYTHON_PYGAME_FONT
	help
	  The configuration utility for recalbox

	  https://gitlab.com/recalbox/recalbox-configgen
```

## package/recalbox-crt/Config.in
```kconfig
config BR2_PACKAGE_RECALBOX_CRT
	bool "recalbox crt"
	select BR2_PACKAGE_RECALBOX_RGB_DUAL
	select BR2_PACKAGE_RECALBOX_RGB_DUAL_GUNCON2

	help
	  Crt tv support for recalbox

	  https://gitlab.com/recalbox/recalbox
```

## package/recalbox-hardware/Config.in
```kconfig
config BR2_PACKAGE_RECALBOX_HARDWARE
	bool "recalbox hardware"
	depends on BR2_PACKAGE_RECALBOX_THEMES
	select BR2_PACKAGE_RECALBOX_PIBOY if (BR2_PACKAGE_RECALBOX_TARGET_RPI3 || BR2_PACKAGE_RECALBOX_TARGET_RPI4 || BR2_PACKAGE_RECALBOX_TARGET_RPI4_64)
	help
	  Hardware management.

	  https://gitlab.com/recalbox/recalbox-hardware
```

## package/recalbox-manager2/Config.in
```kconfig
config BR2_PACKAGE_RECALBOX_MANAGER2
	bool "recalbox-manager2"
	select BR2_PACKAGE_NODEJS
	help
	  A nodejs based web manager
	  https://github.com/djlechuck/recalbox-manager
```

## package/recalbox-manager3/Config.in
```kconfig
config BR2_PACKAGE_RECALBOX_MANAGER3
	bool "recalbox webmanager v3"
	depends on BR2_INSTALL_LIBSTDCPP
	help
	  Recalbox WebManager v3
	  https://gitlab.com/recalbox/recalbox-manager-v3

comment "RECALBOX_MANAGER3 needs a toolchain w/ C++"
	depends on !BR2_INSTALL_LIBSTDCPP
```

## package/recalbox-mplayer/Config.in
```kconfig
config BR2_PACKAGE_RECALBOX_MPLAYER
	bool "recalbox-mplayer"
	depends on BR2_TOOLCHAIN_HAS_SYNC_4
	depends on BR2_TOOLCHAIN_HAS_THREADS
	help
	  MPlayer is a movie player which runs on many systems and
	  supports many different file formats.

	  http://www.mplayerhq.hu/

comment "recalbox-mplayer needs a toolchain w/ threads"
	depends on BR2_TOOLCHAIN_HAS_SYNC_4
	depends on !BR2_TOOLCHAIN_HAS_THREADS
```

## package/recalbox-piboy/Config.in
```kconfig
config BR2_PACKAGE_RECALBOX_PIBOY
	bool "recalbox-piboy"
	help
	  PiBoy DMG tester
```

## package/recalbox-rgb-dual-guncon2/Config.in
```kconfig
config BR2_PACKAGE_RECALBOX_RGB_DUAL_GUNCON2
	bool "Guncon drivers for Recalbox RGB Dual"
	depends on BR2_LINUX_KERNEL
	select DRM_KMS_HELPER
	help
	    Based on https://github.com/beardypig/guncon2 Guncon2 Driver for linux

comment "Guncon Drivers needs a kernel and headers"
	depends on !BR2_LINUX_KERNEL
```

## package/recalbox-rgb-dual/Config.in
```kconfig
config BR2_PACKAGE_RECALBOX_RGB_DUAL
	bool "Recalbox RGB Dual dts and driver"
	depends on BR2_LINUX_KERNEL
	select DRM_KMS_HELPER
	help
	  Support for Recalbox RGB Dual, the dual scart and vga dac
	  for Rasbperry Pi 4, 400, 3 and Zero2

comment "Recalbox RGB Dual needs a kernel and headers"
	depends on !BR2_LINUX_KERNEL
```

## package/recalbox-rockchip-mali-bifrost-vulkan/Config.in
```kconfig
config BR2_PACKAGE_RECALBOX_ROCKCHIP_MALI_BIFROST_VULKAN
	bool "Enable Bifrost Vulkan support"
	depends on BR2_PACKAGE_RECALBOX_ROCKCHIP_MALI_BIFROST_GBM
	depends on BR2_arm || BR2_aarch64
	select BR2_PACKAGE_HAS_LIBEGL
	select BR2_PACKAGE_HAS_LIBGLES
	select BR2_PACKAGE_HAS_LIBGBM
	help
	  Add Vulkan support

if BR2_PACKAGE_RECALBOX_ROCKCHIP_MALI_BIFROST_VULKAN

config BR2_PACKAGE_PROVIDES_LIBEGL
	default "recalbox-rockchip-mali-bifrost-vulkan"

config BR2_PACKAGE_PROVIDES_LIBGLES
	default "recalbox-rockchip-mali-bifrost-vulkan"

config BR2_PACKAGE_PROVIDES_LIBGBM
	default "recalbox-rockchip-mali-bifrost-vulkan"

endif

comment "Mali Rockchip Bifrost Vulkan"
	depends on !BR2_arm && !BR2_aarch64
```

## package/recalbox-rockchip-mali/Config.in
```kconfig
menuconfig BR2_PACKAGE_RECALBOX_ROCKCHIP_MALI
	bool "Mali Rockchip"
	depends on BR2_arm || BR2_aarch64
	select BR2_PACKAGE_HAS_LIBEGL
	select BR2_PACKAGE_HAS_LIBGLES
	select BR2_PACKAGE_HAS_LIBGBM
	select BR2_PACKAGE_LIBDRM
	help
	  The Mali GPU library used in Rockchip Platform.
	  Supported GPU: bifrost, midgard, utgard, valhall.

if BR2_PACKAGE_RECALBOX_ROCKCHIP_MALI

choice
	prompt "Platform/GPU"
config BR2_PACKAGE_RECALBOX_ROCKCHIP_MALI_BIFROST_G31
	bool "bifrost g31"
config BR2_PACKAGE_RECALBOX_ROCKCHIP_MALI_BIFROST_G52
	bool "bifrost g52"
config BR2_PACKAGE_RECALBOX_ROCKCHIP_MALI_MIDGARD
	bool "midgard t86x"
config BR2_PACKAGE_RECALBOX_ROCKCHIP_MALI_UTGARD
	bool "utgard 450"
config BR2_PACKAGE_RECALBOX_ROCKCHIP_MALI_VALHALL
	bool "valhall g610"
endchoice

# mali bifrost g31
choice
	prompt "bifrost g31 version"
	depends on BR2_PACKAGE_RECALBOX_ROCKCHIP_MALI_BIFROST_G31
config BR2_PACKAGE_RECALBOX_ROCKCHIP_MALI_LIB_VERSION_G31_G2P0
	bool "mali g31 g2p0"
config BR2_PACKAGE_RECALBOX_ROCKCHIP_MALI_LIB_VERSION_G31_R13P0
	bool "mali g31 r13p0"
	help
	  libmali g31 version r13p0
	  GBM only with Vulkan support
endchoice

if BR2_PACKAGE_RECALBOX_ROCKCHIP_MALI_LIB_VERSION_G31_G2P0
config BR2_PACKAGE_RECALBOX_ROCKCHIP_MALI_LIB_VERSION
	string
	default "g2p0"
endif

if BR2_PACKAGE_RECALBOX_ROCKCHIP_MALI_LIB_VERSION_G31_R13P0
config BR2_PACKAGE_RECALBOX_ROCKCHIP_MALI_LIB_VERSION
	string
	default "r13p0"
endif

# mali bifrost g52
choice
	prompt "bifrost g52 version"
	depends on BR2_PACKAGE_RECALBOX_ROCKCHIP_MALI_BIFROST_G52
config BR2_PACKAGE_RECALBOX_ROCKCHIP_MALI_LIB_VERSION_G52_G2P0
	bool "mali g52 g2p0"
endchoice

if BR2_PACKAGE_RECALBOX_ROCKCHIP_MALI_LIB_VERSION_G52_G2P0
config BR2_PACKAGE_RECALBOX_ROCKCHIP_MALI_LIB_VERSION
	string
	default "g2p0"
endif

# mali midgard t86x
choice
	prompt "bifrost g52 version"
	depends on BR2_PACKAGE_RECALBOX_ROCKCHIP_MALI_MIDGARD
config BR2_PACKAGE_RECALBOX_ROCKCHIP_MALI_LIB_VERSION_T86X_R18P0
	bool "mali t86x r18p0"
endchoice

if BR2_PACKAGE_RECALBOX_ROCKCHIP_MALI_LIB_VERSION_T860X_R18P0
config BR2_PACKAGE_RECALBOX_ROCKCHIP_MALI_LIB_VERSION
	string
	default "r18p0"
endif

# mali utgard 450
choice
	prompt "utgard 450 version"
	depends on BR2_PACKAGE_RECALBOX_ROCKCHIP_MALI_UTGARD
config BR2_PACKAGE_RECALBOX_ROCKCHIP_MALI_LIB_VERSION_450_R7P0
	bool "mali 450 r7p0"
endchoice

if BR2_PACKAGE_RECALBOX_ROCKCHIP_MALI_LIB_VERSION_450_R17P0
config BR2_PACKAGE_RECALBOX_ROCKCHIP_MALI_LIB_VERSION
	string
	default "r7p0"
endif

# mali valhall g610
choice
	prompt "valhall g610 version"
	depends on BR2_PACKAGE_RECALBOX_ROCKCHIP_MALI_VALHALL
config BR2_PACKAGE_RECALBOX_ROCKCHIP_MALI_LIB_VERSION_G610_G6P0
	bool "mali g610 g6p0"
endchoice

if BR2_PACKAGE_RECALBOX_ROCKCHIP_MALI_LIB_VERSION_G610_G6P0
config BR2_PACKAGE_RECALBOX_ROCKCHIP_MALI_LIB_VERSION
	string
	default "g6p0"
endif

config BR2_PACKAGE_PROVIDES_LIBEGL
	default "recalbox-rockchip-mali"

config BR2_PACKAGE_PROVIDES_LIBGLES
	default "recalbox-rockchip-mali"

config BR2_PACKAGE_PROVIDES_LIBGBM
	default "recalbox-rockchip-mali"

endif

comment "Mali Rockchip"
	depends on !BR2_arm && !BR2_aarch64
```

## package/recalbox-romfs/Config.in
```kconfig
# Recalbox-roms main package
source "$BR2_EXTERNAL_RECALBOX_PATH/package/recalbox-romfs/recalbox-romfs/Config.in"

menu "Rom dirs and xml"
source "$BR2_EXTERNAL_RECALBOX_PATH/package/recalbox-romfs/recalbox-romfs-thepowdertoy/Config.in"
source "$BR2_EXTERNAL_RECALBOX_PATH/package/recalbox-romfs/recalbox-romfs-uzebox/Config.in"
endmenu
```

## package/recalbox-romfs/recalbox-romfs-2048/Config.in
```kconfig
config BR2_PACKAGE_RECALBOX_ROMFS_2048
	bool "recalbox-romfs-2048"
	select BR2_PACKAGE_RECALBOX_ROMS
	depends on BR2_PACKAGE_LIBRETRO_2048
	help
	  share_init/roms and xml for 2048
```

## package/recalbox-romfs/recalbox-romfs-3do/Config.in
```kconfig
config BR2_PACKAGE_RECALBOX_ROMFS_3DO
	bool "recalbox-romfs-3do"
	select BR2_PACKAGE_RECALBOX_ROMS
	depends on BR2_PACKAGE_LIBRETRO_OPERA
	help
	  share_init/roms and xml for 3do
```

## package/recalbox-romfs/recalbox-romfs-3ds/Config.in
```kconfig
config BR2_PACKAGE_RECALBOX_ROMFS_3DS
	bool "recalbox-romfs-3ds"
	select BR2_PACKAGE_RECALBOX_ROMS
	depends on BR2_PACKAGE_LIBRETRO_CITRA
	help
	  share_init/roms and xml for 3ds
```

## package/recalbox-romfs/recalbox-romfs-64dd/Config.in
```kconfig
config BR2_PACKAGE_RECALBOX_ROMFS_64DD
	bool "recalbox-romfs-64dd"
	select BR2_PACKAGE_RECALBOX_ROMS
	depends on BR2_PACKAGE_LIBRETRO_PARALLEL_N64
	help
	  share_init/roms and xml for 64dd
```

## package/recalbox-romfs/recalbox-romfs-amiga1200/Config.in
```kconfig
config BR2_PACKAGE_RECALBOX_ROMFS_AMIGA1200
	bool "recalbox-romfs-amiga1200"
	select BR2_PACKAGE_RECALBOX_ROMS
	depends on BR2_PACKAGE_AMIBERRY \
	  || BR2_PACKAGE_LIBRETRO_UAE
	help
	  share_init/roms and xml for amiga1200
```
