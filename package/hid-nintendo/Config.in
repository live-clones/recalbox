## package/hid-nintendo/Config.in
```kconfig
config BR2_PACKAGE_HID_NINTENDO
	bool "hid-nintendo"
	depends on BR2_LINUX_KERNEL
	help
	  A Nintendo HID kernel module.
```

## package/hyperion-ng/Config.in
```kconfig
config BR2_PACKAGE_HYPERION_NG
	bool "hyperion-ng"
	depends on BR2_INSTALL_LIBSTDCPP
	select BR2_PACKAGE_PYTHON3
	select BR2_PACKAGE_QT5SERIALPORT
	help
	  Hyperion is an open source ambient light software.
	  https://github.com/hyperion-project/hyperion

comment "Hyperion-ng needs BR2_INSTALL_LIBSTDCPP BR2_PACKAGE_QT5SERIALPORT"
	depends on !BR2_INSTALL_LIBSTDCPP || !BR2_PACKAGE_QT5SERIALPORT
```

## package/hyperion/Config.in
```kconfig
config BR2_PACKAGE_HYPERION
	bool "Hyperion"
	depends on BR2_INSTALL_LIBSTDCPP
	depends on BR2_PACKAGE_LIBUSB
	depends on BR2_PACKAGE_QT5BASE
	depends on BR2_PACKAGE_QT5BASE_GUI
	depends on BR2_PACKAGE_QT5BASE_NETWORK
	depends on BR2_PACKAGE_QT5BASE_WIDGETS
	depends on BR2_PACKAGE_RPI_FIRMWARE
	depends on BR2_PACKAGE_RPI_USERLAND
	depends on BR2_PACKAGE_PROTOBUF
	help
	  Hyperion is an open source ambient light software.
	  https://github.com/hyperion-project/hyperion

comment "Hyperion needs LIBUSB, QT5BASE, QT5BASE_GUI, QT5BASE_NETWPORK, QT5BASE_WIDGETS, PROTOBUF, and RPI_FIRMWARE"
	depends on !BR2_INSTALL_LIBSTDCPP || !BR2_PACKAGE_LIBUSB || !BR2_PACKAGE_QT5_GUI_MODULE || \
	  !BR2_PACKAGE_QT5BASE || !BR2_PACKAGE_QT5BASE_NETWORK || !BR2_PACKAGE_QT5BASE_GUI || \
	  !BR2_PACKAGE_QT5BASE_WIDGETS || !BR2_PACKAGE_RPI_FIRMWARE || !BR2_PACKAGE_RPI_USERLAND || \
	  !BR2_PACKAGE_PROTOBUF
```

## package/hypseus/Config.in
```kconfig
config BR2_PACKAGE_HYPSEUS
	bool "Hypseus (Daphne fork)"
	depends on BR2_INSTALL_LIBSTDCPP
	depends on BR2_PACKAGE_SDL2
	select BR2_PACKAGE_LIBOGG
	select BR2_PACKAGE_LIBVORBIS
	select BR2_PACKAGE_ZLIB
	select BR2_PACKAGE_SDL2_IMAGE
	select BR2_PACKAGE_SDL2_TTF
	select BR2_PACKAGE_LIBMPEG2
	help
	  Hypseus is a fork of Matt Ownby's Daphne.
	  A program that "lets one play the original versions
	  of many laserdisc arcade games on one's PC."

	  https://github.com/DirtBagXon/hypseus-singe

comment "Hypseus  needs a toolchain w/ C++,  SDL2"
	depends on !BR2_INSTALL_LIBSTDCPP || !BR2_PACKAGE_SDL2
```

## package/joycond/Config.in
```kconfig
config BR2_PACKAGE_JOYCOND
	bool "joycond"
	depends on BR2_PACKAGE_HAS_UDEV
	select BR2_PACKAGE_LIBEVDEV
	select BR2_PACKAGE_HID_NINTENDO
	help
	  joycond is a linux daemon which uses the evdev devices
	  provided by hid-nintendo (formerly known as hid-joycon)
	  to implement joycon pairing.
```

## package/kmsgrab/Config.in
```kconfig
config BR2_PACKAGE_KMSGRAB
	bool "kmsgrab"
	select BR2_PACKAGE_LIBPNG
	select BR2_PACKAGE_LIBDRM
	help
	  Simple screenshot tool for DRM/KMS drivers.

	  https://github.com/pcercuei/kmsgrab
```

## package/kodi-plugin-script-future/Config.in
```kconfig
config BR2_PACKAGE_KODI_PLUGIN_SCRIPT_FUTURE
	bool "kodi-plugin-script-future"
	default n
	depends on BR2_PACKAGE_KODI
	help
	  Kodi Future script plugin

	  https://kodi.wiki/view/Add-on:Future
```

## package/kodi-plugin-script-inputstreamhelper/Config.in
```kconfig
config BR2_PACKAGE_KODI_PLUGIN_SCRIPT_INPUTSTREAMHELPER
	bool "kodi-plugin-script-inputstreamhelper"
	default n
	depends on BR2_PACKAGE_KODI
	help
	  Kodi inputstreamhelper script plugin

	  https://kodi.wiki/view/Add-on:InputStream_Helper
```

## package/kodi-plugin-video-embycon/Config.in
```kconfig
config BR2_PACKAGE_KODI_PLUGIN_VIDEO_EMBYCON
	depends on BR2_PACKAGE_KODI
	select BR2_PACKAGE_PYTHON_HASHLIB
	bool "kodi-plugin-video-embycon"
	default y
	help
	  Kodi EmbyCon Plugin

	  https://github.com/faush01/plugin.video.embycon
```

## package/kodi-plugin-video-netflix/Config.in
```kconfig
config BR2_PACKAGE_KODI_PLUGIN_VIDEO_NETFLIX
	bool "kodi-plugin-video-netflix"
	default y
	depends on BR2_PACKAGE_KODI
	select BR2_PACKAGE_KODI_PLUGIN_SCRIPT_ADDON_SIGNALS
	select BR2_PACKAGE_PYTHON_SIX
	select BR2_PACKAGE_PYTHON_PYCRYPTODOMEX
	select BR2_PACKAGE_KODI_SCRIPT_MODULE_ADDON_SIGNALS
	select BR2_PACKAGE_KODI_SCRIPT_MODULE_INPUTSTREAMHELPER
	select BR2_PACKAGE_KODI_SCRIPT_MODULE_FUTURE
	select BR2_PACKAGE_KODI_SCRIPT_MODULE_REQUESTS
	help
	  Kodi Netflix Plugin

	  source https://github.com/CastagnaIT/plugin.video.netflix/
```

## package/kodi-plugin-video-twitch/Config.in
```kconfig
config BR2_PACKAGE_KODI_PLUGIN_VIDEO_TWITCH
	bool "kodi-plugin-video-twitch"
	default y
	depends on BR2_PACKAGE_KODI
	select BR2_PACKAGE_PYTHON_SIX
	select BR2_PACKAGE_PYTHON_REQUESTS
	select BR2_PACKAGE_KODI_SCRIPT_MODULE_PYTHON_TWITCH
	help
	  Kodi Twitch Plugin

	  source https://kodi.tv/addon/plugins-video-add-ons/twitch
```

## package/kodi-plugin-video-youtube/Config.in
```kconfig
config BR2_PACKAGE_KODI_PLUGIN_VIDEO_YOUTUBE
	bool "kodi-plugin-video-youtube"
	default y
	depends on BR2_PACKAGE_KODI
	select BR2_PACKAGE_PYTHON_SIX
	select BR2_PACKAGE_PYTHON_REQUESTS
	help
	  Kodi Youtube Plugin

	  https://kodi.tv/addon/plugins-video-add-ons/youtube
```

## package/kodi-resource-language-de_de/Config.in
```kconfig
config BR2_PACKAGE_KODI_RESOURCE_LANGUAGE_DE_DE
	bool "kodi-resource-language-de_de"
	default y
	depends on BR2_PACKAGE_KODI
	help
	  Kodi German language resource

	  https://mirrors.kodi.tv/addons/matrix/resource.language.de_de/
```

## package/kodi-resource-language-es_es/Config.in
```kconfig
config BR2_PACKAGE_KODI_RESOURCE_LANGUAGE_ES_ES
	bool "kodi-resource-language-es_es"
	default y
	depends on BR2_PACKAGE_KODI
	help
	  Kodi Spanish language resource

	  https://mirrors.kodi.tv/addons/matrix/resource.language.es_es/
```

## package/kodi-resource-language-eu_es/Config.in
```kconfig
config BR2_PACKAGE_KODI_RESOURCE_LANGUAGE_EU_ES
	bool "kodi-resource-language-eu_es"
	default y
	depends on BR2_PACKAGE_KODI
	help
	  Kodi Basque language resource

	  https://mirrors.kodi.tv/addons/matrix/resource.language.eu_es/
```

## package/kodi-resource-language-fr_fr/Config.in
```kconfig
config BR2_PACKAGE_KODI_RESOURCE_LANGUAGE_FR_FR
	bool "kodi-resource-language-fr_fr"
	default y
	depends on BR2_PACKAGE_KODI
	help
	  Kodi French language resource

	  https://mirrors.kodi.tv/addons/matrix/resource.language.fr_fr/
```

## package/kodi-resource-language-it_it/Config.in
```kconfig
config BR2_PACKAGE_KODI_RESOURCE_LANGUAGE_IT_IT
	bool "kodi-resource-language-it_it"
	default y
	depends on BR2_PACKAGE_KODI
	help
	  Kodi Italian language resource

	  https://mirrors.kodi.tv/addons/matrix/resource.language.it_it/
```

## package/kodi-resource-language-pt_br/Config.in
```kconfig
config BR2_PACKAGE_KODI_RESOURCE_LANGUAGE_PT_BR
	bool "kodi-resource-language-pt_br"
	default y
	depends on BR2_PACKAGE_KODI
	help
	  Kodi Portuguese (Brazil) language resource

	  https://mirrors.kodi.tv/addons/matrix/resource.language.pt_br/
```

## package/kodi-resource-language-sv_se/Config.in
```kconfig
config BR2_PACKAGE_KODI_RESOURCE_LANGUAGE_SV_SE
	bool "kodi-resource-language-sv_se"
	default y
	depends on BR2_PACKAGE_KODI
	help
	  Kodi Swedish language resource

	  https://mirrors.kodi.tv/addons/matrix/resource.language.sv_se/
```

## package/kodi-resource-language-tr_tr/Config.in
```kconfig
config BR2_PACKAGE_KODI_RESOURCE_LANGUAGE_TR_TR
	bool "kodi-resource-language-tr_tr"
	default y
	depends on BR2_PACKAGE_KODI
	help
	  Kodi Turkish language resource

	  https://mirrors.kodi.tv/addons/matrix/resource.language.tr_tr/
```

## package/kodi-resource-language-zh_cn/Config.in
```kconfig
config BR2_PACKAGE_KODI_RESOURCE_LANGUAGE_ZH_CN
	bool "kodi-resource-language-zh_cn"
	default y
	depends on BR2_PACKAGE_KODI
	help
	  Kodi Chinese (Simple) language resource

	  https://mirrors.kodi.tv/addons/matrix/resource.language.zh_cn/
```

## package/kodi-script-addon-signals/Config.in
```kconfig
config BR2_PACKAGE_KODI_SCRIPT_ADDON_SIGNALS
	bool "kodi-script-addon-signals"
	default n
	depends on BR2_PACKAGE_KODI
	help
	  Kodi Addon Signals plugin

	  https://kodi.wiki/view/Add-on:Addon_Signals
```

## package/kodi-script-module-addon-signals/Config.in
```kconfig
config BR2_PACKAGE_KODI_SCRIPT_MODULE_ADDON_SIGNALS
	bool "kodi-script-module-addon-signals"
	default n
	depends on BR2_PACKAGE_KODI
	help
	  Kodi Addon Signals script

	  https://mirrors.kodi.tv/addons/matrix/script.module.addon.signals/
```

## package/kodi-script-module-certifi/Config.in
```kconfig
config BR2_PACKAGE_KODI_SCRIPT_MODULE_CERTIFI
	bool "kodi-script-module-certifi"
	default n
	depends on BR2_PACKAGE_KODI
	help
	  Kodi Certifi script module

	  https://mirrors.kodi.tv/addons/matrix/script.module.certifi/
```

## package/kodi-script-module-chardet/Config.in
```kconfig
config BR2_PACKAGE_KODI_SCRIPT_MODULE_CHARDET
	bool "kodi-script-module-chardet"
	default n
	depends on BR2_PACKAGE_KODI
	help
	  Kodi Chardet script module

	  https://mirrors.kodi.tv/addons/matrix/script.module.chardet/
```
