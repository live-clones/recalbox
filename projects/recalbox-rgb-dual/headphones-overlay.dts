/dts-v1/;
/plugin/;

/ {
	compatible = "brcm,bcm2835", "brcm,bcm2708", "brcm,bcm2709";

	fragment@0 {
		target = <&audio_pins>;
		__overlay__ {
			brcm,pins = < 40 41 >;
			brcm,function = < 4 >;
		};
	};

	fragment@1 {
		target = <&audio>;
		__overlay__  {
			brcm,disable-headphones = <0>;
		};
	};
	
};
