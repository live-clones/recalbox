## package/dolphin-emu/Config.in
```kconfig
config BR2_PACKAGE_DOLPHIN_EMU
	bool "dolphin-emu"
	depends on BR2_x86_64
	depends on BR2_PACKAGE_XORG7
	select BR2_PACKAGE_LIBEVDEV
	select BR2_PACKAGE_FFMPEG
	select BR2_PACKAGE_ZLIB
	select BR2_PACKAGE_LIBPNG
	select BR2_PACKAGE_LZO
	select BR2_PACKAGE_LIBUSB
	select BR2_PACKAGE_LIBCURL
	select BR2_PACKAGE_SFML
	select BR2_PACKAGE_BLUEZ5_UTILS
	select BR2_PACKAGE_CAIRO_SCRIPT
	select BR2_PACKAGE_HIDAPI
	select BR2_PACKAGE_QT5_VERSION_LATEST
	select BR2_PACKAGE_QT5
	select BR2_PACKAGE_QT5BASE
	select BR2_PACKAGE_QT5BASE_OPENGL
	select BR2_PACKAGE_QT5BASE_XCB
	select BR2_PACKAGE_QT5BASE_EGLFS
	select BR2_PACKAGE_QT5BASE_FONTCONFIG
	select BR2_PACKAGE_QT5BASE_GUI
	select BR2_PACKAGE_QT5BASE_WIDGETS
	select BR2_PACKAGE_HICOLOR_ICON_THEME
	select BR2_PACKAGE_QT5BASE_GIF
	select BR2_PACKAGE_QT5BASE_JPEG
	select BR2_PACKAGE_QT5BASE_PNG
	help
	  A  Nintendo GameCube/Wii emulator.
	  https://github.com/dolphin-emu/dolphin

comment "Dolphin needs x86_64, XORG7"
	depends on !BR2_x86_64 || !BR2_PACKAGE_XORG7
```

## package/drmadapter/Config.in
```kconfig
config BR2_PACKAGE_DRMADAPTER
	bool "drmadapter"
	depends on BR2_INSTALL_LIBSTDCPP
	help
	  A Firmware to kernel video parameter adapter

	  https://gitlab.com/recalbox/recalbox-drm-video-adapter

comment "Emulation station 2 needs a toolchain w/ C++ SDL2"
	depends on !BR2_INSTALL_LIBSTDCPP
```

## package/duckstation/Config.in
```kconfig
config BR2_PACKAGE_DUCKSTATION
	bool "duckstation"
	depends on BR2_PACKAGE_HAS_LIBEGL
	select BR2_PACKAGE_FMT
	select BR2_PACKAGE_BOOST
	select BR2_PACKAGE_FFMPEG
	select BR2_PACKAGE_SDL2
	select BR2_PACKAGE_LIBEVDEV
	select BR2_PACKAGE_LIBDRM if !BR2_PACKAGE_RECALBOX_TARGET_RPI1 && !BR2_PACKAGE_RECALBOX_TARGET_RPI3
	help
	  DuckStation - PlayStation 1 Emulator

	  https://github.com/stenzek/duckstation

comment "PCSX_REARMED needs a toolchain w/ C++"
	depends on !BR2_INSTALL_LIBSTDCPP
```

## package/eepromutils/Config.in
```kconfig
config BR2_PACKAGE_EEPROMUTILS
	bool "eepromutils"
	help
	  Utils for eeprom
	  https://github.com/raspberrypi/hats/tree/master/eepromutils
```

## package/fbv-recalbox/Config.in
```kconfig
config BR2_PACKAGE_FBV_RECALBOX
	bool "fbv-recalbox"
	select BR2_PACKAGE_LIBPNG
	select BR2_PACKAGE_JPEG
	select BR2_PACKAGE_GIFLIB
	help
	  fbv is a very simple graphic file viewer for the framebuffer
	  console, capable of displaying GIF, JPEG, PNG and BMP files
	  using libungif, libjpeg and libpng.

	  http://freshmeat.net/projects/fbv/
```

## package/frotz-recalbox/Config.in
```kconfig
config BR2_PACKAGE_FROTZ
	bool "beebem"
	depends on BR2_INSTALL_LIBSTDCPP
	select BR2_PACKAGE_SDL2
	help
	  A ZMachine emulator

	  https://gitlab.com/DavidGriffith/frotz

comment "Frotz needs a toolchain w/ C++ SDL2"
	depends on !BR2_INSTALL_LIBSTDCPP || !BR2_PACKAGE_SDL2
```

## package/go-ipfs/Config.in
```kconfig
config BR2_PACKAGE_GO_IPFS
	bool "go-ipfs"
	depends on BR2_PACKAGE_HOST_GO_TARGET_ARCH_SUPPORTS
	depends on BR2_PACKAGE_HOST_GO_TARGET_CGO_LINKING_SUPPORTS
	depends on BR2_TOOLCHAIN_HAS_THREADS
	select BR2_PACKAGE_OPENSSL

	help
	  IPFS is a global, versioned, peer-to-peer filesystem.
	  IPFS provides an interface as simple as the HTTP web,
	  but with permanence built-in.
	  You can also mount the world at /ipfs.

	  https://ipfs.io

comment "go-ipfs needs a toolchain w/ threads"
	depends on BR2_PACKAGE_HOST_GO_TARGET_ARCH_SUPPORTS
	depends on BR2_PACKAGE_HOST_GO_TARGET_CGO_LINKING_SUPPORTS
	depends on !BR2_TOOLCHAIN_HAS_THREADS
```

## package/gsplus/Config.in
```kconfig
config BR2_PACKAGE_GSPLUS
	bool "gsplus"
	select BR2_PACKAGE_SDL2
	select BR2_PACKAGE_LIBPCAP
	help
	  Apple II GS emulator

	  http://www.apple2.gs/plus

comment "Gsplus needs a toolchain w/ OpenGl, SDL2"
	depends on BR2_PACKAGE_SDL2
```

## package/guichan/Config.in
```kconfig
config BR2_PACKAGE_GUICHAN
	depends on BR2_PACKAGE_SDL
	select BR2_PACKAGE_SDL_IMAGE
        bool "guichan"
        help
          A tiny GUI library


comment "Guichan depends on SDL"
	depends on !(BR2_PACKAGE_SDL)
```

## package/hatari/Config.in
```kconfig
config BR2_PACKAGE_HATARI
	bool "recalbox Emulationstation 2"
	depends on BR2_INSTALL_LIBSTDCPP
	select BR2_PACKAGE_SDL2
	select BR2_PACKAGE_LIBZIP
	select BR2_PACKAGE_MTOOLS
	help
	  Atari ST/STE/TT/Falcon emulator.

	  https://hatari.tuxfamily.org/

comment "Emulation station 2 needs a toolchain w/ C++, ALSA and SDL2"
	depends on !BR2_INSTALL_LIBSTDCPP || !BR2_PACKAGE_SDL2
```

## package/hhpc/Config.in
```kconfig
config BR2_PACKAGE_HHPC
	bool "hhpc"
	depends on BR2_PACKAGE_XSERVER_XORG_SERVER
	help
	  A small utility to hide the mouse pointer with X.org (X11).

	  https://github.com/aktau/hhpc

comment "hhpc depends on BR2_PACKAGE_XSERVER_XORG_SERVER"
	depends on !BR2_PACKAGE_XSERVER_XORG_SERVER
```
