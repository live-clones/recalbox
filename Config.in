## configs/recalbox-odroidgo2_defconfig
```kconfig
BR2_aarch64=y
BR2_cortex_a35=y
BR2_OPTIMIZE_3=y
BR2_SHARED_STATIC_LIBS=y
BR2_GLOBAL_PATCH_DIR="$(BR2_EXTERNAL_RECALBOX_PATH)/board/recalbox/patches $(BR2_EXTERNAL_RECALBOX_PATH)/board/recalbox/odroidgo2/patches"
BR2_TOOLCHAIN_BUILDROOT_GLIBC=y
BR2_KERNEL_HEADERS_VERSION=y
BR2_DEFAULT_KERNEL_VERSION="4.4"
BR2_PACKAGE_HOST_LINUX_HEADERS_CUSTOM_4_4=y
BR2_GCC_VERSION_10_X=y
BR2_GCC_ENABLE_OPENMP=y
BR2_GCC_ENABLE_LTO=y
BR2_BINUTILS_VERSION_2_35_X=y
BR2_TOOLCHAIN_BUILDROOT_CXX=y
BR2_GCC_ENABLE_GRAPHITE=y
BR2_TARGET_OPTIMIZATION="-pipe -fsigned-char"
BR2_TARGET_GENERIC_HOSTNAME="RECALBOX"
BR2_TARGET_GENERIC_ISSUE="PLAY AGAIN"
BR2_INIT_SYSV=y
BR2_ROOTFS_DEVICE_CREATION_DYNAMIC_EUDEV=y
BR2_TARGET_GENERIC_ROOT_PASSWD="recalboxroot"
BR2_SYSTEM_BIN_SH_BASH=y
BR2_TARGET_GENERIC_GETTY_PORT="tty1"
BR2_TARGET_GENERIC_GETTY_BAUDRATE_115200=y
# BR2_TARGET_GENERIC_REMOUNT_ROOTFS_RW is not set
BR2_ENABLE_LOCALE_WHITELIST="C ar ca cs de el en en_US es eu_ES fr gl_ES hu it ja_JP ko lb_LU lt_LT lv_LV nb nn_NO nl no pl pt pt_BR ro ru_RU sv_SE tr uk_UA zh_CN zh_TW"
BR2_GENERATE_LOCALE="en_US.UTF-8 ar_YE.UTF-8 ca_ES.UTF-8 cs_CZ.UTF-8 de_DE.UTF-8 el_GR.UTF-8 es_ES.UTF-8 eu_ES.UTF-8 fr_FR.UTF-8 hu_HU.UTF-8 it_IT.UTF-8 ja_JP.UTF-8 ko_KR.UTF-8 lb_LU.UTF-8 lv_LV.UTF-8 nb_NO.UTF-8 nn_NO.UTF-8 nl_NL.UTF-8 pl_PL.UTF-8 pt_BR.UTF-8 ru_RU.UTF-8 sv_SE.UTF-8 tr_TR.UTF-8 zh_CN.UTF-8 zh_TW.UTF-8"
BR2_TARGET_TZ_INFO=y
BR2_TARGET_LOCALTIME="Europe/Paris"
BR2_ROOTFS_OVERLAY="$(BR2_EXTERNAL_RECALBOX_PATH)/board/recalbox/fsoverlay $(BR2_EXTERNAL_RECALBOX_PATH)/board/recalbox/odroidgo2/fsoverlay"
BR2_ROOTFS_POST_BUILD_SCRIPT="$(BR2_EXTERNAL_RECALBOX_PATH)/board/recalbox/recalbox-patch-target.sh"
BR2_ROOTFS_POST_IMAGE_SCRIPT="$(BR2_EXTERNAL_RECALBOX_PATH)/board/recalbox/copy-recalbox-archives.sh"
BR2_LINUX_KERNEL=y
BR2_LINUX_KERNEL_CUSTOM_GIT=y
BR2_LINUX_KERNEL_CUSTOM_REPO_URL="https://github.com/hardkernel/linux.git"
BR2_LINUX_KERNEL_CUSTOM_REPO_VERSION="fbfe5c30bf5643f44cc8c87c9b53b1ba2a0bfa49"
BR2_LINUX_KERNEL_PATCH="$(BR2_EXTERNAL_RECALBOX_PATH)/board/recalbox/kernel_patches/$(BR2_TOOLCHAIN_HEADERS_AT_LEAST) $(BR2_EXTERNAL_RECALBOX_PATH)/board/recalbox/odroidgo2/kernel_patches/$(BR2_TOOLCHAIN_HEADERS_AT_LEAST)"
BR2_LINUX_KERNEL_DEFCONFIG="odroidgoa"
BR2_LINUX_KERNEL_CONFIG_FRAGMENT_FILES="$(BR2_EXTERNAL_RECALBOX_PATH)/board/recalbox/odroidgo2/linux-defconfig-fragment.config"
BR2_LINUX_KERNEL_DTS_SUPPORT=y
BR2_LINUX_KERNEL_INTREE_DTS_NAME="rockchip/rk3326-odroidgo2-linux-v11 rockchip/rk3326-odroidgo2-linux rockchip/rk3326-odroidgo3-linux"
BR2_PACKAGE_BUSYBOX_CONFIG_FRAGMENT_FILES="$(BR2_EXTERNAL_RECALBOX_PATH)/board/recalbox/busybox.custom.config"
BR2_PACKAGE_ALSA_UTILS=y
BR2_PACKAGE_ALSA_UTILS_AMIXER=y
BR2_PACKAGE_FFMPEG_GPL=y
BR2_PACKAGE_FFMPEG_FFPLAY=y
BR2_PACKAGE_FFMPEG_FFPROBE=y
BR2_PACKAGE_MPV=y
BR2_PACKAGE_P7ZIP=y
BR2_PACKAGE_UNZIP=y
BR2_PACKAGE_XZ=y
BR2_PACKAGE_ZIP=y
BR2_PACKAGE_BINUTILS=y
BR2_PACKAGE_DIFFUTILS=y
BR2_PACKAGE_CIFS_UTILS=y
BR2_PACKAGE_DOSFSTOOLS=y
BR2_PACKAGE_DOSFSTOOLS_FSCK_FAT=y
BR2_PACKAGE_DOSFSTOOLS_MKFS_FAT=y
BR2_PACKAGE_EXFAT=y
BR2_PACKAGE_EXFAT_UTILS=y
BR2_PACKAGE_NTFS_3G=y
BR2_PACKAGE_NTFS_3G_NTFSPROGS=y
BR2_PACKAGE_FBDUMP=y
BR2_PACKAGE_FBGRAB=y
BR2_PACKAGE_FBV=y
BR2_PACKAGE_SDL_IMAGE_XPM=y
BR2_PACKAGE_SDL_MIXER=y
BR2_PACKAGE_SDL_NET=y
BR2_PACKAGE_SDL2_KMSDRM=y
BR2_PACKAGE_SDL2_OPENGLES=y
BR2_PACKAGE_XKEYBOARD_CONFIG=y
BR2_PACKAGE_LINUX_FIRMWARE=y
BR2_PACKAGE_LINUX_FIRMWARE_AR3012_USB=y
BR2_PACKAGE_LINUX_FIRMWARE_TI_CC2560=y
BR2_PACKAGE_LINUX_FIRMWARE_ATHEROS_9170=y
BR2_PACKAGE_LINUX_FIRMWARE_ATHEROS_9271=y
BR2_PACKAGE_LINUX_FIRMWARE_BRCM_BCM43XX=y
BR2_PACKAGE_LINUX_FIRMWARE_BRCM_BCM43XXX=y
BR2_PACKAGE_LINUX_FIRMWARE_BRCM_BCM4366B1=y
BR2_PACKAGE_LINUX_FIRMWARE_BRCM_BCM4366C0=y
BR2_PACKAGE_LINUX_FIRMWARE_RALINK_RT61=y
BR2_PACKAGE_LINUX_FIRMWARE_RALINK_RT73=y
BR2_PACKAGE_LINUX_FIRMWARE_RALINK_RT2XX=y
BR2_PACKAGE_LINUX_FIRMWARE_RTL_81XX=y
BR2_PACKAGE_LINUX_FIRMWARE_RTL_87XX=y
BR2_PACKAGE_LINUX_FIRMWARE_RTL_88XX=y
BR2_PACKAGE_LINUX_FIRMWARE_RTL_RTW88=y
BR2_PACKAGE_DBUS_CPP=y
BR2_PACKAGE_DBUS_GLIB=y
BR2_PACKAGE_DBUS_PYTHON=y
BR2_PACKAGE_DBUS_TRIGGERD=y
BR2_PACKAGE_EUDEV_RULES_GEN=y
BR2_PACKAGE_EVTEST=y
BR2_PACKAGE_I2C_TOOLS=y
BR2_PACKAGE_KBD=y
BR2_PACKAGE_LINUXCONSOLETOOLS=y
BR2_PACKAGE_LIRC_TOOLS=y
BR2_PACKAGE_PARTED=y
BR2_PACKAGE_USBMOUNT=y
BR2_PACKAGE_USBUTILS=y
BR2_PACKAGE_NODEJS=y
BR2_PACKAGE_NODEJS_MODULES_ADDITIONAL="request"
BR2_PACKAGE_PYTHON3_PY_PYC=y
BR2_PACKAGE_PYTHON_LIBUSB1=y
BR2_PACKAGE_PYTHON_PAHO_MQTT=y
BR2_PACKAGE_PYTHON_PSUTIL=y
BR2_PACKAGE_PYTHON_PYGAME=y
BR2_PACKAGE_PYTHON_PYGAME_IMAGE=y
BR2_PACKAGE_PYTHON_PYGAME_FONT=y
BR2_PACKAGE_TCL=y
BR2_PACKAGE_EXPECT=y
BR2_PACKAGE_SNAPPY=y
BR2_PACKAGE_LIBWEBSOCKETS=y
BR2_PACKAGE_CA_CERTIFICATES=y
BR2_PACKAGE_LIBOPENSSL_BIN=y
BR2_PACKAGE_LIBUSB_COMPAT=y
BR2_PACKAGE_LIBBLURAY=y
BR2_PACKAGE_X264=y
BR2_PACKAGE_X265=y
BR2_PACKAGE_LIBCURL_CURL=y
BR2_PACKAGE_BOOST=y
BR2_PACKAGE_BOOST_ATOMIC=y
BR2_PACKAGE_NCURSES_WCHAR=y
BR2_PACKAGE_PCRE2=y
BR2_PACKAGE_PCRE2_16=y
BR2_PACKAGE_BLUEZ5_UTILS_CLIENT=y
BR2_PACKAGE_BLUEZ5_UTILS_DEPRECATED=y
BR2_PACKAGE_BLUEZ5_UTILS_PLUGINS_SIXAXIS=y
BR2_PACKAGE_BLUEZ5_UTILS_TEST=y
BR2_PACKAGE_BLUEZ5_UTILS_TOOLS_HID2HCI=y
BR2_PACKAGE_CRDA=y
BR2_PACKAGE_DHCPCD=y
BR2_PACKAGE_DROPBEAR=y
BR2_PACKAGE_GESFTPSERVER=y
BR2_PACKAGE_IW=y
BR2_PACKAGE_MOSQUITTO=y
BR2_PACKAGE_NTP=y
BR2_PACKAGE_RSYNC=y
BR2_PACKAGE_SAMBA4=y
BR2_PACKAGE_WGET=y
BR2_PACKAGE_WPA_SUPPLICANT=y
BR2_PACKAGE_WPA_SUPPLICANT_CLI=y
BR2_PACKAGE_WPA_SUPPLICANT_DBUS=y
BR2_PACKAGE_WPA_SUPPLICANT_DBUS_INTROSPECTION=y
BR2_PACKAGE_WPA_SUPPLICANT_WPA3=y
BR2_PACKAGE_WPA_SUPPLICANT_WPS=y
BR2_PACKAGE_HTOP=y
BR2_PACKAGE_PROCPS_NG=y
BR2_PACKAGE_TAR=y
BR2_PACKAGE_UTIL_LINUX_LOSETUP=y
BR2_PACKAGE_UTIL_LINUX_RFKILL=y
BR2_PACKAGE_UTIL_LINUX_SETTERM=y
BR2_PACKAGE_NANO=y
BR2_PACKAGE_VIM=y
BR2_TARGET_ROOTFS_SQUASHFS=y
BR2_TARGET_ROOTFS_SQUASHFS4_LZO=y
# BR2_TARGET_ROOTFS_TAR is not set
BR2_PACKAGE_HOST_GENIMAGE=y
BR2_PACKAGE_ROCKCHIP_MALI=y
BR2_PACKAGE_ROCKCHIP_MALI_BIFROST_VULKAN=y
BR2_PACKAGE_EVWAIT=y
BR2_PACKAGE_RECALBOX_CONFIGGEN=y
BR2_PACKAGE_RECALBOX_INITRAMFS=y
BR2_PACKAGE_RECALBOX_MANAGER2=y
BR2_PACKAGE_RECALBOX_ROMFS2=y
BR2_PACKAGE_RECALBOX_SYSTEM=y
BR2_PACKAGE_RECALBOX_TARGET_ODROIDGO2=y
BR2_PACKAGE_RECALBOX_THEMES=y
BR2_PACKAGE_RECALBOX_HARDWARE=y
BR2_PACKAGE_RECALBOX_SETTINGS=y
BR2_PACKAGE_UBOOT_ODROIDGO2=y
BR2_PACKAGE_RECALBOX_EMULATIONSTATION2=y
BR2_PACKAGE_ADVANCEMAME=y
BR2_PACKAGE_MUPEN64PLUS_AUDIO_SDL=y
BR2_PACKAGE_MUPEN64PLUS_CORE=y
BR2_PACKAGE_MUPEN64PLUS_INPUT_SDL=y
BR2_PACKAGE_MUPEN64PLUS_RSPHLE=y
BR2_PACKAGE_MUPEN64PLUS_UICONSOLE=y
BR2_PACKAGE_MUPEN64PLUS_VIDEO_RICE=y
BR2_PACKAGE_MUPEN64PLUS_VIDEO_GLIDE64MK2=y
BR2_PACKAGE_ORICUTRON=y
BR2_PACKAGE_PPSSPP=y
BR2_PACKAGE_SIMCOUPE=y
BR2_PACKAGE_AMIBERRY=y
BR2_PACKAGE_DOSBOX=y
BR2_PACKAGE_GSPLUS=y
BR2_PACKAGE_HYPSEUS=y
BR2_PACKAGE_OPENBOR=y
BR2_PACKAGE_RETROARCH=y
BR2_PACKAGE_SCUMMVM=y
BR2_PACKAGE_SOLARUS_RECALBOX=y
BR2_PACKAGE_TI99SIM=y
BR2_PACKAGE_XROAR=y
BR2_PACKAGE_LIBRETRO_81=y
BR2_PACKAGE_LIBRETRO_2048=y
BR2_PACKAGE_LIBRETRO_ATARI800=y
BR2_PACKAGE_LIBRETRO_BK_EMULATOR=y
BR2_PACKAGE_LIBRETRO_FREEINTV=y
BR2_PACKAGE_LIBRETRO_BEETLE_LYNX=y
BR2_PACKAGE_LIBRETRO_BEETLE_NGP=y
BR2_PACKAGE_LIBRETRO_BEETLE_PCE_FAST=y
BR2_PACKAGE_LIBRETRO_BEETLE_SUPERGRAFX=y
BR2_PACKAGE_LIBRETRO_BEETLE_VB=y
BR2_PACKAGE_LIBRETRO_BEETLE_WSWAN=y
BR2_PACKAGE_LIBRETRO_BLUEMSX=y
BR2_PACKAGE_LIBRETRO_CANNONBALL=y
BR2_PACKAGE_LIBRETRO_CAP32=y
BR2_PACKAGE_LIBRETRO_CROCODS=y
BR2_PACKAGE_LIBRETRO_DINOTHAWR=y
BR2_PACKAGE_LIBRETRO_DOSBOX_PURE=y
BR2_PACKAGE_LIBRETRO_EASYRPG=y
BR2_PACKAGE_LIBRETRO_ECWOLF=y
BR2_PACKAGE_LIBRETRO_EMUSCV=y
BR2_PACKAGE_LIBRETRO_FBNEO=y
BR2_PACKAGE_LIBRETRO_FCEUMM=y
BR2_PACKAGE_LIBRETRO_FCEUNEXT=y
BR2_PACKAGE_LIBRETRO_FLYCAST=y
BR2_PACKAGE_LIBRETRO_FMSX=y
BR2_PACKAGE_LIBRETRO_FREECHAF=y
BR2_PACKAGE_LIBRETRO_FUSE=y
BR2_PACKAGE_LIBRETRO_GAMBATTE=y
BR2_PACKAGE_LIBRETRO_GEARSYSTEM=y
BR2_PACKAGE_LIBRETRO_GENESISPLUSGX=y
BR2_PACKAGE_LIBRETRO_GENESISPLUSGXWIDE=y
BR2_PACKAGE_LIBRETRO_GPSP=y
BR2_PACKAGE_LIBRETRO_GW=y
BR2_PACKAGE_LIBRETRO_HANDY=y
BR2_PACKAGE_LIBRETRO_HATARI=y
BR2_PACKAGE_LIBRETRO_IMAGEVIEWER=y
BR2_PACKAGE_LIBRETRO_LOWRES_NX=y
BR2_PACKAGE_LIBRETRO_LUTRO=y
BR2_PACKAGE_LIBRETRO_MAME2003_PLUS=y
BR2_PACKAGE_LIBRETRO_MAME2003=y
BR2_PACKAGE_LIBRETRO_MAME2010=y
BR2_PACKAGE_LIBRETRO_MAME2015=y
BR2_PACKAGE_LIBRETRO_MESEN=y
BR2_PACKAGE_LIBRETRO_MESEN_S=y
BR2_PACKAGE_LIBRETRO_METEOR=y
BR2_PACKAGE_LIBRETRO_MGBA=y
BR2_PACKAGE_LIBRETRO_MRBOOM=y
BR2_PACKAGE_LIBRETRO_MU=y
BR2_PACKAGE_LIBRETRO_MUPEN64PLUS_NX=y
BR2_PACKAGE_LIBRETRO_NESTOPIA=y
BR2_PACKAGE_LIBRETRO_NEOCD=y
BR2_PACKAGE_LIBRETRO_NP2KAI=y
BR2_PACKAGE_LIBRETRO_NXENGINE=y
BR2_PACKAGE_LIBRETRO_O2EM=y
BR2_PACKAGE_LIBRETRO_OPERA=y
BR2_PACKAGE_LIBRETRO_PARALLEL_N64=y
BR2_PACKAGE_LIBRETRO_PICODRIVE=y
BR2_PACKAGE_LIBRETRO_POKEMINI=y
BR2_PACKAGE_LIBRETRO_POTATOR=y
BR2_PACKAGE_LIBRETRO_PRBOOM=y
BR2_PACKAGE_LIBRETRO_PROSYSTEM=y
BR2_PACKAGE_LIBRETRO_PX68K=y
BR2_PACKAGE_LIBRETRO_QUASI88=y
BR2_PACKAGE_LIBRETRO_QUICKNES=y
BR2_PACKAGE_LIBRETRO_RACE=y
BR2_PACKAGE_LIBRETRO_REMINISCENCE=y
BR2_PACKAGE_LIBRETRO_RETRO8=y
BR2_PACKAGE_LIBRETRO_SAMEBOY=y
BR2_PACKAGE_LIBRETRO_SNES9X=y
BR2_PACKAGE_LIBRETRO_SNES9X2002=y
BR2_PACKAGE_LIBRETRO_SNES9X2005=y
BR2_PACKAGE_LIBRETRO_SNES9X2010=y
BR2_PACKAGE_LIBRETRO_STELLA=y
BR2_PACKAGE_LIBRETRO_SWANSTATION=y
BR2_PACKAGE_LIBRETRO_TGBDUAL=y
BR2_PACKAGE_LIBRETRO_THEODORE=y
BR2_PACKAGE_LIBRETRO_TIC80=y
BR2_PACKAGE_LIBRETRO_TYRQUAKE=y
BR2_PACKAGE_LIBRETRO_UAE=y
BR2_PACKAGE_LIBRETRO_UAE4ARM=y
BR2_PACKAGE_LIBRETRO_UZEM=y
BR2_PACKAGE_LIBRETRO_VECX=y
BR2_PACKAGE_LIBRETRO_VICE=y
BR2_PACKAGE_LIBRETRO_XMIL=y
BR2_PACKAGE_LIBRETRO_XRICK=y
BR2_PACKAGE_LIBRETRO_YABASANSHIRO=y
BR2_PACKAGE_FBV_RECALBOX=y
BR2_PACKAGE_JSTEST2=y
BR2_PACKAGE_WSD=y
BR2_PACKAGE_LIBRETRO_CHEATS=y
BR2_PACKAGE_MEGATOOLS=y
BR2_PACKAGE_FLUIDSYNTH_PULSEAUDIO=y
BR2_PACKAGE_PAMIX=y
BR2_PACKAGE_RTL8189FS=y
BR2_PACKAGE_RTL88X2BU=y
```
