## Config.in
```kconfig
menu "Recalbox"
  menu "Hardware"
    comment "CPU/GPU specific options"
    menu "Rockchip"
      source "$BR2_EXTERNAL_RECALBOX_PATH/package/rockchip-mali/Config.in"
      source "$BR2_EXTERNAL_RECALBOX_PATH/package/rockchip-mpp/Config.in"
    endmenu
    comment "Board specific options"
    menu "Hardkernel"
			menu "odroidgo2"
        source "$BR2_EXTERNAL_RECALBOX_PATH/package/librga/Config.in"
        source "$BR2_EXTERNAL_RECALBOX_PATH/package/libgo2/Config.in"
      endmenu
    endmenu
  endmenu
         source "$BR2_EXTERNAL_RECALBOX_PATH/package/dpi-pizero-gpicase/Config.in"
         source "$BR2_EXTERNAL_RECALBOX_PATH/package/evwait/Config.in"
         source "$BR2_EXTERNAL_RECALBOX_PATH/package/freeimage/Config.in"
         source "$BR2_EXTERNAL_RECALBOX_PATH/package/guichan/Config.in"
         source "$BR2_EXTERNAL_RECALBOX_PATH/package/libenet/Config.in"
         source "$BR2_EXTERNAL_RECALBOX_PATH/package/mali-450/Config.in"
         source "$BR2_EXTERNAL_RECALBOX_PATH/package/mali-t62x/Config.in"
         source "$BR2_EXTERNAL_RECALBOX_PATH/package/moonlight-embedded/Config.in"
         source "$BR2_EXTERNAL_RECALBOX_PATH/package/nvidia-driver-390-recalbox/Config.in"
         source "$BR2_EXTERNAL_RECALBOX_PATH/package/nvidia-driver-440-recalbox/Config.in"
         source "$BR2_EXTERNAL_RECALBOX_PATH/package/nvidia-driver-460-recalbox/Config.in"
         source "$BR2_EXTERNAL_RECALBOX_PATH/package/pwm-audio-pi-zero/Config.in"
         source "$BR2_EXTERNAL_RECALBOX_PATH/package/pwm-audio-pizero-gpicase/Config.in"
         source "$BR2_EXTERNAL_RECALBOX_PATH/package/recalbox-api/Config.in"
         source "$BR2_EXTERNAL_RECALBOX_PATH/package/recalbox-bluetooth/Config.in"
         source "$BR2_EXTERNAL_RECALBOX_PATH/package/recalbox-bootia32/Config.in"
         source "$BR2_EXTERNAL_RECALBOX_PATH/package/recalbox-configgen/Config.in"
         source "$BR2_EXTERNAL_RECALBOX_PATH/package/recalbox-initramfs/Config.in"
         source "$BR2_EXTERNAL_RECALBOX_PATH/package/recalbox-manager2/Config.in"
         source "$BR2_EXTERNAL_RECALBOX_PATH/package/recalbox-mplayer/Config.in"
         source "$BR2_EXTERNAL_RECALBOX_PATH/package/recalbox-romfs2/Config.in"
         source "$BR2_EXTERNAL_RECALBOX_PATH/package/recalbox-system/Config.in"
         source "$BR2_EXTERNAL_RECALBOX_PATH/package/recalbox-tft-assets/Config.in"
         source "$BR2_EXTERNAL_RECALBOX_PATH/package/recalbox-themes/Config.in"
         source "$BR2_EXTERNAL_RECALBOX_PATH/package/recalbox-x86_64_efi/Config.in"
         source "$BR2_EXTERNAL_RECALBOX_PATH/package/rgb-pi/Config.in"
         source "$BR2_EXTERNAL_RECALBOX_PATH/package/sfml/Config.in"
         source "$BR2_EXTERNAL_RECALBOX_PATH/package/tft-waveshare/Config.in"
         source "$BR2_EXTERNAL_RECALBOX_PATH/package/wm8960-audiohat/Config.in"
         source "$BR2_EXTERNAL_RECALBOX_PATH/package/recalbox-hardware/Config.in"
         source "$BR2_EXTERNAL_RECALBOX_PATH/package/recalbox-settings/Config.in"
         source "$BR2_EXTERNAL_RECALBOX_PATH/package/uboot-xu4/Config.in"
         source "$BR2_EXTERNAL_RECALBOX_PATH/package/uboot-odroidgo2/Config.in"
menu "Emulationstation"
         source "$BR2_EXTERNAL_RECALBOX_PATH/package/recalbox-emulationstation2/Config.in"
endmenu
menu "Controllers"
         source "$BR2_EXTERNAL_RECALBOX_PATH/package/db9_gpio_rpi/Config.in"
         source "$BR2_EXTERNAL_RECALBOX_PATH/package/gamecon_gpio_rpi/Config.in"
         source "$BR2_EXTERNAL_RECALBOX_PATH/package/mk_arcade_joystick_rpi/Config.in"
         source "$BR2_EXTERNAL_RECALBOX_PATH/package/qtsixa-shanwan/Config.in"
         source "$BR2_EXTERNAL_RECALBOX_PATH/package/qtsixa/Config.in"
         source "$BR2_EXTERNAL_RECALBOX_PATH/package/recalbox-retrogame/Config.in"
         source "$BR2_EXTERNAL_RECALBOX_PATH/package/steamcontroller/Config.in"
         source "$BR2_EXTERNAL_RECALBOX_PATH/package/virtualgamepads/Config.in"
         source "$BR2_EXTERNAL_RECALBOX_PATH/package/xarcade2jstick/Config.in"
         source "$BR2_EXTERNAL_RECALBOX_PATH/package/xboxdrv/Config.in"
         comment "Nintendo switch Joycons support"
         source "$BR2_EXTERNAL_RECALBOX_PATH/package/joycond/Config.in"
         source "$BR2_EXTERNAL_RECALBOX_PATH/package/hid-nintendo/Config.in"
endmenu
menu "Emulators"
         source "$BR2_EXTERNAL_RECALBOX_PATH/package/advancemame/Config.in"
         source "$BR2_EXTERNAL_RECALBOX_PATH/package/linapple-pie/Config.in"
         source "$BR2_EXTERNAL_RECALBOX_PATH/package/mupen64plus-audio-sdl/Config.in"
         source "$BR2_EXTERNAL_RECALBOX_PATH/package/mupen64plus-core/Config.in"
         source "$BR2_EXTERNAL_RECALBOX_PATH/package/mupen64plus-gliden64/Config.in"
         source "$BR2_EXTERNAL_RECALBOX_PATH/package/mupen64plus-gliden64-20/Config.in"
         source "$BR2_EXTERNAL_RECALBOX_PATH/package/mupen64plus-input-sdl/Config.in"
         source "$BR2_EXTERNAL_RECALBOX_PATH/package/mupen64plus-omx/Config.in"
         source "$BR2_EXTERNAL_RECALBOX_PATH/package/mupen64plus-video-gles2n64/Config.in"
         source "$BR2_EXTERNAL_RECALBOX_PATH/package/mupen64plus-video-gles2rice/Config.in"
         source "$BR2_EXTERNAL_RECALBOX_PATH/package/mupen64plus-video-rice/Config.in"
         source "$BR2_EXTERNAL_RECALBOX_PATH/package/mupen64plus-rsphle/Config.in"
         source "$BR2_EXTERNAL_RECALBOX_PATH/package/mupen64plus-uiconsole/Config.in"
         source "$BR2_EXTERNAL_RECALBOX_PATH/package/mupen64plus-video-glide64mk2/Config.in"
         source "$BR2_EXTERNAL_RECALBOX_PATH/package/oricutron/Config.in"
         source "$BR2_EXTERNAL_RECALBOX_PATH/package/ppsspp/Config.in"
         source "$BR2_EXTERNAL_RECALBOX_PATH/package/simcoupe/Config.in"
         source "$BR2_EXTERNAL_RECALBOX_PATH/package/amiberry/Config.in"
         source "$BR2_EXTERNAL_RECALBOX_PATH/package/dolphin-emu/Config.in"
         source "$BR2_EXTERNAL_RECALBOX_PATH/package/dosbox/Config.in"
         source "$BR2_EXTERNAL_RECALBOX_PATH/package/gsplus/Config.in"
         source "$BR2_EXTERNAL_RECALBOX_PATH/package/hypseus/Config.in"
         source "$BR2_EXTERNAL_RECALBOX_PATH/package/openbor/Config.in"
         source "$BR2_EXTERNAL_RECALBOX_PATH/package/pcsx_rearmed/Config.in"
         source "$BR2_EXTERNAL_RECALBOX_PATH/package/pifba/Config.in"
         source "$BR2_EXTERNAL_RECALBOX_PATH/package/pisnes/Config.in"
         source "$BR2_EXTERNAL_RECALBOX_PATH/package/reicast-old/Config.in"
         source "$BR2_EXTERNAL_RECALBOX_PATH/package/reicast/Config.in"
         source "$BR2_EXTERNAL_RECALBOX_PATH/package/retroarch-assets/Config.in"
         source "$BR2_EXTERNAL_RECALBOX_PATH/package/retroarch/Config.in"
         source "$BR2_EXTERNAL_RECALBOX_PATH/package/scummvm/Config.in"
         source "$BR2_EXTERNAL_RECALBOX_PATH/package/vice/Config.in"
         source "$BR2_EXTERNAL_RECALBOX_PATH/package/solarus-recalbox/Config.in"
         source "$BR2_EXTERNAL_RECALBOX_PATH/package/supermodel/Config.in"
         source "$BR2_EXTERNAL_RECALBOX_PATH/package/ti99sim/Config.in"
         source "$BR2_EXTERNAL_RECALBOX_PATH/package/xroar/Config.in"

if BR2_PACKAGE_RETROARCH
menu "Libretro Cores"
        source "$BR2_EXTERNAL_RECALBOX_PATH/package/libretro-81/Config.in"
        source "$BR2_EXTERNAL_RECALBOX_PATH/package/libretro-2048/Config.in"
        source "$BR2_EXTERNAL_RECALBOX_PATH/package/libretro-atari800/Config.in"
        source "$BR2_EXTERNAL_RECALBOX_PATH/package/libretro-bk-emulator/Config.in"
        source "$BR2_EXTERNAL_RECALBOX_PATH/package/libretro-freeintv/Config.in"
        source "$BR2_EXTERNAL_RECALBOX_PATH/package/libretro-beetle-lynx/Config.in"
        source "$BR2_EXTERNAL_RECALBOX_PATH/package/libretro-beetle-ngp/Config.in"
        source "$BR2_EXTERNAL_RECALBOX_PATH/package/libretro-beetle-pce-fast/Config.in"
        source "$BR2_EXTERNAL_RECALBOX_PATH/package/libretro-beetle-pcfx/Config.in"
        source "$BR2_EXTERNAL_RECALBOX_PATH/package/libretro-beetle-psx-hw/Config.in"
        source "$BR2_EXTERNAL_RECALBOX_PATH/package/libretro-beetle-psx/Config.in"
        source "$BR2_EXTERNAL_RECALBOX_PATH/package/libretro-beetle-saturn/Config.in"
        source "$BR2_EXTERNAL_RECALBOX_PATH/package/libretro-beetle-supergrafx/Config.in"
        source "$BR2_EXTERNAL_RECALBOX_PATH/package/libretro-beetle-vb/Config.in"
        source "$BR2_EXTERNAL_RECALBOX_PATH/package/libretro-beetle-wswan/Config.in"
        source "$BR2_EXTERNAL_RECALBOX_PATH/package/libretro-bluemsx/Config.in"
        source "$BR2_EXTERNAL_RECALBOX_PATH/package/libretro-boom3/Config.in"
        source "$BR2_EXTERNAL_RECALBOX_PATH/package/libretro-cannonball/Config.in"
        source "$BR2_EXTERNAL_RECALBOX_PATH/package/libretro-cap32/Config.in"
        source "$BR2_EXTERNAL_RECALBOX_PATH/package/libretro-craft/Config.in"
        source "$BR2_EXTERNAL_RECALBOX_PATH/package/libretro-crawl/Config.in"
        source "$BR2_EXTERNAL_RECALBOX_PATH/package/libretro-crocods/Config.in"
        source "$BR2_EXTERNAL_RECALBOX_PATH/package/libretro-desmume/Config.in"
        source "$BR2_EXTERNAL_RECALBOX_PATH/package/libretro-dinothawr/Config.in"
        source "$BR2_EXTERNAL_RECALBOX_PATH/package/libretro-dosbox-pure/Config.in"
        source "$BR2_EXTERNAL_RECALBOX_PATH/package/libretro-easyrpg/Config.in"
        source "$BR2_EXTERNAL_RECALBOX_PATH/package/libretro-ecwolf/Config.in"
        source "$BR2_EXTERNAL_RECALBOX_PATH/package/libretro-emuscv/Config.in"
        source "$BR2_EXTERNAL_RECALBOX_PATH/package/libretro-fbneo/Config.in"
        source "$BR2_EXTERNAL_RECALBOX_PATH/package/libretro-fceumm/Config.in"
        source "$BR2_EXTERNAL_RECALBOX_PATH/package/libretro-fceunext/Config.in"
        source "$BR2_EXTERNAL_RECALBOX_PATH/package/libretro-flycast/Config.in"
        source "$BR2_EXTERNAL_RECALBOX_PATH/package/libretro-fmsx/Config.in"
        source "$BR2_EXTERNAL_RECALBOX_PATH/package/libretro-freechaf/Config.in"
        source "$BR2_EXTERNAL_RECALBOX_PATH/package/libretro-fuse/Config.in"
        source "$BR2_EXTERNAL_RECALBOX_PATH/package/libretro-gambatte/Config.in"
        source "$BR2_EXTERNAL_RECALBOX_PATH/package/libretro-gearsystem/Config.in"
        source "$BR2_EXTERNAL_RECALBOX_PATH/package/libretro-genesisplusgx/Config.in"
        source "$BR2_EXTERNAL_RECALBOX_PATH/package/libretro-genesisplusgxwide/Config.in"
        source "$BR2_EXTERNAL_RECALBOX_PATH/package/libretro-gpsp/Config.in"
        source "$BR2_EXTERNAL_RECALBOX_PATH/package/libretro-gw/Config.in"
        source "$BR2_EXTERNAL_RECALBOX_PATH/package/libretro-handy/Config.in"
        source "$BR2_EXTERNAL_RECALBOX_PATH/package/libretro-hatari/Config.in"
        source "$BR2_EXTERNAL_RECALBOX_PATH/package/libretro-imageviewer/Config.in"
        source "$BR2_EXTERNAL_RECALBOX_PATH/package/libretro-kronos/Config.in"
        source "$BR2_EXTERNAL_RECALBOX_PATH/package/libretro-lowres-nx/Config.in"
        source "$BR2_EXTERNAL_RECALBOX_PATH/package/libretro-lutro/Config.in"
        source "$BR2_EXTERNAL_RECALBOX_PATH/package/libretro-mame/Config.in"
        source "$BR2_EXTERNAL_RECALBOX_PATH/package/libretro-mame2000/Config.in"
        source "$BR2_EXTERNAL_RECALBOX_PATH/package/libretro-mame2003-plus/Config.in"
        source "$BR2_EXTERNAL_RECALBOX_PATH/package/libretro-mame2003/Config.in"
        source "$BR2_EXTERNAL_RECALBOX_PATH/package/libretro-mame2010/Config.in"
        source "$BR2_EXTERNAL_RECALBOX_PATH/package/libretro-mame2015/Config.in"
        source "$BR2_EXTERNAL_RECALBOX_PATH/package/libretro-mame2016/Config.in"
        source "$BR2_EXTERNAL_RECALBOX_PATH/package/libretro-melonds/Config.in"
        source "$BR2_EXTERNAL_RECALBOX_PATH/package/libretro-mesen/Config.in"
        source "$BR2_EXTERNAL_RECALBOX_PATH/package/libretro-mesen-s/Config.in"
        source "$BR2_EXTERNAL_RECALBOX_PATH/package/libretro-meteor/Config.in"
        source "$BR2_EXTERNAL_RECALBOX_PATH/package/libretro-mgba/Config.in"
        source "$BR2_EXTERNAL_RECALBOX_PATH/package/libretro-minivmac/Config.in"
        source "$BR2_EXTERNAL_RECALBOX_PATH/package/libretro-mrboom/Config.in"
        source "$BR2_EXTERNAL_RECALBOX_PATH/package/libretro-mu/Config.in"
        source "$BR2_EXTERNAL_RECALBOX_PATH/package/libretro-mupen64plus/Config.in"
        source "$BR2_EXTERNAL_RECALBOX_PATH/package/libretro-mupen64plus-nx/Config.in"
        source "$BR2_EXTERNAL_RECALBOX_PATH/package/libretro-neocd/Config.in"
        source "$BR2_EXTERNAL_RECALBOX_PATH/package/libretro-nestopia/Config.in"
        source "$BR2_EXTERNAL_RECALBOX_PATH/package/libretro-np2kai/Config.in"
        source "$BR2_EXTERNAL_RECALBOX_PATH/package/libretro-nxengine/Config.in"
        source "$BR2_EXTERNAL_RECALBOX_PATH/package/libretro-o2em/Config.in"
        source "$BR2_EXTERNAL_RECALBOX_PATH/package/libretro-opera/Config.in"
        source "$BR2_EXTERNAL_RECALBOX_PATH/package/libretro-parallel-n64/Config.in"
        source "$BR2_EXTERNAL_RECALBOX_PATH/package/libretro-pcsx_rearmed/Config.in"
        source "$BR2_EXTERNAL_RECALBOX_PATH/package/libretro-picodrive/Config.in"
        source "$BR2_EXTERNAL_RECALBOX_PATH/package/libretro-pokemini/Config.in"
        source "$BR2_EXTERNAL_RECALBOX_PATH/package/libretro-potator/Config.in"
        source "$BR2_EXTERNAL_RECALBOX_PATH/package/libretro-prboom/Config.in"
        source "$BR2_EXTERNAL_RECALBOX_PATH/package/libretro-prosystem/Config.in"
        source "$BR2_EXTERNAL_RECALBOX_PATH/package/libretro-px68k/Config.in"
        source "$BR2_EXTERNAL_RECALBOX_PATH/package/libretro-quasi88/Config.in"
        source "$BR2_EXTERNAL_RECALBOX_PATH/package/libretro-quicknes/Config.in"
        source "$BR2_EXTERNAL_RECALBOX_PATH/package/libretro-race/Config.in"
        source "$BR2_EXTERNAL_RECALBOX_PATH/package/libretro-reminiscence/Config.in"
        source "$BR2_EXTERNAL_RECALBOX_PATH/package/libretro-retro8/Config.in"
        source "$BR2_EXTERNAL_RECALBOX_PATH/package/libretro-retrodream/Config.in"
        source "$BR2_EXTERNAL_RECALBOX_PATH/package/libretro-sameboy/Config.in"
        source "$BR2_EXTERNAL_RECALBOX_PATH/package/libretro-scummvm/Config.in"
        source "$BR2_EXTERNAL_RECALBOX_PATH/package/libretro-snes9x/Config.in"
        source "$BR2_EXTERNAL_RECALBOX_PATH/package/libretro-snes9x2002/Config.in"
        source "$BR2_EXTERNAL_RECALBOX_PATH/package/libretro-snes9x2005/Config.in"
        source "$BR2_EXTERNAL_RECALBOX_PATH/package/libretro-snes9x2010/Config.in"
        source "$BR2_EXTERNAL_RECALBOX_PATH/package/libretro-stella/Config.in"
        source "$BR2_EXTERNAL_RECALBOX_PATH/package/libretro-stella2014/Config.in"
        source "$BR2_EXTERNAL_RECALBOX_PATH/package/libretro-swanstation/Config.in"
        source "$BR2_EXTERNAL_RECALBOX_PATH/package/libretro-tgbdual/Config.in"
        source "$BR2_EXTERNAL_RECALBOX_PATH/package/libretro-theodore/Config.in"
        source "$BR2_EXTERNAL_RECALBOX_PATH/package/libretro-thepowdertoy/Config.in"
        source "$BR2_EXTERNAL_RECALBOX_PATH/package/libretro-tic80/Config.in"
        source "$BR2_EXTERNAL_RECALBOX_PATH/package/libretro-tyrquake/Config.in"
        source "$BR2_EXTERNAL_RECALBOX_PATH/package/libretro-uae/Config.in"
        source "$BR2_EXTERNAL_RECALBOX_PATH/package/libretro-uae4arm/Config.in"
        source "$BR2_EXTERNAL_RECALBOX_PATH/package/libretro-uzem/Config.in"
        source "$BR2_EXTERNAL_RECALBOX_PATH/package/libretro-vecx/Config.in"
        source "$BR2_EXTERNAL_RECALBOX_PATH/package/libretro-vice/Config.in"
        source "$BR2_EXTERNAL_RECALBOX_PATH/package/libretro-virtualjaguar/Config.in"
        source "$BR2_EXTERNAL_RECALBOX_PATH/package/libretro-vitaquake2/Config.in"
        source "$BR2_EXTERNAL_RECALBOX_PATH/package/libretro-vitaquake3/Config.in"
        source "$BR2_EXTERNAL_RECALBOX_PATH/package/libretro-vitavoyager/Config.in"
        source "$BR2_EXTERNAL_RECALBOX_PATH/package/libretro-xmil/Config.in"
        source "$BR2_EXTERNAL_RECALBOX_PATH/package/libretro-xrick/Config.in"
        source "$BR2_EXTERNAL_RECALBOX_PATH/package/libretro-yabasanshiro/Config.in"
        source "$BR2_EXTERNAL_RECALBOX_PATH/package/libretro-yabause/Config.in"
endmenu
endif
endmenu
menu "Kodi addons"
         source "$BR2_EXTERNAL_RECALBOX_PATH/package/kodi-plugin-video-netflix/Config.in"
         source "$BR2_EXTERNAL_RECALBOX_PATH/package/kodi-plugin-video-youtube/Config.in"
         source "$BR2_EXTERNAL_RECALBOX_PATH/package/kodi-script-module-addon-signals/Config.in"
         source "$BR2_EXTERNAL_RECALBOX_PATH/package/kodi-script-module-inputstreamhelper/Config.in"
         source "$BR2_EXTERNAL_RECALBOX_PATH/package/kodi-script-module-future/Config.in"
         source "$BR2_EXTERNAL_RECALBOX_PATH/package/kodi-script-module-requests/Config.in"
         source "$BR2_EXTERNAL_RECALBOX_PATH/package/kodi-script-module-certifi/Config.in"
         source "$BR2_EXTERNAL_RECALBOX_PATH/package/kodi-script-module-chardet/Config.in"
         source "$BR2_EXTERNAL_RECALBOX_PATH/package/kodi-script-module-idna/Config.in"
         source "$BR2_EXTERNAL_RECALBOX_PATH/package/kodi-script-module-urllib3/Config.in"
         source "$BR2_EXTERNAL_RECALBOX_PATH/package/kodi-script.module.t0mm0.common/Config.in"
menu "Languages"
         source "$BR2_EXTERNAL_RECALBOX_PATH/package/kodi-resource-language-de_de/Config.in"
         source "$BR2_EXTERNAL_RECALBOX_PATH/package/kodi-resource-language-es_es/Config.in"
         source "$BR2_EXTERNAL_RECALBOX_PATH/package/kodi-resource-language-eu_es/Config.in"
         source "$BR2_EXTERNAL_RECALBOX_PATH/package/kodi-resource-language-fr_fr/Config.in"
         source "$BR2_EXTERNAL_RECALBOX_PATH/package/kodi-resource-language-it_it/Config.in"
         source "$BR2_EXTERNAL_RECALBOX_PATH/package/kodi-resource-language-pt_br/Config.in"
         source "$BR2_EXTERNAL_RECALBOX_PATH/package/kodi-resource-language-sv_se/Config.in"
         source "$BR2_EXTERNAL_RECALBOX_PATH/package/kodi-resource-language-tr_tr/Config.in"
         source "$BR2_EXTERNAL_RECALBOX_PATH/package/kodi-resource-language-zh_cn/Config.in"
endmenu
endmenu
menu "Utils"
         source "$BR2_EXTERNAL_RECALBOX_PATH/package/fbv-recalbox/Config.in"
         source "$BR2_EXTERNAL_RECALBOX_PATH/package/hhpc/Config.in"
         source "$BR2_EXTERNAL_RECALBOX_PATH/package/hyperion/Config.in"
         source "$BR2_EXTERNAL_RECALBOX_PATH/package/jstest2/Config.in"
         source "$BR2_EXTERNAL_RECALBOX_PATH/package/kernelfirmwares/Config.in"
         source "$BR2_EXTERNAL_RECALBOX_PATH/package/rtl8812au/Config.in"
         source "$BR2_EXTERNAL_RECALBOX_PATH/package/rtl88x2bu/Config.in"
         source "$BR2_EXTERNAL_RECALBOX_PATH/package/rtl8821cu/Config.in"
         source "$BR2_EXTERNAL_RECALBOX_PATH/package/libcapsimage/Config.in"
         source "$BR2_EXTERNAL_RECALBOX_PATH/package/libretro-cheats/Config.in"
         source "$BR2_EXTERNAL_RECALBOX_PATH/package/megatools/Config.in"
         source "$BR2_EXTERNAL_RECALBOX_PATH/package/nanoarch/Config.in"
         source "$BR2_EXTERNAL_RECALBOX_PATH/package/raspi2png/Config.in"
         source "$BR2_EXTERNAL_RECALBOX_PATH/package/liblcf/Config.in"
         source "$BR2_EXTERNAL_RECALBOX_PATH/package/libxmp-lite/Config.in"
         source "$BR2_EXTERNAL_RECALBOX_PATH/package/wildmidi/Config.in"
         source "$BR2_EXTERNAL_RECALBOX_PATH/package/lba-finder/Config.in"
         source "$BR2_EXTERNAL_RECALBOX_PATH/package/pm-utils/Config.in"
         source "$BR2_EXTERNAL_RECALBOX_PATH/package/wsd/Config.in"
         source "$BR2_EXTERNAL_RECALBOX_PATH/package/pamix/Config.in"
endmenu
menu "Small TFT Screen"
         source "$BR2_EXTERNAL_RECALBOX_PATH/package/rpi-fbcp/Config.in"
endmenu
menu "Pi Hats"
         source "$BR2_EXTERNAL_RECALBOX_PATH/package/recalbox-wpaf/Config.in"
endmenu
endmenu
```
